VERSION "1.11.2"

NS_ :

BS_:

BU_: TCU BRK ESP MCU RDD GP TMS GW KPD1 RDE FNR ECU KPD2 ATSGO ACU IMU1 IMU2 IMU3 IMU4 IMU5 AGW PMI HDOQS EGOQS OBC EEC CBSW EJRH EJLH EPDLT EPDL2 EPDLR EPDLA TRBDZ ECU1 CLST LC510 EGDL JS SMB KPAC ACCU Audio TGU RDRR RDLH RDRH AVM CHMSL CTC SMK EVC MCU2 PHM MC3D AMBLMP RCTGU RDU PT3D XCU can1 can2

BO_ 2566902305 MCU_FOUHI: 112 MCU
 SG_ AirClnOutFiltUsedHr : 864|32@1+ (1,0) [0|4294967295] "minutes" Vector__XXX
 SG_ AirClnInFiltUsedHr : 832|32@1+ (1,0) [0|4294967295] "minutes" Vector__XXX
 SG_ PmpDrvAirCtrgHr : 800|32@1+ (1,0) [0|4294967295] "minutes" Vector__XXX
 SG_ PmpDrvOilHr : 768|32@1+ (1,0) [0|4294967295] "minutes" Vector__XXX
 SG_ HstFiltHr : 736|32@1+ (1,0) [0|4294967295] "minutes" Vector__XXX
 SG_ AxleOilFiltHr : 704|32@1+ (1,0) [0|4294967295] "minutes" Vector__XXX
 SG_ AtsSparkPlugHr : 672|32@1+ (1,0) [0|4294967295] "minutes" Vector__XXX
 SG_ EgCrkcaseBreatherElementHr : 640|32@1+ (1,0) [0|4294967295] "minutes" Vector__XXX
 SG_ AirCndFiltInHr : 608|32@1+ (1,0) [0|4294967295] "minutes" Vector__XXX
 SG_ AirCndFiltOutHr : 576|32@1+ (1,0) [0|4294967295] "minutes" Vector__XXX
 SG_ EgOilCtrCleanerFiltHr : 544|32@1+ (1,0) [0|4294967295] "minutes" Vector__XXX
 SG_ DefBreatherFiltHr : 512|32@1+ (1,0) [0|4294967295] "minutes" Vector__XXX
 SG_ DefFiltHr : 480|32@1+ (1,0) [0|4294967295] "minutes" Vector__XXX
 SG_ OilBathPrecleanerHr : 448|32@1+ (1,0) [0|4294967295] "minutes" Vector__XXX
 SG_ DefHr : 416|32@1+ (1,0) [0|4294967295] "minutes" Vector__XXX
 SG_ AxleOilHr : 384|32@1+ (1,0) [0|4294967295] "minutes" Vector__XXX
 SG_ TrmsOilFiltHr : 352|32@1+ (1,0) [0|4294967295] "minutes" Vector__XXX
 SG_ TrmsOilHr : 320|32@1+ (1,0) [0|4294967295] "minutes" Vector__XXX
 SG_ BreatherOilSepFiltHr : 288|32@1+ (1,0) [0|4294967295] "minutes" Vector__XXX
 SG_ DpfHr : 256|32@1+ (1,0) [0|4294967295] "minutes" Vector__XXX
 SG_ CoolHr : 224|32@1+ (1,0) [0|4294967295] "minutes" Vector__XXX
 SG_ HydOilHr : 192|32@1+ (1,0) [0|4294967295] "minutes" Vector__XXX
 SG_ EgOilHr : 160|32@1+ (1,0) [0|4294967295] "minutes" Vector__XXX
 SG_ PilotFiltHr : 128|32@1+ (1,0) [0|4294967295] "minutes" Vector__XXX
 SG_ RetFiltHr : 96|32@1+ (1,0) [0|4294967295] "minutes" Vector__XXX
 SG_ EgOilFiltHr : 64|32@1+ (1,0) [0|4294967295] "minutes" Vector__XXX
 SG_ AirCleanerHr : 32|32@1+ (1,0) [0|4294967295] "minutes" Vector__XXX
 SG_ FuleFiltHr : 0|32@1+ (1,0) [0|4294967295] "minutes" Vector__XXX

BO_ 2566902561 MCU_FOCPHI: 56 MCU
 SG_ AirClnOutFilt : 432|16@1+ (1,0) [0|65535] "hours" Vector__XXX
 SG_ AirClnInFilt : 416|16@1+ (1,0) [0|65535] "hours" Vector__XXX
 SG_ PmpDrvAirCtrgPrd : 400|16@1+ (1,0) [0|65535] "hours" Vector__XXX
 SG_ PmpDrvOilPrd : 384|16@1+ (1,0) [0|65535] "hours" Vector__XXX
 SG_ HstFiltPrd : 368|16@1+ (1,0) [0|65535] "hours" Vector__XXX
 SG_ AxleOilFiltPrd : 352|16@1+ (1,0) [0|65535] "hours" Vector__XXX
 SG_ AtsSparkPlugPrd : 336|16@1+ (1,0) [0|65535] "hours" Vector__XXX
 SG_ EgCrkcaseBreatherElementPrd : 320|16@1+ (1,0) [0|65535] "hours" Vector__XXX
 SG_ AirCndFiltInPrd : 304|16@1+ (1,0) [0|65535] "hours" Vector__XXX
 SG_ AirCndFiltOutPrd : 288|16@1+ (1,0) [0|65535] "hours" Vector__XXX
 SG_ EgOilCtrCleanerFiltPrd : 272|16@1+ (1,0) [0|65535] "hours" Vector__XXX
 SG_ DefBreatherFiltPrd : 256|16@1+ (1,0) [0|65535] "hours" Vector__XXX
 SG_ DefFiltPrd : 240|16@1+ (1,0) [0|65535] "hours" Vector__XXX
 SG_ OilBathPrecleanerPrd : 224|16@1+ (1,0) [0|65535] "hours" Vector__XXX
 SG_ DefPrd : 208|16@1+ (1,0) [0|65535] "hours" Vector__XXX
 SG_ AxleOilPrd : 192|16@1+ (1,0) [0|65535] "hours" Vector__XXX
 SG_ TrmsOilFiltPrd : 176|16@1+ (1,0) [0|65535] "hours" Vector__XXX
 SG_ TrmsOilPrd : 160|16@1+ (1,0) [0|65535] "hours" Vector__XXX
 SG_ BreatherOilSepFiltPrd : 144|16@1+ (1,0) [0|65535] "hours" Vector__XXX
 SG_ DpfPrd : 128|16@1+ (1,0) [0|65535] "hours" Vector__XXX
 SG_ CoolPrd : 112|16@1+ (1,0) [0|65535] "hours" Vector__XXX
 SG_ HydOilPrd : 96|16@1+ (1,0) [0|65535] "hours" Vector__XXX
 SG_ EgOilPrd : 80|16@1+ (1,0) [0|65535] "hours" Vector__XXX
 SG_ PilotFiltPrd : 64|16@1+ (1,0) [0|65535] "hours" Vector__XXX
 SG_ RetFiltPrd : 48|16@1+ (1,0) [0|65535] "hours" Vector__XXX
 SG_ EgOilFiltPrd : 32|16@1+ (1,0) [0|65535] "hours" Vector__XXX
 SG_ AirCleanerPrd : 16|16@1+ (1,0) [0|65535] "hours" Vector__XXX
 SG_ FuleFiltPrd : 0|16@1+ (1,0) [0|65535] "hours" Vector__XXX

BO_ 2566902817 MCU_XASI: 142 MCU
 SG_ PmpDrvOilTmp : 1120|16@1+ (1,-40) [-40|210] "°C" Vector__XXX
 SG_ EvaporatorTmp : 1104|16@1+ (1,-40) [-40|210] "°C" Vector__XXX
 SG_ FanSpd : 1088|16@1+ (1,0) [0|64255] "rpm" Vector__XXX
 SG_ BladeFanPchSsVlt : 1072|16@1+ (0.001,0) [0|64.255] "V" Vector__XXX
 SG_ RamLckPrs : 1056|16@1+ (0.0625,0) [0|500] "bar" Vector__XXX
 SG_ TrailerDnPilotPrs : 1040|16@1+ (0.00390625,0) [0|50] "bar" Vector__XXX
 SG_ BoomHead2Prs : 1024|16@1+ (0.0625,0) [0|500] "bar" Vector__XXX
 SG_ ArmRodPrs : 1008|16@1+ (0.0625,0) [0|500] "bar" Vector__XXX
 SG_ ArmHEadPrs : 992|16@1+ (0.0625,0) [0|500] "bar" Vector__XXX
 SG_ BoodRodPrs : 976|16@1+ (0.0625,0) [0|500] "bar" Vector__XXX
 SG_ BoomHeadPrs : 960|16@1+ (0.0625,0) [0|500] "bar" Vector__XXX
 SG_ BckRodPrsSs : 944|16@1+ (0.0625,0) [0|500] "bar" Vector__XXX
 SG_ BckHeadPrsSs : 928|16@1+ (0.0625,0) [0|500] "bar" Vector__XXX
 SG_ TpsVlt : 912|16@1+ (0.001,0) [0|64.255] "V" Vector__XXX
 SG_ PchAng : 896|16@1+ (1,0) [0|65535] "" Vector__XXX
 SG_ RoolAng : 880|16@1+ (1,0) [0|65535] "" Vector__XXX
 SG_ TmsSecVlt : 864|16@1+ (0.001,0) [0|64.255] "V" Vector__XXX
 SG_ VhcTrvlSpdSsFreq : 848|16@1+ (1,0) [0|65000] "Hz" Vector__XXX
 SG_ AirClnDiffPrsSs2 : 832|16@1+ (0.01,0) [0|642.55] "kPa" Vector__XXX
 SG_ FanClutchSpdSsFdbkSig : 816|16@1+ (1,0) [0|65000] "Hz" Vector__XXX
 SG_ FlwCtrlLeverRh : 800|16@1+ (0.001,0) [0|64.255] "V" Vector__XXX
 SG_ FlwCtrlLeverLh : 784|16@1+ (0.001,0) [0|64.255] "V" Vector__XXX
 SG_ FlwCtrlAddLeverLh : 768|16@1+ (0.001,0) [0|64.255] "V" Vector__XXX
 SG_ AirClnDiffPrsSs1 : 752|16@1+ (0.01,0) [0|642.55] "kPa" Vector__XXX
 SG_ BatVlt : 736|16@1+ (0.001,0) [0|64.255] "V" Vector__XXX
 SG_ AltVlt : 720|16@1+ (0.001,0) [0|64.255] "V" Vector__XXX
 SG_ DzLvrOutVlt : 704|16@1+ (0.001,0) [0|64.255] "V" Vector__XXX
 SG_ WirelessChgStLmpVlt : 688|16@1+ (0.001,0) [0|64.255] "V" Vector__XXX
 SG_ CbElvLvrVlt : 672|16@1+ (0.001,0) [0|64.255] "V" Vector__XXX
 SG_ HydOilTmp : 656|16@1- (1,-40) [-40|210] "celsius" Vector__XXX
 SG_ MecaCoolTmp : 640|16@1- (1,-40) [-40|210] "celsius" Vector__XXX
 SG_ GndSawDnSsPrs : 624|16@1+ (0.00390625,0) [0|50] "bar" Vector__XXX
 SG_ GndSawUpSsPrs : 608|16@1+ (0.00390625,0) [0|50] "bar" Vector__XXX
 SG_ WifSsVlt : 592|16@1+ (0.001,0) [0|64.255] "V" Vector__XXX
 SG_ FuelLv : 576|16@1+ (1,0) [0|250] "percent" Vector__XXX
 SG_ FuelLvAddFuelTnk : 560|16@1+ (16,0) [0|4000] "kPa" Vector__XXX
 SG_ AcpSsPrs : 544|16@1+ (16,0) [0|4000] "kPa" Vector__XXX
 SG_ AccPdlVlt : 528|16@1+ (0.001,0) [0|64.255] "V" Vector__XXX
 SG_ EgCtrlDialVlt : 512|16@1+ (0.001,0) [0|64.255] "V" Vector__XXX
 SG_ LsPrs : 496|16@1+ (0.0625,0) [0|500] "Bar" Vector__XXX
 SG_ P3NegaconPrs : 480|16@1+ (0.0625,0) [0|500] "Bar" Vector__XXX
 SG_ RrNegaconPrs : 464|16@1+ (0.0625,0) [0|500] "Bar" Vector__XXX
 SG_ FrNegaconPrs : 448|16@1+ (0.0625,0) [0|500] "Bar" Vector__XXX
 SG_ PilotTrvlPtPrs : 432|16@1+ (0.0625,0) [0|50] "Bar" Vector__XXX
 SG_ PilotWrkPaPrs : 416|16@1+ (0.0625,0) [0|50] "Bar" Vector__XXX
 SG_ ArmLckPrs : 400|16@1+ (0.00390625,0) [0|50] "bar" Vector__XXX
 SG_ BckCrowdConfPrs : 384|16@1+ (0.00390625,0) [0|50] "bar" Vector__XXX
 SG_ ArmCrowdConfPrs : 368|16@1+ (0.00390625,0) [0|50] "bar" Vector__XXX
 SG_ BoomUpConfPrs : 352|16@1+ (0.00390625,0) [0|50] "bar" Vector__XXX
 SG_ Opt3Prs : 336|16@1+ (0.00390625,0) [0|50] "bar" Vector__XXX
 SG_ Opt2Prs : 320|16@1+ (0.00390625,0) [0|50] "bar" Vector__XXX
 SG_ Opt1Prs : 304|16@1+ (0.00390625,0) [0|50] "bar" Vector__XXX
 SG_ SwgPrs : 288|16@1+ (0.00390625,0) [0|50] "bar" Vector__XXX
 SG_ TrvlLhPrs : 272|16@1+ (0.00390625,0) [0|50] "bar" Vector__XXX
 SG_ TrvlRhPrs : 256|16@1+ (0.00390625,0) [0|50] "bar" Vector__XXX
 SG_ BckDumpPrs : 240|16@1+ (0.00390625,0) [0|50] "bar" Vector__XXX
 SG_ BckCrowdPrs : 224|16@1+ (0.00390625,0) [0|50] "bar" Vector__XXX
 SG_ ArmOutPrs : 208|16@1+ (0.00390625,0) [0|50] "bar" Vector__XXX
 SG_ ArmInPrs : 192|16@1+ (0.00390625,0) [0|50] "bar" Vector__XXX
 SG_ BoomDnPrs : 176|16@1+ (0.00390625,0) [0|50] "bar" Vector__XXX
 SG_ BoomUpPrs : 160|16@1+ (0.00390625,0) [0|50] "bar" Vector__XXX
 SG_ EmgStrPrs : 144|16@1+ (0.0625,0) [0|500] "bar" Vector__XXX
 SG_ Pmp3Ang : 128|16@1+ (0.001,0) [0|64.255] "V" Vector__XXX
 SG_ RRpmpAng : 112|16@1+ (0.001,0) [0|64.255] "V" Vector__XXX
 SG_ FrPmpAng : 96|16@1+ (0.001,0) [0|64.255] "V" Vector__XXX
 SG_ FuelPrs : 80|16@1+ (0.00390625,0) [0|50] "bar" Vector__XXX
 SG_ RcwStpVvPrs : 64|16@1+ (0.0625,0) [0|500] "bar" Vector__XXX
 SG_ Pmp3Prs : 48|16@1+ (0.0625,0) [0|500] "bar" Vector__XXX
 SG_ BoomCylPrs : 32|16@1+ (0.0625,0) [0|500] "bar" Vector__XXX
 SG_ RrPmpPrs : 16|16@1+ (0.0625,0) [0|500] "bar" Vector__XXX
 SG_ FrPmpPrs : 0|16@1+ (0.0625,0) [0|500] "bar" Vector__XXX

BO_ 2566903073 MCU_XAAI: 92 MCU
 SG_ FanClutchPwmOutSig : 720|16@1+ (0.01,-321.27) [-321.27|321.28] "" Vector__XXX
 SG_ EfanPwmOutSig : 704|16@1+ (0.01,-321.27) [-321.27|321.28] "" Vector__XXX
 SG_ CabDnEppr : 688|16@1+ (0.001,0) [0|64.255] "mA" Vector__XXX
 SG_ CabRaiseEppr : 672|16@1+ (0.001,0) [0|64.255] "mA" Vector__XXX
 SG_ VariBladeFanEvc : 656|16@1+ (1,0) [0|2000] "mA" Vector__XXX
 SG_ BoomSwgCcwEvc : 640|16@1+ (1,0) [0|2000] "mA" Vector__XXX
 SG_ BoomSwgCwEvc : 624|16@1+ (1,0) [0|2000] "mA" Vector__XXX
 SG_ TrvlPmpEvc : 608|16@1+ (1,0) [0|2000] "mA" Vector__XXX
 SG_ Pmp3Evc : 592|16@1+ (1,0) [0|2000] "mA" Vector__XXX
 SG_ DzDnEvc : 576|16@1+ (1,0) [0|2000] "mA" Vector__XXX
 SG_ DzUpEvc : 560|16@1+ (1,0) [0|2000] "mA" Vector__XXX
 SG_ ArtiBoomDnEvc : 544|16@1+ (1,0) [0|2000] "mA" Vector__XXX
 SG_ ArtiBoomUpEvc : 528|16@1+ (1,0) [0|2000] "mA" Vector__XXX
 SG_ SwgLhEvc : 512|16@1+ (1,0) [0|2000] "mA" Vector__XXX
 SG_ SwgRhEvc : 496|16@1+ (1,0) [0|2000] "mA" Vector__XXX
 SG_ TrvlLhRvsEvc : 480|16@1+ (1,0) [0|2000] "mA" Vector__XXX
 SG_ TrvlLhFwdEvc : 464|16@1+ (1,0) [0|2000] "mA" Vector__XXX
 SG_ TrvlRhRvsEvc : 448|16@1+ (1,0) [0|2000] "mA" Vector__XXX
 SG_ TrvlRhFwdEvc : 432|16@1+ (1,0) [0|2000] "mA" Vector__XXX
 SG_ BckDumpEvc : 416|16@1+ (1,0) [0|2000] "mA" Vector__XXX
 SG_ BckCrowdEvc : 400|16@1+ (1,0) [0|2000] "mA" Vector__XXX
 SG_ Arm2DumpEvc : 384|16@1+ (1,0) [0|2000] "mA" Vector__XXX
 SG_ Arm2CrowdEvc : 368|16@1+ (1,0) [0|2000] "mA" Vector__XXX
 SG_ Arm1DumpEvc : 352|16@1+ (1,0) [0|2000] "mA" Vector__XXX
 SG_ Arm1CrowdEvc : 336|16@1+ (1,0) [0|2000] "mA" Vector__XXX
 SG_ Boom2UpEvc : 320|16@1+ (1,0) [0|2000] "mA" Vector__XXX
 SG_ Boom1DnEvc : 304|16@1+ (1,0) [0|2000] "mA" Vector__XXX
 SG_ Boom1UpEvc : 288|16@1+ (1,0) [0|2000] "mA" Vector__XXX
 SG_ ArmLckEvc : 272|16@1+ (1,0) [0|2000] "mA" Vector__XXX
 SG_ BckCrowdConfEvc : 256|16@1+ (1,0) [0|2000] "mA" Vector__XXX
 SG_ ArmCrowdConfEvc : 240|16@1+ (1,0) [0|2000] "mA" Vector__XXX
 SG_ BoomUpConfEvc : 224|16@1+ (1,0) [0|2000] "mA" Vector__XXX
 SG_ BypassCutOffBEvc : 208|16@1+ (1,0) [0|2000] "mA" Vector__XXX
 SG_ BypassCutOffAEvc : 192|16@1+ (1,0) [0|2000] "mA" Vector__XXX
 SG_ Trvl2PmpCmbEvc : 176|16@1+ (1,0) [0|2000] "mA" Vector__XXX
 SG_ TrvlFwdEvc : 160|16@1+ (1,0) [0|2000] "mA" Vector__XXX
 SG_ PrsCtrl2Evc : 144|16@1+ (1,0) [0|2000] "mA" Vector__XXX
 SG_ PrsCtrl1Evc : 128|16@1+ (1,0) [0|2000] "mA" Vector__XXX
 SG_ RttCcwEvc : 112|16@1+ (1,0) [0|2000] "mA" Vector__XXX
 SG_ RttCwEvc : 96|16@1+ (1,0) [0|2000] "mA" Vector__XXX
 SG_ TwCloseEvc : 80|16@1+ (1,0) [0|2000] "mA" Vector__XXX
 SG_ TwOpenEvc : 64|16@1+ (1,0) [0|2000] "mA" Vector__XXX
 SG_ FlwCtrlEvc : 48|16@1+ (1,0) [0|2000] "mA" Vector__XXX
 SG_ CoolFanEvc : 32|16@1+ (1,0) [0|2000] "mA" Vector__XXX
 SG_ PmpElecEvc : 16|16@1+ (1,0) [0|2000] "mA" Vector__XXX
 SG_ Pmp1Evc : 0|16@1+ (1,0) [0|2000] "mA" Vector__XXX

BO_ 2566903329 MCU_XDSI: 28 MCU
 SG_ PowerdStariwayProxSw : 218|2@1+ (1,0) [0|3] "" Vector__XXX
 SG_ KeySwAccSlave : 216|2@1+ (1,0) [0|3] "" Vector__XXX
 SG_ KeySwAccMaster : 214|2@1+ (1,0) [0|3] "" Vector__XXX
 SG_ KeySwBrSlave : 212|2@1+ (1,0) [0|3] "" Vector__XXX
 SG_ SeatBeltSw : 210|2@1+ (1,0) [0|3] "" Vector__XXX
 SG_ Efan3ErrorSt : 208|2@1+ (1,0) [0|3] "" Vector__XXX
 SG_ Efan2ErrorSt : 206|2@1+ (1,0) [0|3] "" Vector__XXX
 SG_ Efan1ErrorSt : 204|2@1+ (1,0) [0|3] "" Vector__XXX
 SG_ AgsSw : 202|2@1+ (1,0) [0|3] "" Vector__XXX
 SG_ SwgLPltPrsSw : 200|2@1+ (1,0) [0|3] "" Vector__XXX
 SG_ SwgRPltPrsSw : 198|2@1+ (1,0) [0|3] "" Vector__XXX
 SG_ FineSwgSw : 196|2@1+ (1,0) [0|3] "" Vector__XXX
 SG_ CbLwPosSw : 194|2@1+ (1,0) [0|3] "" Vector__XXX
 SG_ CbElvActSw : 192|2@1+ (1,0) [0|3] "" Vector__XXX
 SG_ MainStRpmpPrsSw : 190|2@1+ (1,0) [0|3] "" Vector__XXX
 SG_ GndSawInitSw : 188|2@1+ (1,0) [0|3] "" Vector__XXX
 SG_ FanErrSig : 186|2@1+ (1,0) [0|3] "" Vector__XXX
 SG_ HydWakeUpSw : 184|2@1+ (1,0) [0|3] "" Vector__XXX
 SG_ EmgStpSw : 182|2@1+ (1,0) [0|3] "" Vector__XXX
 SG_ HhVltChgSw : 180|2@1+ (1,0) [0|3] "" Vector__XXX
 SG_ PrkBrkPrsSw : 178|2@1+ (1,0) [0|3] "" Vector__XXX
 SG_ RamLckRvsSw : 176|2@1+ (1,0) [0|3] "" Vector__XXX
 SG_ AirCompPrsSw : 174|2@1+ (1,0) [0|3] "" Vector__XXX
 SG_ Mg2DJoyTrigSw : 172|2@1+ (1,0) [0|3] "" Vector__XXX
 SG_ KeySwBr : 170|2@1+ (1,0) [0|3] "" Vector__XXX
 SG_ TwSwSelSw : 168|2@1+ (1,0) [0|3] "" Vector__XXX
 SG_ DzOutSw : 166|2@1+ (1,0) [0|3] "" Vector__XXX
 SG_ MrrHtSw : 164|2@1+ (1,0) [0|3] "" Vector__XXX
 SG_ SwgAlignSw : 162|2@1+ (1,0) [0|3] "" Vector__XXX
 SG_ MultiFuncSw : 160|2@1+ (1,0) [0|3] "" Vector__XXX
 SG_ AutoDigSw : 158|2@1+ (1,0) [0|3] "" Vector__XXX
 SG_ TrvlPmpHhSpdSw : 156|2@1+ (1,0) [0|3] "" Vector__XXX
 SG_ DoorSw : 154|2@1+ (1,0) [0|3] "" Vector__XXX
 SG_ RrAxleRhHallSsSw : 152|2@1+ (1,0) [0|3] "" Vector__XXX
 SG_ RrAxleLhHallSsSw : 150|2@1+ (1,0) [0|3] "" Vector__XXX
 SG_ FrAxleHallSsSw : 148|2@1+ (1,0) [0|3] "" Vector__XXX
 SG_ QckCouplerRhSw : 146|2@1+ (1,0) [0|3] "" Vector__XXX
 SG_ QckCouplerLhSw : 144|2@1+ (1,0) [0|3] "" Vector__XXX
 SG_ PowMdSw : 142|2@1+ (1,0) [0|3] "" Vector__XXX
 SG_ WrkMdSw : 140|2@1+ (1,0) [0|3] "" Vector__XXX
 SG_ AuxMdSelSw : 138|2@1+ (1,0) [0|3] "" Vector__XXX
 SG_ SwgBrkRlsSw : 136|2@1+ (1,0) [0|3] "" Vector__XXX
 SG_ BrkrFltSw : 134|2@1+ (1,0) [0|3] "" Vector__XXX
 SG_ SwgPriSw : 132|2@1+ (1,0) [0|3] "" Vector__XXX
 SG_ RttCwSw : 130|2@1+ (1,0) [0|3] "" Vector__XXX
 SG_ RttCcwSw : 128|2@1+ (1,0) [0|3] "" Vector__XXX
 SG_ WiperWasherSw : 126|2@1+ (1,0) [0|3] "" Vector__XXX
 SG_ WiperContSw : 124|2@1+ (1,0) [0|3] "" Vector__XXX
 SG_ Wiper2StepSw : 122|2@1+ (1,0) [0|3] "" Vector__XXX
 SG_ Wiper1StepSw : 120|2@1+ (1,0) [0|3] "" Vector__XXX
 SG_ TmsSt : 118|2@1+ (1,0) [0|3] "" Vector__XXX
 SG_ ArtiBoomPrsSw : 116|2@1+ (1,0) [0|3] "" Vector__XXX
 SG_ CoolLvSw : 114|2@1+ (1,0) [0|3] "" Vector__XXX
 SG_ RttOprSw : 112|2@1+ (1,0) [0|3] "" Vector__XXX
 SG_ TwCloseOprSw : 110|2@1+ (1,0) [0|3] "" Vector__XXX
 SG_ TwOpenOprSw : 108|2@1+ (1,0) [0|3] "" Vector__XXX
 SG_ RcwCloseSw : 106|2@1+ (1,0) [0|3] "" Vector__XXX
 SG_ RcwOprSw : 104|2@1+ (1,0) [0|3] "" Vector__XXX
 SG_ EmgEgStpSw : 102|2@1+ (1,0) [0|3] "" Vector__XXX
 SG_ OwOptPdlPrsSw : 100|2@1+ (1,0) [0|3] "" Vector__XXX
 SG_ SpcSw : 98|2@1+ (1,0) [0|3] "" Vector__XXX
 SG_ IhbSw : 96|2@1+ (1,0) [0|3] "" Vector__XXX
 SG_ TrvlAlmSelSw : 94|2@1+ (1,0) [0|3] "" Vector__XXX
 SG_ SwgAlmSelSw : 92|2@1+ (1,0) [0|3] "" Vector__XXX
 SG_ EmgStrSw : 90|2@1+ (1,0) [0|3] "" Vector__XXX
 SG_ HhBeamSw : 88|2@1+ (1,0) [0|3] "" Vector__XXX
 SG_ StpLmp : 86|2@1+ (1,0) [0|3] "" Vector__XXX
 SG_ AccPdlSw : 84|2@1+ (1,0) [0|3] "" Vector__XXX
 SG_ BrkPrsSw : 82|2@1+ (1,0) [0|3] "" Vector__XXX
 SG_ Cruise : 80|2@1+ (1,0) [0|3] "" Vector__XXX
 SG_ EgOilPrsSw : 78|2@1+ (1,0) [0|3] "" Vector__XXX
 SG_ WrkPxPrsSw : 76|2@1+ (1,0) [0|3] "" Vector__XXX
 SG_ TrvlPyPrsSw : 74|2@1+ (1,0) [0|3] "" Vector__XXX
 SG_ IgnSw : 72|2@1+ (1,0) [0|3] "" Vector__XXX
 SG_ RamLckAutoSw : 70|2@1+ (1,0) [0|3] "" Vector__XXX
 SG_ PreHt : 68|2@1+ (1,0) [0|3] "" Vector__XXX
 SG_ WifWrn : 66|2@1+ (1,0) [0|3] "" Vector__XXX
 SG_ SwgPrsSw : 64|2@1+ (1,0) [0|3] "" Vector__XXX
 SG_ JoyPtnBhl : 62|2@1+ (1,0) [0|3] "" Vector__XXX
 SG_ JoyPtnIso : 60|2@1+ (1,0) [0|3] "" Vector__XXX
 SG_ RvsFanSw : 58|2@1+ (1,0) [0|3] "" Vector__XXX
 SG_ TwOptPdlPrsSw : 56|2@1+ (1,0) [0|3] "" Vector__XXX
 SG_ BrkOilPrsWrn : 54|2@1+ (1,0) [0|3] "" Vector__XXX
 SG_ OwdWrnSelSw : 52|2@1+ (1,0) [0|3] "" Vector__XXX
 SG_ RetFiltWrn : 50|2@1+ (1,0) [0|3] "" Vector__XXX
 SG_ PilotFiltWrn : 48|2@1+ (1,0) [0|3] "" Vector__XXX
 SG_ AirCleanerWrn : 46|2@1+ (1,0) [0|3] "" Vector__XXX
 SG_ PilotCutOffSw : 44|2@1+ (1,0) [0|3] "" Vector__XXX
 SG_ ItgtBoomSw : 42|2@1+ (1,0) [0|3] "" Vector__XXX
 SG_ OneTouchRedSpdSw : 40|2@1+ (1,0) [0|3] "" Vector__XXX
 SG_ RamLckSw : 38|2@1+ (1,0) [0|3] "" Vector__XXX
 SG_ PrkSw : 36|2@1+ (1,0) [0|3] "" Vector__XXX
 SG_ AirCndSw : 34|2@1+ (1,0) [0|3] "" Vector__XXX
 SG_ JoyDirSelSw : 32|2@1+ (1,0) [0|3] "" Vector__XXX
 SG_ TrvlBwdSw : 30|2@1+ (1,0) [0|3] "" Vector__XXX
 SG_ TrvlNtrlSw : 28|2@1+ (1,0) [0|3] "" Vector__XXX
 SG_ TrvlFwdSw : 26|2@1+ (1,0) [0|3] "" Vector__XXX
 SG_ HhSpdSelSw : 24|2@1+ (1,0) [0|3] "" Vector__XXX
 SG_ LwSpdSelSw : 22|2@1+ (1,0) [0|3] "" Vector__XXX
 SG_ InchingSelSw : 20|2@1+ (1,0) [0|3] "" Vector__XXX
 SG_ QckCoupler : 18|2@1+ (1,0) [0|3] "" Vector__XXX
 SG_ TwSelSw : 16|2@1+ (1,0) [0|3] "" Vector__XXX
 SG_ OnwWaySelSw : 14|2@1+ (1,0) [0|3] "" Vector__XXX
 SG_ WrkLmpSw : 12|2@1+ (1,0) [0|3] "" Vector__XXX
 SG_ AutoTrvl2SpdSw : 10|2@1+ (1,0) [0|3] "" Vector__XXX
 SG_ Trvl2SpdSelSw : 8|2@1+ (1,0) [0|3] "" Vector__XXX
 SG_ TrvlSelSw : 6|2@1+ (1,0) [0|3] "" Vector__XXX
 SG_ BrkrSw : 4|2@1+ (1,0) [0|3] "" Vector__XXX
 SG_ PwrMaxSw : 2|2@1+ (1,0) [0|3] "" Vector__XXX
 SG_ Alt : 0|2@1+ (1,0) [0|3] "" Vector__XXX

BO_ 2566903585 MCU_XDAI: 24 MCU
 SG_ SwgLoadRedSolR : 188|2@1+ (1,0) [0|3] "" Vector__XXX
 SG_ SwgLoadRedSolF : 186|2@1+ (1,0) [0|3] "" Vector__XXX
 SG_ OptPriSv : 184|2@1+ (1,0) [0|3] "" Vector__XXX
 SG_ PmpDrvCoolSv : 182|2@1+ (1,0) [0|3] "" Vector__XXX
 SG_ SecondStarterRly : 180|2@1+ (1,0) [0|3] "" Vector__XXX
 SG_ FuelFilledLmp : 178|2@1+ (1,0) [0|3] "" Vector__XXX
 SG_ ExtVocWarnSig : 176|2@1+ (1,0) [0|3] "" Vector__XXX
 SG_ EtpRly : 174|2@1+ (1,0) [0|3] "" Vector__XXX
 SG_ DesRunSig : 172|2@1+ (1,0) [0|3] "" Vector__XXX
 SG_ EngRunOutSig : 170|2@1+ (1,0) [0|3] "" Vector__XXX
 SG_ AccRly : 168|2@1+ (1,0) [0|3] "" Vector__XXX
 SG_ SelSv : 166|2@1+ (1,0) [0|3] "" Vector__XXX
 SG_ ArmCrowdCutOffSv : 164|2@1+ (1,0) [0|3] "" Vector__XXX
 SG_ ArmDumpCutOffSv : 162|2@1+ (1,0) [0|3] "" Vector__XXX
 SG_ EmgStrSv : 160|2@1+ (1,0) [0|3] "" Vector__XXX
 SG_ TrvlRhPilotCutOffSv : 158|2@1+ (1,0) [0|3] "" Vector__XXX
 SG_ GndSawMdChangeRly : 156|2@1+ (1,0) [0|3] "" Vector__XXX
 SG_ HvChgSig : 150|2@1+ (1,0) [0|3] "" Vector__XXX
 SG_ FanPwmSig : 148|2@1+ (1,0) [0|3] "" Vector__XXX
 SG_ TrkExpationSv : 146|2@1+ (1,0) [0|3] "" Vector__XXX
 SG_ HhVltMainRly : 144|2@1+ (1,0) [0|3] "" Vector__XXX
 SG_ HhVltPreChgRly : 142|2@1+ (1,0) [0|3] "" Vector__XXX
 SG_ PilotBz : 140|2@1+ (1,0) [0|3] "" Vector__XXX
 SG_ QckChgInd : 138|2@1+ (1,0) [0|3] "" Vector__XXX
 SG_ QckChgRly : 136|2@1+ (1,0) [0|3] "" Vector__XXX
 SG_ NormChgInd : 134|2@1+ (1,0) [0|3] "" Vector__XXX
 SG_ LwVltMainRly : 132|2@1+ (1,0) [0|3] "" Vector__XXX
 SG_ BoomSwgSelRly : 130|2@1+ (1,0) [0|3] "" Vector__XXX
 SG_ PmpDeratSv : 128|2@1+ (1,0) [0|3] "" Vector__XXX
 SG_ PrkBrkRly : 126|2@1+ (1,0) [0|3] "" Vector__XXX
 SG_ RvsLmpRly : 124|2@1+ (1,0) [0|3] "" Vector__XXX
 SG_ AirCompRly : 122|2@1+ (1,0) [0|3] "" Vector__XXX
 SG_ CabLmpRly : 120|2@1+ (1,0) [0|3] "" Vector__XXX
 SG_ AvmWrnSig : 118|2@1+ (1,0) [0|3] "" Vector__XXX
 SG_ WrkLmpRly : 116|2@1+ (1,0) [0|3] "" Vector__XXX
 SG_ AirCondCompStpSig : 114|2@1+ (1,0) [0|3] "" Vector__XXX
 SG_ Chmsl : 112|2@1+ (1,0) [0|3] "" Vector__XXX
 SG_ BoomSusRodSv : 110|2@1+ (1,0) [0|3] "" Vector__XXX
 SG_ BoomSusHedSv : 108|2@1+ (1,0) [0|3] "" Vector__XXX
 SG_ MrrHt : 106|2@1+ (1,0) [0|3] "" Vector__XXX
 SG_ ClearLmp : 104|2@1+ (1,0) [0|3] "" Vector__XXX
 SG_ HhHeadLmp : 102|2@1+ (1,0) [0|3] "" Vector__XXX
 SG_ LwHeadLmp : 100|2@1+ (1,0) [0|3] "" Vector__XXX
 SG_ FineSwgSv : 98|2@1+ (1,0) [0|3] "" Vector__XXX
 SG_ TurnRhSigLmp : 96|2@1+ (1,0) [0|3] "" Vector__XXX
 SG_ TurnLhSigLmp : 94|2@1+ (1,0) [0|3] "" Vector__XXX
 SG_ BeaconRly : 92|2@1+ (1,0) [0|3] "" Vector__XXX
 SG_ LightRly : 90|2@1+ (1,0) [0|3] "" Vector__XXX
 SG_ LmpRly : 88|2@1+ (1,0) [0|3] "" Vector__XXX
 SG_ RamLckSv : 86|2@1+ (1,0) [0|3] "" Vector__XXX
 SG_ LwSpdTrvlSv : 84|2@1+ (1,0) [0|3] "" Vector__XXX
 SG_ TrvlPmpHhSpd2Sv : 82|2@1+ (1,0) [0|3] "" Vector__XXX
 SG_ TrvlPmpHhSpd1Sv : 80|2@1+ (1,0) [0|3] "" Vector__XXX
 SG_ WiperWasherRly : 78|2@1+ (1,0) [0|3] "" Vector__XXX
 SG_ WiperRly : 76|2@1+ (1,0) [0|3] "" Vector__XXX
 SG_ AutoShutOffRly : 74|2@1+ (1,0) [0|3] "" Vector__XXX
 SG_ AirHtRly : 72|2@1+ (1,0) [0|3] "" Vector__XXX
 SG_ GlowPlugPreHhRly2 : 70|2@1+ (1,0) [0|3] "" Vector__XXX
 SG_ GlowPlugPreHhRly1 : 68|2@1+ (1,0) [0|3] "" Vector__XXX
 SG_ HhSpdRly : 66|2@1+ (1,0) [0|3] "" Vector__XXX
 SG_ LwSpdRly : 64|2@1+ (1,0) [0|3] "" Vector__XXX
 SG_ InchingRly : 62|2@1+ (1,0) [0|3] "" Vector__XXX
 SG_ SpareRly : 60|2@1+ (1,0) [0|3] "" Vector__XXX
 SG_ BackBzRly : 58|2@1+ (1,0) [0|3] "" Vector__XXX
 SG_ StartRly : 56|2@1+ (1,0) [0|3] "" Vector__XXX
 SG_ AutoBrkSv : 54|2@1+ (1,0) [0|3] "" Vector__XXX
 SG_ PilotCutOffSv : 52|2@1+ (1,0) [0|3] "" Vector__XXX
 SG_ McvEpprCutOffSv : 50|2@1+ (1,0) [0|3] "" Vector__XXX
 SG_ BsSpoolSc : 48|2@1+ (1,0) [0|3] "" Vector__XXX
 SG_ QckCouplerSv : 46|2@1+ (1,0) [0|3] "" Vector__XXX
 SG_ FreeBoomDnSv : 44|2@1+ (1,0) [0|3] "" Vector__XXX
 SG_ FreeBoomUpSv : 42|2@1+ (1,0) [0|3] "" Vector__XXX
 SG_ TrvlStrgtSv : 40|2@1+ (1,0) [0|3] "" Vector__XXX
 SG_ RttCcwSv : 38|2@1+ (1,0) [0|3] "" Vector__XXX
 SG_ RttCwSv : 36|2@1+ (1,0) [0|3] "" Vector__XXX
 SG_ Trvl2PmpCmbSv : 34|2@1+ (1,0) [0|3] "" Vector__XXX
 SG_ OptPdlSaftySv : 32|2@1+ (1,0) [0|3] "" Vector__XXX
 SG_ ForceRgnSv : 30|2@1+ (1,0) [0|3] "" Vector__XXX
 SG_ TwOprSv : 28|2@1+ (1,0) [0|3] "" Vector__XXX
 SG_ UnloadSv : 26|2@1+ (1,0) [0|3] "" Vector__XXX
 SG_ TwRhCloseSv : 24|2@1+ (1,0) [0|3] "" Vector__XXX
 SG_ TwRhOpenSv : 22|2@1+ (1,0) [0|3] "" Vector__XXX
 SG_ SwgBrkRelSv : 20|2@1+ (1,0) [0|3] "" Vector__XXX
 SG_ BypassCutOffSv : 18|2@1+ (1,0) [0|3] "" Vector__XXX
 SG_ RwdSv : 16|2@1+ (1,0) [0|3] "" Vector__XXX
 SG_ FwdSv : 14|2@1+ (1,0) [0|3] "" Vector__XXX
 SG_ CruiseSv : 12|2@1+ (1,0) [0|3] "" Vector__XXX
 SG_ TwoPmpSelSv : 10|2@1+ (1,0) [0|3] "" Vector__XXX
 SG_ FanRvsSv : 8|2@1+ (1,0) [0|3] "" Vector__XXX
 SG_ BrkrSelSv : 6|2@1+ (1,0) [0|3] "" Vector__XXX
 SG_ HhSpdTrvlSv : 4|2@1+ (1,0) [0|3] "" Vector__XXX
 SG_ PowMaxSv : 2|2@1+ (1,0) [0|3] "" Vector__XXX
 SG_ BrkrOprSv : 0|2@1+ (1,0) [0|3] "" Vector__XXX

BO_ 2566903841 MCU_LASI: 98 MCU
 SG_ TmsSecVlt : 768|16@1+ (0.001,0) [0|64.255] "V" Vector__XXX
 SG_ EvaporatorTmp : 752|16@1+ (1,-40) [-40|210] "`C" Vector__XXX
 SG_ RsvJoy1GripYPos : 746|6@1+ (1,0) [0|63] "" Vector__XXX
 SG_ Joy1GripYPos : 736|10@1+ (0.1,0) [0|102] "percent" Vector__XXX
 SG_ RsvJoy1YPos : 730|6@1+ (1,0) [0|63] "" Vector__XXX
 SG_ Joy1YPos : 720|10@1+ (0.1,0) [0|102] "percent" Vector__XXX
 SG_ RsvJoy1XPos : 714|6@1+ (1,0) [0|63] "" Vector__XXX
 SG_ Joy1XPos : 704|10@1+ (0.1,0) [0|102] "percent" Vector__XXX
 SG_ EmcvLeverOptB : 688|16@1+ (0.001,0) [0|64.255] "V" Vector__XXX
 SG_ EmcvLeverOptA : 672|16@1+ (0.001,0) [0|64.255] "V" Vector__XXX
 SG_ EmcvLeverBckB : 656|16@1+ (0.001,0) [0|64.255] "V" Vector__XXX
 SG_ EmcvLeverBckA : 640|16@1+ (0.001,0) [0|64.255] "V" Vector__XXX
 SG_ EmcvLeverBoomB : 624|16@1+ (0.001,0) [0|64.255] "V" Vector__XXX
 SG_ EmcvLeverBoomA : 608|16@1+ (0.001,0) [0|64.255] "V" Vector__XXX
 SG_ ElecStrVv : 592|16@1+ (1,0) [0|65535] "percent" Vector__XXX
 SG_ ElecStrLeverB : 576|16@1+ (0.001,0) [0|64.255] "V" Vector__XXX
 SG_ ElecStrLeverA : 560|16@1+ (0.001,0) [0|64.255] "V" Vector__XXX
 SG_ AcpSsPrs : 544|16@1+ (16,0) [0|4000] "kPa" Vector__XXX
 SG_ FanSpd : 528|16@1+ (1,0) [0|64255] "rpm" Vector__XXX
 SG_ BatTmp : 512|16@1+ (0.001,0) [0|64.255] "V" Vector__XXX
 SG_ AltTmp : 496|16@1+ (0.001,0) [0|64.255] "V" Vector__XXX
 SG_ AxleOilTmp : 432|16@1- (1,-40) [-40|210] "celsius" Vector__XXX
 SG_ HydOilTmp : 416|16@1- (1,-40) [-40|210] "celsius" Vector__XXX
 SG_ CoolTmp : 400|16@1- (1,-40) [-40|210] "celsius" Vector__XXX
 SG_ OpsSsVlt : 384|16@1+ (0.001,0) [0|64.255] "V" Vector__XXX
 SG_ WifSsVlt : 368|16@1+ (0.001,0) [0|64.255] "V" Vector__XXX
 SG_ FuelLv : 352|16@1+ (1,0) [0|250] "percent" Vector__XXX
 SG_ BrkPdlB : 304|16@1+ (0.001,0) [0|64.255] "V" Vector__XXX
 SG_ BrkPdlA : 288|16@1+ (0.001,0) [0|64.255] "V" Vector__XXX
 SG_ AccPdlVlt : 272|16@1+ (0.001,0) [0|64.255] "V" Vector__XXX
 SG_ BrkChgPriPrs : 256|16@1+ (0.0625,0) [0|500] "bar" Vector__XXX
 SG_ RhThmbWhlVlt : 240|16@1+ (0.001,0) [0|64.255] "V" Vector__XXX
 SG_ CtlLsPrs : 224|16@1+ (0.0625,0) [0|500] "bar" Vector__XXX
 SG_ CtlTowSpdPrs : 208|16@1+ (0.0625,0) [0|500] "bar" Vector__XXX
 SG_ AngSsBckRef : 192|16@1+ (0.001,0) [0|64.255] "V" Vector__XXX
 SG_ AngSsBck : 176|16@1+ (0.001,0) [0|64.255] "V" Vector__XXX
 SG_ AngSsBoomRef : 160|16@1+ (0.001,0) [0|64.255] "V" Vector__XXX
 SG_ AngSsBoom : 144|16@1+ (0.001,0) [0|64.255] "V" Vector__XXX
 SG_ CtlBckLoadPrs : 128|16@1+ (0.0625,0) [0|500] "bar" Vector__XXX
 SG_ CtlEgCtrlDialVlt : 112|16@1+ (0.001,0) [0|64.255] "V" Vector__XXX
 SG_ PrkBrkPrs : 96|16@1+ (0.0625,0) [0|500] "bar" Vector__XXX
 SG_ FanMotPrs : 80|16@1+ (0.0625,0) [0|500] "bar" Vector__XXX
 SG_ BrkOilPrs : 64|16@1+ (0.0625,0) [0|500] "bar" Vector__XXX
 SG_ StrPrs : 48|16@1+ (0.0625,0) [0|500] "bar" Vector__XXX
 SG_ BoomRodPrs : 32|16@1+ (0.0625,0) [0|500] "bar" Vector__XXX
 SG_ BooHeadPrs : 16|16@1+ (0.0625,0) [0|500] "bar" Vector__XXX
 SG_ MainPrs : 0|16@1+ (0.0625,0) [0|500] "bar" Vector__XXX

BO_ 2566904097 MCU_LAAI: 50 MCU
 SG_ FanClutchPwmOutSig : 384|16@1+ (0.01,-321.27) [-321.27|321.28] "percent" Vector__XXX
 SG_ CacFanCtrl : 368|16@1- (0.01,-321.27) [-321.27|321.28] "percent" Vector__XXX
 SG_ CdsFanCtrl : 352|16@1- (0.01,-321.27) [-321.27|321.28] "percent" Vector__XXX
 SG_ RipperDnEvc : 336|16@1+ (1,0) [0|2000] "mA" Vector__XXX
 SG_ RipperUpEvc : 320|16@1+ (1,0) [0|2000] "mA" Vector__XXX
 SG_ BladeAngLhEvc : 304|16@1+ (1,0) [0|2000] "mA" Vector__XXX
 SG_ BladeAngRhEvc : 288|16@1+ (1,0) [0|2000] "mA" Vector__XXX
 SG_ BladeDnEvc : 272|16@1+ (1,0) [0|2000] "mA" Vector__XXX
 SG_ BladeRaiseEvc : 256|16@1+ (1,0) [0|2000] "mA" Vector__XXX
 SG_ BladeTiltLhEvc : 240|16@1+ (1,0) [0|2000] "mA" Vector__XXX
 SG_ BladeTiltRhEvc : 224|16@1+ (1,0) [0|2000] "mA" Vector__XXX
 SG_ EbrkPropPrsRedVv : 160|16@1+ (1,0) [0|2000] "mA" Vector__XXX
 SG_ McvBackPrsEvc : 144|16@1+ (1,0) [0|2000] "mA" Vector__XXX
 SG_ Spool4BEvc : 128|16@1+ (1,0) [0|2000] "mA" Vector__XXX
 SG_ Spool4AEvc : 112|16@1+ (1,0) [0|2000] "mA" Vector__XXX
 SG_ Opt2Evc : 96|16@1+ (1,0) [0|2000] "mA" Vector__XXX
 SG_ Opt1Evc : 80|16@1+ (1,0) [0|2000] "mA" Vector__XXX
 SG_ BckDumpEvc : 64|16@1+ (1,0) [0|2000] "mA" Vector__XXX
 SG_ BoomCrowdEvc : 48|16@1+ (1,0) [0|2000] "mA" Vector__XXX
 SG_ BoomFltEvc : 32|16@1+ (1,0) [0|2000] "mA" Vector__XXX
 SG_ BoomRaiseEvc : 16|16@1+ (1,0) [0|2000] "mA" Vector__XXX
 SG_ FanCtrlEvc : 0|16@1+ (1,0) [0|2000] "mA" Vector__XXX

BO_ 2566904353 MCU_LDSI: 16 MCU
 SG_ AxleDhlCtrlSw : 126|2@1+ (1,0) [0|3] "" Vector__XXX
 SG_ QckCplDisengageSw : 124|2@1+ (1,0) [0|3] "" Vector__XXX
 SG_ RttBeaconSw : 122|2@1+ (1,0) [0|3] "" Vector__XXX
 SG_ RvsFanManualSw : 120|2@1+ (1,0) [0|3] "" Vector__XXX
 SG_ RvsFanAutoSw : 118|2@1+ (1,0) [0|3] "" Vector__XXX
 SG_ Aux8Sw : 116|2@1+ (1,0) [0|3] "" Vector__XXX
 SG_ TwoSpeedSw : 114|2@1+ (1,0) [0|3] "" Vector__XXX
 SG_ Aux7Sw : 112|2@1+ (1,0) [0|3] "" Vector__XXX
 SG_ OpsSw : 110|2@1+ (1,0) [0|3] "" Vector__XXX
 SG_ HhFlowPinK : 108|2@1+ (1,0) [0|3] "" Vector__XXX
 SG_ HhFlowPinN : 106|2@1+ (1,0) [0|3] "" Vector__XXX
 SG_ DustInd : 104|2@1+ (1,0) [0|3] "" Vector__XXX
 SG_ FrDoorSw : 102|2@1+ (1,0) [0|3] "" Vector__XXX
 SG_ ArmRestLhSw : 100|2@1+ (1,0) [0|3] "" Vector__XXX
 SG_ ArmRestRhSw : 98|2@1+ (1,0) [0|3] "" Vector__XXX
 SG_ Spool3LeverSw : 96|2@1+ (1,0) [0|3] "" Vector__XXX
 SG_ BckLeverSw : 94|2@1+ (1,0) [0|3] "" Vector__XXX
 SG_ EgOilPrsSw : 92|2@1+ (1,0) [0|3] "" Vector__XXX
 SG_ HydLckoutSw : 90|2@1+ (1,0) [0|3] "" Vector__XXX
 SG_ TractionCtrlSw : 88|2@1+ (1,0) [0|3] "" Vector__XXX
 SG_ AirCleanSw : 86|2@1+ (1,0) [0|3] "" Vector__XXX
 SG_ RetFiltSw : 84|2@1+ (1,0) [0|3] "" Vector__XXX
 SG_ QckCouperLckSw : 82|2@1+ (1,0) [0|3] "" Vector__XXX
 SG_ DnShftSw : 80|2@1+ (1,0) [0|3] "" Vector__XXX
 SG_ PreHt : 78|2@1+ (1,0) [0|3] "" Vector__XXX
 SG_ Joy1XDetentPosSt : 76|2@1+ (1,0) [0|3] "" Vector__XXX
 SG_ Joy1YDetentPosSt : 74|2@1+ (1,0) [0|3] "" Vector__XXX
 SG_ IhbSw : 72|2@1+ (1,0) [0|3] "" Vector__XXX
 SG_ HstOilFiltWrn : 70|2@1+ (1,0) [0|3] "" Vector__XXX
 SG_ GrboxOvrTmp : 68|2@1+ (1,0) [0|3] "" Vector__XXX
 SG_ AgsLmp : 66|2@1+ (1,0) [0|3] "" Vector__XXX
 SG_ QckCouplerInitSw : 64|2@1+ (1,0) [0|3] "" Vector__XXX
 SG_ PrkSw : 62|2@1+ (1,0) [0|3] "" Vector__XXX
 SG_ SeatBeltSw : 60|2@1+ (1,0) [0|3] "" Vector__XXX
 SG_ ReDefrstSw : 58|2@1+ (1,0) [0|3] "" Vector__XXX
 SG_ HormSw : 56|2@1+ (1,0) [0|3] "" Vector__XXX
 SG_ Fnr2ActSw : 54|2@1+ (1,0) [0|3] "" Vector__XXX
 SG_ RearWiperStpSw : 52|2@1+ (1,0) [0|3] "" Vector__XXX
 SG_ FrWiperStpSig : 50|2@1+ (1,0) [0|3] "" Vector__XXX
 SG_ DpfForceRgnSw : 48|2@1+ (1,0) [0|3] "" Vector__XXX
 SG_ EmgStrPrsSw : 46|2@1+ (1,0) [0|3] "" Vector__XXX
 SG_ MainStrPrsSw : 44|2@1+ (1,0) [0|3] "" Vector__XXX
 SG_ AccPdlKd : 42|2@1+ (1,0) [0|3] "" Vector__XXX
 SG_ AccPdlIvs : 40|2@1+ (1,0) [0|3] "" Vector__XXX
 SG_ PrkBrkPrsSw : 38|2@1+ (1,0) [0|3] "" Vector__XXX
 SG_ CoolLv : 36|2@1+ (1,0) [0|3] "" Vector__XXX
 SG_ WghCntSw : 34|2@1+ (1,0) [0|3] "" Vector__XXX
 SG_ EmgStpSw : 32|2@1+ (1,0) [0|3] "" Vector__XXX
 SG_ DhlManSw : 30|2@1+ (1,0) [0|3] "" Vector__XXX
 SG_ FnrR3 : 28|2@1+ (1,0) [0|3] "" Vector__XXX
 SG_ FnrN3 : 26|2@1+ (1,0) [0|3] "" Vector__XXX
 SG_ FnrF3 : 24|2@1+ (1,0) [0|3] "" Vector__XXX
 SG_ FnrR2 : 22|2@1+ (1,0) [0|3] "" Vector__XXX
 SG_ FnrN2 : 20|2@1+ (1,0) [0|3] "" Vector__XXX
 SG_ FnrF2 : 18|2@1+ (1,0) [0|3] "" Vector__XXX
 SG_ FnrR1 : 16|2@1+ (1,0) [0|3] "" Vector__XXX
 SG_ FnrN1 : 14|2@1+ (1,0) [0|3] "" Vector__XXX
 SG_ FnrF1 : 12|2@1+ (1,0) [0|3] "" Vector__XXX
 SG_ StartBrSw : 10|2@1+ (1,0) [0|3] "" Vector__XXX
 SG_ StartAccSw : 8|2@1+ (1,0) [0|3] "" Vector__XXX
 SG_ StartCSw : 6|2@1+ (1,0) [0|3] "" Vector__XXX
 SG_ PilotCutOffSw : 4|2@1+ (1,0) [0|3] "" Vector__XXX
 SG_ ArmRestCutOffSw : 2|2@1+ (1,0) [0|3] "" Vector__XXX
 SG_ ElecStrSelSw : 0|2@1+ (1,0) [0|3] "" Vector__XXX

BO_ 2566904609 MCU_LDAI: 17 MCU
 SG_ DhlSol : 130|2@1+ (1,0) [0|3] "" Vector__XXX
 SG_ GreenBeacon : 128|2@1+ (1,0) [0|3] "" Vector__XXX
 SG_ Beacon : 126|2@1+ (1,0) [0|3] "" Vector__XXX
 SG_ RrWrkLmp : 124|2@1+ (1,0) [0|3] "" Vector__XXX
 SG_ FrWrkLmp : 122|2@1+ (1,0) [0|3] "" Vector__XXX
 SG_ EfanOutSig : 120|2@1+ (1,0) [0|3] "" Vector__XXX
 SG_ RrCabLmpRly : 118|2@1+ (1,0) [0|3] "" Vector__XXX
 SG_ FrCabLmpRly : 116|2@1+ (1,0) [0|3] "" Vector__XXX
 SG_ HeadLmpRly : 114|2@1+ (1,0) [0|3] "" Vector__XXX
 SG_ RideCtrlCutOffSv : 112|2@1+ (1,0) [0|3] "" Vector__XXX
 SG_ Aux8 : 110|2@1+ (1,0) [0|3] "" Vector__XXX
 SG_ Aux7 : 108|2@1+ (1,0) [0|3] "" Vector__XXX
 SG_ Aux6 : 106|2@1+ (1,0) [0|3] "" Vector__XXX
 SG_ Aux5 : 104|2@1+ (1,0) [0|3] "" Vector__XXX
 SG_ Aux4 : 102|2@1+ (1,0) [0|3] "" Vector__XXX
 SG_ Aux3 : 100|2@1+ (1,0) [0|3] "" Vector__XXX
 SG_ AuxShutOffSv : 98|2@1+ (1,0) [0|3] "" Vector__XXX
 SG_ PilotCutOffSv : 96|2@1+ (1,0) [0|3] "" Vector__XXX
 SG_ FrWiperRly : 94|2@1+ (1,0) [0|3] "" Vector__XXX
 SG_ SideWasherRly : 92|2@1+ (1,0) [0|3] "" Vector__XXX
 SG_ UreaSuperChgWrnSig : 90|2@1+ (1,0) [0|3] "" Vector__XXX
 SG_ EgRunOutSig : 88|2@1+ (1,0) [0|3] "" Vector__XXX
 SG_ SideWiperRly : 86|2@1+ (1,0) [0|3] "" Vector__XXX
 SG_ FrWhaserRly : 84|2@1+ (1,0) [0|3] "" Vector__XXX
 SG_ FrWiperLwSigRly : 82|2@1+ (1,0) [0|3] "" Vector__XXX
 SG_ FrWiperHhSpdRly : 80|2@1+ (1,0) [0|3] "" Vector__XXX
 SG_ LwBeamRly : 78|2@1+ (1,0) [0|3] "" Vector__XXX
 SG_ HhBeamRly : 76|2@1+ (1,0) [0|3] "" Vector__XXX
 SG_ IllmLmpRly : 74|2@1+ (1,0) [0|3] "" Vector__XXX
 SG_ RttBeaconRly : 72|2@1+ (1,0) [0|3] "" Vector__XXX
 SG_ TurnSigRhRly : 70|2@1+ (1,0) [0|3] "" Vector__XXX
 SG_ TurnSigLhRly : 68|2@1+ (1,0) [0|3] "" Vector__XXX
 SG_ HormRly : 66|2@1+ (1,0) [0|3] "" Vector__XXX
 SG_ AccRly : 64|2@1+ (1,0) [0|3] "" Vector__XXX
 SG_ RrWinHtRly : 62|2@1+ (1,0) [0|3] "" Vector__XXX
 SG_ AutoShutOffRly : 60|2@1+ (1,0) [0|3] "" Vector__XXX
 SG_ BackUpBzRly : 58|2@1+ (1,0) [0|3] "" Vector__XXX
 SG_ MrrHtRly : 56|2@1+ (1,0) [0|3] "" Vector__XXX
 SG_ HuelHtRly : 54|2@1+ (1,0) [0|3] "" Vector__XXX
 SG_ GlowPlugFuelRly : 52|2@1+ (1,0) [0|3] "" Vector__XXX
 SG_ GlowPlugRly : 50|2@1+ (1,0) [0|3] "" Vector__XXX
 SG_ EmgStrTestRly : 48|2@1+ (1,0) [0|3] "" Vector__XXX
 SG_ RrWasherRly : 46|2@1+ (1,0) [0|3] "" Vector__XXX
 SG_ RrWiperRly : 44|2@1+ (1,0) [0|3] "" Vector__XXX
 SG_ RrWrkCabLmpRly : 42|2@1+ (1,0) [0|3] "" Vector__XXX
 SG_ RrWrkRadLmpRly : 40|2@1+ (1,0) [0|3] "" Vector__XXX
 SG_ FrWrkLmpRly : 38|2@1+ (1,0) [0|3] "" Vector__XXX
 SG_ ElecStrSaftyRly : 36|2@1+ (1,0) [0|3] "" Vector__XXX
 SG_ PilotBzRly : 34|2@1+ (1,0) [0|3] "" Vector__XXX
 SG_ LisActRly : 32|2@1+ (1,0) [0|3] "" Vector__XXX
 SG_ HstCutOffRhSv : 30|2@1+ (1,0) [0|3] "" Vector__XXX
 SG_ HstCutOffLhSv : 28|2@1+ (1,0) [0|3] "" Vector__XXX
 SG_ BckMagnet : 26|2@1+ (1,0) [0|3] "" Vector__XXX
 SG_ BoomMagnet : 24|2@1+ (1,0) [0|3] "" Vector__XXX
 SG_ HstCutOffSv : 20|2@1+ (1,0) [0|3] "" Vector__XXX
 SG_ HydCutOffSv : 18|2@1+ (1,0) [0|3] "" Vector__XXX
 SG_ StartRly : 16|2@1+ (1,0) [0|3] "" Vector__XXX
 SG_ QckCouplerRly : 14|2@1+ (1,0) [0|3] "" Vector__XXX
 SG_ EgStpRly : 12|2@1+ (1,0) [0|3] "" Vector__XXX
 SG_ PrkBrkRlsSv : 10|2@1+ (1,0) [0|3] "" Vector__XXX
 SG_ EscortWrkLmpRly : 8|2@1+ (1,0) [0|3] "" Vector__XXX
 SG_ AxleOilCoolSv : 6|2@1+ (1,0) [0|3] "" Vector__XXX
 SG_ UnloadSv : 4|2@1+ (1,0) [0|3] "" Vector__XXX
 SG_ BrkChgSv : 2|2@1+ (1,0) [0|3] "" Vector__XXX
 SG_ RvsFanSV : 0|2@1+ (1,0) [0|3] "" Vector__XXX

BO_ 2566904865 MCU_CETI: 12 MCU
 SG_ EcuMaker2 : 88|8@1+ (1,0) [0|255] "" Vector__XXX
 SG_ MchMaker : 80|4@1+ (1,0) [0|15] "" Vector__XXX
 SG_ SalesRegion : 72|8@1+ (1,0) [0|255] "" Vector__XXX
 SG_ TcuType : 68|4@1+ (1,0) [0|15] "" Vector__XXX
 SG_ JoyType : 64|4@1+ (1,0) [0|15] "" Vector__XXX
 SG_ McvCtrlType : 60|4@1+ (1,0) [0|15] "" Vector__XXX
 SG_ McvType : 56|4@1+ (1,0) [0|15] "" Vector__XXX
 SG_ PmpCtrlType : 52|4@1+ (1,0) [0|15] "" Vector__XXX
 SG_ PmpType : 48|4@1+ (1,0) [0|15] "" Vector__XXX
 SG_ EcuMaker : 44|4@1+ (1,0) [0|15] "" Vector__XXX
 SG_ EgMaker : 40|4@1+ (1,0) [0|15] "" Vector__XXX
 SG_ ModelYearVer : 36|4@1+ (1,0) [0|15] "" Vector__XXX
 SG_ MchType : 32|4@1+ (1,0) [0|15] "" Vector__XXX
 SG_ MchClass : 16|16@1+ (0.1,0) [0|6502.3] "" Vector__XXX
 SG_ MchGen : 8|8@1+ (1,0) [0|255] "" Vector__XXX
 SG_ EmsCtrl : 0|8@1+ (1,0) [0|255] "" Vector__XXX

BO_ 2566905121 MCU_ASDI: 178 MCU
 SG_ TwUseFlow4 : 1408|16@1+ (1,0) [0|65535] "" Vector__XXX
 SG_ TwUseFlow3 : 1392|16@1+ (1,0) [0|65535] "" Vector__XXX
 SG_ TwUseFlow2 : 1376|16@1+ (1,0) [0|65535] "" Vector__XXX
 SG_ TwUseFlow1 : 1360|16@1+ (1,0) [0|65535] "" Vector__XXX
 SG_ TwUseFlow0 : 1344|16@1+ (1,0) [0|65535] "" Vector__XXX
 SG_ TwSetFlow4 : 1328|16@1+ (1,0) [0|65535] "" Vector__XXX
 SG_ TwSetFlow3 : 1312|16@1+ (1,0) [0|65535] "" Vector__XXX
 SG_ TwSetFlow2 : 1296|16@1+ (1,0) [0|65535] "" Vector__XXX
 SG_ TwSetFlow1 : 1280|16@1+ (1,0) [0|65535] "" Vector__XXX
 SG_ TwSetFlow0 : 1264|16@1+ (1,0) [0|65535] "" Vector__XXX
 SG_ TwMinFlowAtt4 : 1248|16@1+ (1,0) [0|65535] "" Vector__XXX
 SG_ TwMinFlowAtt3 : 1232|16@1+ (1,0) [0|65535] "" Vector__XXX
 SG_ TwMinFlowAtt2 : 1216|16@1+ (1,0) [0|65535] "" Vector__XXX
 SG_ TwMinFlowAtt1 : 1200|16@1+ (1,0) [0|65535] "" Vector__XXX
 SG_ TwMinFlowAtt0 : 1184|16@1+ (1,0) [0|65535] "" Vector__XXX
 SG_ TwMaxFlowAtt4 : 1168|16@1+ (1,0) [0|65535] "" Vector__XXX
 SG_ TwMaxFlowAtt3 : 1152|16@1+ (1,0) [0|65535] "" Vector__XXX
 SG_ TwMaxFlowAtt2 : 1136|16@1+ (1,0) [0|65535] "" Vector__XXX
 SG_ TwMaxFlowAtt1 : 1120|16@1+ (1,0) [0|65535] "" Vector__XXX
 SG_ TwMaxFlowAtt0 : 1104|16@1+ (1,0) [0|65535] "" Vector__XXX
 SG_ TwMaxFlowPmp4 : 1088|16@1+ (1,0) [0|65535] "" Vector__XXX
 SG_ TwMaxFlowPmp3 : 1072|16@1+ (1,0) [0|65535] "" Vector__XXX
 SG_ TwMaxFlowPmp2 : 1056|16@1+ (1,0) [0|65535] "" Vector__XXX
 SG_ TwMaxFlowPmp1 : 1040|16@1+ (1,0) [0|65535] "" Vector__XXX
 SG_ TwMaxFlowPmp0 : 1024|16@1+ (1,0) [0|65535] "" Vector__XXX
 SG_ TwPrs4 : 1008|16@1+ (1,0) [0|65535] "" Vector__XXX
 SG_ TwPrs3 : 992|16@1+ (1,0) [0|65535] "" Vector__XXX
 SG_ TwPrs2 : 976|16@1+ (1,0) [0|65535] "" Vector__XXX
 SG_ TwPrs1 : 960|16@1+ (1,0) [0|65535] "" Vector__XXX
 SG_ TwPrs0 : 944|16@1+ (1,0) [0|65535] "" Vector__XXX
 SG_ TwRpm4 : 928|16@1+ (1,0) [0|65535] "" Vector__XXX
 SG_ TwRpm3 : 912|16@1+ (1,0) [0|65535] "" Vector__XXX
 SG_ TwRpm2 : 896|16@1+ (1,0) [0|65535] "" Vector__XXX
 SG_ TwRpm1 : 880|16@1+ (1,0) [0|65535] "" Vector__XXX
 SG_ TwRpm0 : 864|16@1+ (1,0) [0|65535] "" Vector__XXX
 SG_ Tw4BrkrBtnType : 853|2@1+ (1,0) [0|3] "" Vector__XXX
 SG_ Tw4TwoPmpOpt : 852|1@1+ (1,0) [0|1] "" Vector__XXX
 SG_ Tw4SelAttNo : 849|3@1+ (1,0) [0|7] "" Vector__XXX
 SG_ Tw4SelAttType : 848|1@1+ (1,0) [0|1] "" Vector__XXX
 SG_ Tw3BrkrBtnType : 837|2@1+ (1,0) [0|3] "" Vector__XXX
 SG_ Tw3TwoPmpOpt : 836|1@1+ (1,0) [0|1] "" Vector__XXX
 SG_ Tw3SelAttNo : 833|3@1+ (1,0) [0|7] "" Vector__XXX
 SG_ Tw3SelAttType : 832|1@1+ (1,0) [0|1] "" Vector__XXX
 SG_ Tw2BrkrBtnType : 821|2@1+ (1,0) [0|3] "" Vector__XXX
 SG_ Tw2TwoPmpOpt : 820|1@1+ (1,0) [0|1] "" Vector__XXX
 SG_ Tw2SelAttNo : 817|3@1+ (1,0) [0|7] "" Vector__XXX
 SG_ Tw2SelAttType : 816|1@1+ (1,0) [0|1] "" Vector__XXX
 SG_ Tw1BrkrBtnType : 805|2@1+ (1,0) [0|3] "" Vector__XXX
 SG_ Tw1TwoPmpOpt : 804|1@1+ (1,0) [0|1] "" Vector__XXX
 SG_ Tw1SelAttNo : 801|3@1+ (1,0) [0|7] "" Vector__XXX
 SG_ Tw1SelAttType : 800|1@1+ (1,0) [0|1] "" Vector__XXX
 SG_ Tw0BrkrBtnType : 789|2@1+ (1,0) [0|3] "" Vector__XXX
 SG_ Tw0TwoPmpOpt : 788|1@1+ (1,0) [0|1] "" Vector__XXX
 SG_ Tw0SelAttNo : 785|3@1+ (1,0) [0|7] "" Vector__XXX
 SG_ Tw0SelAttType : 784|1@1+ (1,0) [0|1] "" Vector__XXX
 SG_ OwUseFlow4 : 768|16@1+ (1,0) [0|65535] "" Vector__XXX
 SG_ OwUseFlow3 : 752|16@1+ (1,0) [0|65535] "" Vector__XXX
 SG_ OwUseFlow2 : 736|16@1+ (1,0) [0|65535] "" Vector__XXX
 SG_ OwUseFlow1 : 720|16@1+ (1,0) [0|65535] "" Vector__XXX
 SG_ OwUseFlow0 : 704|16@1+ (1,0) [0|65535] "" Vector__XXX
 SG_ OwSetFlow4 : 688|16@1+ (1,0) [0|65535] "" Vector__XXX
 SG_ OwSetFlow3 : 672|16@1+ (1,0) [0|65535] "" Vector__XXX
 SG_ OwSetFlow2 : 656|16@1+ (1,0) [0|65535] "" Vector__XXX
 SG_ OwSetFlow1 : 640|16@1+ (1,0) [0|65535] "" Vector__XXX
 SG_ OwSetFlow0 : 624|16@1+ (1,0) [0|65535] "" Vector__XXX
 SG_ OwMinFlowAtt4 : 608|16@1+ (1,0) [0|65535] "" Vector__XXX
 SG_ OwMinFlowAtt3 : 592|16@1+ (1,0) [0|65535] "" Vector__XXX
 SG_ OwMinFlowAtt2 : 576|16@1+ (1,0) [0|65535] "" Vector__XXX
 SG_ OwMinFlowAtt1 : 560|16@1+ (1,0) [0|65535] "" Vector__XXX
 SG_ OwMinFlowAtt0 : 544|16@1+ (1,0) [0|65535] "" Vector__XXX
 SG_ OwMaxFlowAtt4 : 528|16@1+ (1,0) [0|65535] "" Vector__XXX
 SG_ OwMaxFlowAtt3 : 512|16@1+ (1,0) [0|65535] "" Vector__XXX
 SG_ OwMaxFlowAtt2 : 496|16@1+ (1,0) [0|65535] "" Vector__XXX
 SG_ OwMaxFlowAtt1 : 480|16@1+ (1,0) [0|65535] "" Vector__XXX
 SG_ OwMaxFlowAtt0 : 464|16@1+ (1,0) [0|65535] "" Vector__XXX
 SG_ OwMaxFlowPmp4 : 448|16@1+ (1,0) [0|65535] "" Vector__XXX
 SG_ OwMaxFlowPmp3 : 432|16@1+ (1,0) [0|65535] "" Vector__XXX
 SG_ OwMaxFlowPmp2 : 416|16@1+ (1,0) [0|65535] "" Vector__XXX
 SG_ OwMaxFlowPmp1 : 400|16@1+ (1,0) [0|65535] "" Vector__XXX
 SG_ OwMaxFlowPmp0 : 384|16@1+ (1,0) [0|65535] "" Vector__XXX
 SG_ OwPrs4 : 368|16@1+ (1,0) [0|65535] "" Vector__XXX
 SG_ OwPrs3 : 352|16@1+ (1,0) [0|65535] "" Vector__XXX
 SG_ OwPrs2 : 336|16@1+ (1,0) [0|65535] "" Vector__XXX
 SG_ OwPrs1 : 320|16@1+ (1,0) [0|65535] "" Vector__XXX
 SG_ OwPrs0 : 304|16@1+ (1,0) [0|65535] "" Vector__XXX
 SG_ OwRpm4 : 288|16@1+ (1,0) [0|65535] "" Vector__XXX
 SG_ OwRpm3 : 272|16@1+ (1,0) [0|65535] "" Vector__XXX
 SG_ OwRpm2 : 256|16@1+ (1,0) [0|65535] "" Vector__XXX
 SG_ OwRpm1 : 240|16@1+ (1,0) [0|65535] "" Vector__XXX
 SG_ OwRpm0 : 224|16@1+ (1,0) [0|65535] "" Vector__XXX
 SG_ RttCurStep : 220|4@1+ (1,0) [0|15] "" Vector__XXX
 SG_ TwCurStep : 216|4@1+ (1,0) [0|15] "" Vector__XXX
 SG_ Ow4BrkrBtnType : 213|2@1+ (1,0) [0|3] "" Vector__XXX
 SG_ Ow4TwoPmpOpt : 212|1@1+ (1,0) [0|1] "" Vector__XXX
 SG_ Ow4SelAttNo : 209|3@1+ (1,0) [0|7] "" Vector__XXX
 SG_ Ow4SelAttType : 208|1@1+ (1,0) [0|1] "" Vector__XXX
 SG_ OwCurStep : 200|4@1+ (1,0) [0|15] "" Vector__XXX
 SG_ Ow3BrkrBtnType : 197|2@1+ (1,0) [0|3] "" Vector__XXX
 SG_ Ow3TwoPmpOpt : 196|1@1+ (1,0) [0|1] "" Vector__XXX
 SG_ Ow3SelAttNo : 193|3@1+ (1,0) [0|7] "" Vector__XXX
 SG_ Ow3SelAttType : 192|1@1+ (1,0) [0|1] "" Vector__XXX
 SG_ Ow2BrkrBtnType : 181|2@1+ (1,0) [0|3] "" Vector__XXX
 SG_ Ow2TwoPmpOpt : 180|1@1+ (1,0) [0|1] "" Vector__XXX
 SG_ Ow2SelAttNo : 177|3@1+ (1,0) [0|7] "" Vector__XXX
 SG_ Ow2SelAttType : 176|1@1+ (1,0) [0|1] "" Vector__XXX
 SG_ Ow1BrkrBtnType : 165|2@1+ (1,0) [0|3] "" Vector__XXX
 SG_ Ow1TwoPmpOpt : 164|1@1+ (1,0) [0|1] "" Vector__XXX
 SG_ Ow1SelAttNo : 161|3@1+ (1,0) [0|7] "" Vector__XXX
 SG_ Ow1SelAttType : 160|1@1+ (1,0) [0|1] "" Vector__XXX
 SG_ Ow0BrkrBtnType : 149|2@1+ (1,0) [0|3] "" Vector__XXX
 SG_ Ow0TwoPmpOpt : 148|1@1+ (1,0) [0|1] "" Vector__XXX
 SG_ Ow0SelAttNo : 145|3@1+ (1,0) [0|7] "" Vector__XXX
 SG_ Ow0SelAttType : 144|1@1+ (1,0) [0|1] "" Vector__XXX
 SG_ MaxFlow : 128|16@1+ (1,0) [0|65535] "" Vector__XXX
 SG_ MinFlow : 112|16@1+ (1,0) [0|65535] "" Vector__XXX
 SG_ MaxPrsTw : 96|16@1+ (1,0) [0|65535] "" Vector__XXX
 SG_ MinPrsTw : 80|16@1+ (1,0) [0|65535] "" Vector__XXX
 SG_ MaxPrsOw : 64|16@1+ (1,0) [0|65535] "" Vector__XXX
 SG_ MinPrsOw : 48|16@1+ (1,0) [0|65535] "" Vector__XXX
 SG_ MaxSpd : 32|16@1+ (1,0) [0|65535] "" Vector__XXX
 SG_ MinSpd : 16|16@1+ (1,0) [0|65535] "" Vector__XXX
 SG_ SelAttTw : 3|3@1+ (1,0) [0|7] "" Vector__XXX
 SG_ SelAttOw : 0|3@1+ (1,0) [0|7] "" Vector__XXX

BO_ 2566905377 MCU_FUDI: 44 MCU
 SG_ PSmartMd : 320|32@1+ (1,0) [0|4294967295] "liters" Vector__XXX
 SG_ TotFuelUsed : 288|32@1+ (0.5,0) [0|4294967295] "liters" Vector__XXX
 SG_ LiftMd : 256|32@1+ (1,0) [0|4294967295] "liters" Vector__XXX
 SG_ TrvlStd : 224|32@1+ (1,0) [0|4294967295] "liters" Vector__XXX
 SG_ TrvlPow : 192|32@1+ (1,0) [0|4294967295] "liters" Vector__XXX
 SG_ Idle : 160|32@1+ (1,0) [0|4294967295] "liters" Vector__XXX
 SG_ AutoIdle : 128|32@1+ (1,0) [0|4294967295] "liters" Vector__XXX
 SG_ EcnMd : 96|32@1+ (1,0) [0|4294967295] "liters" Vector__XXX
 SG_ StdMd : 64|32@1+ (1,0) [0|4294967295] "liters" Vector__XXX
 SG_ PowMd : 32|32@1+ (1,0) [0|4294967295] "liters" Vector__XXX
 SG_ PowPlusMd : 0|32@1+ (1,0) [0|4294967295] "liters" Vector__XXX

BO_ 2566905633 MCU_UHDI: 136 MCU
 SG_ AcptPrsAbove2600 : 1056|32@1+ (1,0) [0|4294967295] "minutes" Vector__XXX
 SG_ AcptPrs21002500 : 1024|32@1+ (1,0) [0|4294967295] "minutes" Vector__XXX
 SG_ AcptPrs16002000 : 992|32@1+ (1,0) [0|4294967295] "minutes" Vector__XXX
 SG_ AcptPrs10001500 : 960|32@1+ (1,0) [0|4294967295] "minutes" Vector__XXX
 SG_ AcptPrsBelow900 : 928|32@1+ (1,0) [0|4294967295] "minutes" Vector__XXX
 SG_ HydOilTmpAbove16 : 896|32@1+ (1,0) [0|4294967295] "minutes" Vector__XXX
 SG_ HydOilTmp11to15 : 864|32@1+ (1,0) [0|4294967295] "minutes" Vector__XXX
 SG_ HydOilTmp5to10 : 832|32@1+ (1,0) [0|4294967295] "minutes" Vector__XXX
 SG_ EvaporatorTmpBelow4 : 800|32@1+ (1,0) [0|4294967295] "minutes" Vector__XXX
 SG_ PSmartMd : 768|32@1+ (1,0) [0|4294967295] "minutes" Vector__XXX
 SG_ TotOprHr : 736|32@1+ (1,0) [0|4294967295] "minutes" Vector__XXX
 SG_ CoolTempAbove106 : 704|32@1+ (1,0) [0|4294967295] "minutes" Vector__XXX
 SG_ CoolTemp101105 : 672|32@1+ (1,0) [0|4294967295] "minutes" Vector__XXX
 SG_ CoolTemp96100 : 640|32@1+ (1,0) [0|4294967295] "minutes" Vector__XXX
 SG_ CoolTemp9195 : 608|32@1+ (1,0) [0|4294967295] "minutes" Vector__XXX
 SG_ CoolTemp8190 : 576|32@1+ (1,0) [0|4294967295] "minutes" Vector__XXX
 SG_ CoolTempBelow80 : 544|32@1+ (1,0) [0|4294967295] "minutes" Vector__XXX
 SG_ HydOilTmpAbove96 : 512|32@1+ (1,0) [0|4294967295] "minutes" Vector__XXX
 SG_ HydOilTmp9195 : 480|32@1+ (1,0) [0|4294967295] "minutes" Vector__XXX
 SG_ HydOilTmp8190 : 448|32@1+ (1,0) [0|4294967295] "minutes" Vector__XXX
 SG_ HydOilTmp7180 : 416|32@1+ (1,0) [0|4294967295] "minutes" Vector__XXX
 SG_ HydOilTmp5170 : 384|32@1+ (1,0) [0|4294967295] "minutes" Vector__XXX
 SG_ HydOilTmpBelow50 : 352|32@1+ (1,0) [0|4294967295] "minutes" Vector__XXX
 SG_ TwMd : 320|32@1+ (1,0) [0|4294967295] "minutes" Vector__XXX
 SG_ BrkrMd : 288|32@1+ (1,0) [0|4294967295] "minutes" Vector__XXX
 SG_ LiftMd : 256|32@1+ (1,0) [0|4294967295] "minutes" Vector__XXX
 SG_ TrvlStd : 224|32@1+ (1,0) [0|4294967295] "minutes" Vector__XXX
 SG_ TrvlPow : 192|32@1+ (1,0) [0|4294967295] "minutes" Vector__XXX
 SG_ Idle : 160|32@1+ (1,0) [0|4294967295] "minutes" Vector__XXX
 SG_ AutoIdle : 128|32@1+ (1,0) [0|4294967295] "minutes" Vector__XXX
 SG_ EcnMd : 96|32@1+ (1,0) [0|4294967295] "minutes" Vector__XXX
 SG_ StdMd : 64|32@1+ (1,0) [0|4294967295] "minutes" Vector__XXX
 SG_ PowMd : 32|32@1+ (1,0) [0|4294967295] "minutes" Vector__XXX
 SG_ PowPlusMd : 0|32@1+ (1,0) [0|4294967295] "minutes" Vector__XXX

BO_ 2566905889 MCU_RTFI: 14 MCU
 SG_ Afc7 : 96|16@1+ (1,0) [0|65535] "" Vector__XXX
 SG_ Afc6 : 80|16@1+ (1,0) [0|65535] "" Vector__XXX
 SG_ Afc5 : 64|16@1+ (1,0) [0|65535] "" Vector__XXX
 SG_ Afc4 : 48|16@1+ (1,0) [0|65535] "" Vector__XXX
 SG_ Afc3 : 32|16@1+ (1,0) [0|65535] "" Vector__XXX
 SG_ Afc2 : 16|16@1+ (1,0) [0|65535] "" Vector__XXX
 SG_ Afc1 : 0|16@1+ (1,0) [0|65535] "" Vector__XXX

BO_ 2566906145 MCU_FLI: 14 MCU
 SG_ RealTimeFailNCdFmi : 96|16@1+ (1,0) [0|65535] "" Vector__XXX
 SG_ RealTimeFail6CdFmi : 80|16@1+ (1,0) [0|65535] "" Vector__XXX
 SG_ RealTimeFail5CdFmi : 64|16@1+ (1,0) [0|65535] "" Vector__XXX
 SG_ RealTimeFail4CdFmi : 48|16@1+ (1,0) [0|65535] "" Vector__XXX
 SG_ RealTimeFail3CdFmi : 32|16@1+ (1,0) [0|65535] "" Vector__XXX
 SG_ RealTimeFail2CdFmi : 16|16@1+ (1,0) [0|65535] "" Vector__XXX
 SG_ RealTimeFail1CdFmi : 0|16@1+ (1,0) [0|65535] "" Vector__XXX

BO_ 2566906401 MCU_ARTFI: 250 MCU

BO_ 2566906657 MCU_TSS: 8 MCU
 SG_ SecSt : 32|2@1+ (1,0) [0|3] "" Vector__XXX
 SG_ TmsSecCode : 0|32@1+ (1,0) [0|4294967295] "" Vector__XXX

BO_ 2566907169 MCU_VSWVER: 250 MCU
 SG_ McuSwVerYear : 48|8@1+ (1,1985) [1985|2235] "year" Vector__XXX
 SG_ McuSwVerDay : 40|8@1+ (0.25,0) [0|62.5] "days" Vector__XXX
 SG_ McuSwVerMonth : 32|8@1+ (1,0) [0|250] "month" Vector__XXX
 SG_ McuSwVer : 0|32@1+ (1,0) [0|4294967295] "ASCII" Vector__XXX

BO_ 2566907681 MCU_ECOGI: 15 MCU
 SG_ IccoFunCrcmdScore : 112|8@1+ (1,0) [0|250] "" Vector__XXX
 SG_ UnssHydReliefScore : 104|8@1+ (1,0) [0|250] "" Vector__XXX
 SG_ InIntentBrkPreventScore : 96|8@1+ (1,0) [0|250] "" Vector__XXX
 SG_ EmgStpPreventScore : 88|8@1+ (1,0) [0|250] "" Vector__XXX
 SG_ EgMdDnRcmdScore : 80|8@1+ (1,0) [0|250] "" Vector__XXX
 SG_ LckUpRcmdScore : 72|8@1+ (1,0) [0|250] "" Vector__XXX
 SG_ GrNeutRpmUpScore : 64|8@1+ (1,0) [0|250] "" Vector__XXX
 SG_ IdlePrvtScore : 56|8@1+ (1,0) [0|250] "" Vector__XXX
 SG_ ManGrMaxSpdRcmdScore : 48|8@1+ (1,0) [0|250] "" Vector__XXX
 SG_ Auto14RcmdScore : 40|8@1+ (1,0) [0|250] "" Vector__XXX
 SG_ LisVhcSpdSetDnChngRcmdScore : 32|8@1+ (1,0) [0|250] "" Vector__XXX
 SG_ LisVhcSpdSetUpChngRcmdScore : 24|8@1+ (1,0) [0|250] "" Vector__XXX
 SG_ LisFunCrcmdScore : 16|8@1+ (1,0) [0|250] "" Vector__XXX
 SG_ EcoGudCtrl : 0|6@1+ (1,0) [0|63] "" Vector__XXX

CM_ BO_ 2566902305 "Filter & Oil Used Hour Information";
CM_ SG_ 2566902305 AirClnOutFiltUsedHr "Air Cleaner Outer Filter Used Hour";
CM_ SG_ 2566902305 AirClnInFiltUsedHr "Air Cleaner Inner Filter Used Hour";
CM_ SG_ 2566902305 PmpDrvAirCtrgHr "PumpDriveAirCartridgeHour";
CM_ SG_ 2566902305 PmpDrvOilHr "PumpDriveOilHour";
CM_ SG_ 2566902305 HstFiltHr "HSTFilterHour";
CM_ SG_ 2566902305 AxleOilFiltHr "AxleOilFilterHour";
CM_ SG_ 2566902305 AtsSparkPlugHr "ATSSparkPlugHour";
CM_ SG_ 2566902305 EgCrkcaseBreatherElementHr "EngineCrankcaseBreatherElementHour";
CM_ SG_ 2566902305 AirCndFiltInHr "AirConditionerFilter(Inner)Hour";
CM_ SG_ 2566902305 AirCndFiltOutHr "AirConditionerFilter(Outer)Hour";
CM_ SG_ 2566902305 EgOilCtrCleanerFiltHr "EngineOilCentrifugalCleanerFilterHour";
CM_ SG_ 2566902305 DefBreatherFiltHr "DEF(AdBlue)BreatherFilterHour";
CM_ SG_ 2566902305 DefFiltHr "DEF(AdBlue)FilterHour";
CM_ SG_ 2566902305 OilBathPrecleanerHr "OilBathedPrecleanerHour";
CM_ SG_ 2566902305 DefHr "DEFUsedHour";
CM_ SG_ 2566902305 AxleOilHr "AxleOilUsedHour";
CM_ SG_ 2566902305 TrmsOilFiltHr "TransmissionOilFilterUsedHour";
CM_ SG_ 2566902305 TrmsOilHr "TransmissionOilUsedHour";
CM_ SG_ 2566902305 BreatherOilSepFiltHr "BreatherOilSeparatorFilterUsedHour";
CM_ SG_ 2566902305 DpfHr "DPFFilterUsedHour";
CM_ SG_ 2566902305 CoolHr "CoolantWaterUsedHour";
CM_ SG_ 2566902305 HydOilHr "Hyd.OilUsedHour";
CM_ SG_ 2566902305 EgOilHr "EngineOilUsedHour";
CM_ SG_ 2566902305 PilotFiltHr "PilotFilterUsedHour";
CM_ SG_ 2566902305 RetFiltHr "ReturnFilter(Hyd.OilFilter)UsedHour";
CM_ SG_ 2566902305 EgOilFiltHr "EngineOilFilterUsedHour";
CM_ SG_ 2566902305 AirCleanerHr "AirCleanerUsedHour";
CM_ SG_ 2566902305 FuleFiltHr "FuelFilterUsedHour";
CM_ BO_ 2566902561 "Filter & Oil Change Period Hour Information";
CM_ SG_ 2566902561 AirClnOutFilt "Period Info Data; Air Cleaner Outer Filter";
CM_ SG_ 2566902561 AirClnInFilt "Period Info Data; Air Cleaner Inner Filter";
CM_ SG_ 2566902561 PmpDrvAirCtrgPrd "PeriodInfoData;PumpDriveAirCartridge";
CM_ SG_ 2566902561 PmpDrvOilPrd "PeriodInfoData;PumpDriveOil";
CM_ SG_ 2566902561 HstFiltPrd "PeriodInfoData;HSTFilter";
CM_ SG_ 2566902561 AxleOilFiltPrd "PeriodInfoData;AxleOilFilter";
CM_ SG_ 2566902561 AtsSparkPlugPrd "PeriodInfoData;ATSSparkPlug";
CM_ SG_ 2566902561 EgCrkcaseBreatherElementPrd "PeriodInfoData;EngineCrankcaseBreatherElement";
CM_ SG_ 2566902561 AirCndFiltInPrd "PeriodInfoData;AirConditionerFilter(Inner)";
CM_ SG_ 2566902561 AirCndFiltOutPrd "PeriodInfoData;AirConditionerFilter(Outer)";
CM_ SG_ 2566902561 EgOilCtrCleanerFiltPrd "PeriodInfoData;EngineOilCentrifugalCleanerFilter";
CM_ SG_ 2566902561 DefBreatherFiltPrd "PeriodInfoData;DEF(AdBlue)BreatherFilter";
CM_ SG_ 2566902561 DefFiltPrd "PeriodInfoData;DEF(AdBlue)Filter";
CM_ SG_ 2566902561 OilBathPrecleanerPrd "PeriodInfoData;OilBathedPrecleaner";
CM_ SG_ 2566902561 DefPrd "PeriodInfoData;DEF";
CM_ SG_ 2566902561 AxleOilPrd "PeriodInfoData;AxleOil";
CM_ SG_ 2566902561 TrmsOilFiltPrd "PeriodInfoData;TransmissionOilFilter";
CM_ SG_ 2566902561 TrmsOilPrd "PeriodInfoData;TransmissionOil";
CM_ SG_ 2566902561 BreatherOilSepFiltPrd "PeriodInfoData;BreatherOilSeparatorFilter";
CM_ SG_ 2566902561 DpfPrd "PeriodInfoData;DPFFilter";
CM_ SG_ 2566902561 CoolPrd "PeriodInfoData;CoolantWater";
CM_ SG_ 2566902561 HydOilPrd "PeriodInfoData;Hyd.Oil";
CM_ SG_ 2566902561 EgOilPrd "PeriodInfoData;EngineOil";
CM_ SG_ 2566902561 PilotFiltPrd "PeriodInfoData;PilotFilter";
CM_ SG_ 2566902561 RetFiltPrd "PeriodInfoData;Hyd.OilFilter";
CM_ SG_ 2566902561 EgOilFiltPrd "PeriodInfoData;EngineOilFilter";
CM_ SG_ 2566902561 AirCleanerPrd "PeriodInfoData;AirCleaner";
CM_ SG_ 2566902561 FuleFiltPrd "PeriodInfoData;FuelFilter";
CM_ BO_ 2566902817 "Excavator Analog Sensor Information";
CM_ SG_ 2566902817 PmpDrvOilTmp "Pump Drive Oil Temperature";
CM_ SG_ 2566902817 EvaporatorTmp "[Excavator] Evaporator Temperator";
CM_ SG_ 2566902817 FanSpd "[Excavator] FAN Speed";
CM_ SG_ 2566902817 BladeFanPchSsVlt "[Excavator]BladeFANPitchSensorVoltage";
CM_ SG_ 2566902817 RamLckPrs "[Excavator]RAMLOCKPRESSURESENSOR";
CM_ SG_ 2566902817 TrailerDnPilotPrs "[Excavator]TrailerDownPilotPressure";
CM_ SG_ 2566902817 BoomHead2Prs "[Excavator]BOOMHEAD2PRESSURESENSOR(Weighing)";
CM_ SG_ 2566902817 ArmRodPrs "[Excavator]ARMRODPRESSURESENSOR(Weighing)";
CM_ SG_ 2566902817 ArmHEadPrs "[Excavator]ARMHEADPRESSURESENSOR(Weighing)";
CM_ SG_ 2566902817 BoodRodPrs "[Excavator]BOOMRODPRESSURESENSOR(Weighing)";
CM_ SG_ 2566902817 BoomHeadPrs "[Excavator]BOOMHEADPRESSURESENSOR(Weighing)";
CM_ SG_ 2566902817 BckRodPrsSs "Bucket Rod Pressure Sensor";
CM_ SG_ 2566902817 BckHeadPrsSs "Bucket Head Pressure Sensor ";
CM_ SG_ 2566902817 TpsVlt "[Excavator]TPSVoltage(Mechanical Engine)";
CM_ SG_ 2566902817 PchAng "[Excavator]Pitch Angle";
CM_ SG_ 2566902817 RoolAng "[Excavator]Rool Angle";
CM_ SG_ 2566902817 TmsSecVlt "TMSConnectionVoltage";
CM_ SG_ 2566902817 VhcTrvlSpdSsFreq "VehicleTravelSpeedSensor";
CM_ SG_ 2566902817 AirClnDiffPrsSs2 "Air Cleaner Differential Pressure Sensor 2";
CM_ SG_ 2566902817 FanClutchSpdSsFdbkSig "Fan Clutch Speed Sensor Feedback Signal";
CM_ SG_ 2566902817 FlwCtrlLeverRh "[Excavator]RightJoystick썸Voltage(FlowControlLeverRH)";
CM_ SG_ 2566902817 FlwCtrlLeverLh "[Excavator]LeftJoystick썸Voltage(FlowControlLeverLH)";
CM_ SG_ 2566902817 FlwCtrlAddLeverLh "[Excavator]LeftJoystickElectric Steering썸Voltage(FlowControlAddedLeverLH)";
CM_ SG_ 2566902817 AirClnDiffPrsSs1 "Air Cleaner Differential Pressure Sensor 1";
CM_ SG_ 2566902817 BatVlt "BatteryVoltage[Default]";
CM_ SG_ 2566902817 AltVlt "AlternatorVoltage";
CM_ SG_ 2566902817 DzLvrOutVlt "Dozer Lever Output Volatage";
CM_ SG_ 2566902817 WirelessChgStLmpVlt "Wireless Charging Status Lamp Volatage";
CM_ SG_ 2566902817 CbElvLvrVlt "[Excavator] Cabin Elevating Lever Voltage";
CM_ SG_ 2566902817 HydOilTmp "HydraulicTemperature[Default]";
CM_ SG_ 2566902817 MecaCoolTmp "[Excavator]CoolantTemperature(Mechanical Engine)";
CM_ SG_ 2566902817 GndSawDnSsPrs "[Excavator]GroundSAWDownPRESSURESENSOR";
CM_ SG_ 2566902817 GndSawUpSsPrs "[Excavator]GroundSAWUpPRESSURESENSOR";
CM_ SG_ 2566902817 WifSsVlt "WIFSensor(WIFSensor)Voltage";
CM_ SG_ 2566902817 FuelLv "FuelLevel[Default]";
CM_ SG_ 2566902817 FuelLvAddFuelTnk "[Excavator]FuelLevelforAdditionalFuelTank";
CM_ SG_ 2566902817 AcpSsPrs "[Excavator]ACPSensorPressure";
CM_ SG_ 2566902817 AccPdlVlt "AccelPedalVoltage(Wheel)";
CM_ SG_ 2566902817 EgCtrlDialVlt "[Excavator]EngineControlDialVoltage[Default]";
CM_ SG_ 2566902817 LsPrs "[Excavator]LSPressure";
CM_ SG_ 2566902817 P3NegaconPrs "[Excavator]P3NegaconPressure";
CM_ SG_ 2566902817 RrNegaconPrs "[Excavator]RearNegaconPressure";
CM_ SG_ 2566902817 FrNegaconPrs "[Excavator]FrontNegaconPressure";
CM_ SG_ 2566902817 PilotTrvlPtPrs "[Excavator]PilotTravel(Pt)Pressure";
CM_ SG_ 2566902817 PilotWrkPaPrs "[Excavator]PilotWork(Pa)Pressure";
CM_ SG_ 2566902817 ArmLckPrs "[Excavator]ARMLOCKPRESSURE";
CM_ SG_ 2566902817 BckCrowdConfPrs "[Excavator]BUCKETCROWDCONF.PRESSURE";
CM_ SG_ 2566902817 ArmCrowdConfPrs "[Excavator]ARMCROWDCONF.PRESSURE";
CM_ SG_ 2566902817 BoomUpConfPrs "[Excavator]BOOMUPCONF.PRESSURE";
CM_ SG_ 2566902817 Opt3Prs "[Excavator]Opt3Pressure(ElectronicPump)";
CM_ SG_ 2566902817 Opt2Prs "[Excavator]Opt2Pressure(ElectronicPump)";
CM_ SG_ 2566902817 Opt1Prs "[Excavator]Opt1Pressure(ElectronicPump)";
CM_ SG_ 2566902817 SwgPrs "[Excavator]SwingPressure(ElectronicPump)";
CM_ SG_ 2566902817 TrvlLhPrs "[Excavator]LeftTravelPressure(ElectronicPump)";
CM_ SG_ 2566902817 TrvlRhPrs "[Excavator]RightTravelPressure(ElectronicPump)";
CM_ SG_ 2566902817 BckDumpPrs "[Excavator]BucketDumpPressure(ElectronicPump)";
CM_ SG_ 2566902817 BckCrowdPrs "[Excavator]BucketCrowdPressure(ElectronicPump)";
CM_ SG_ 2566902817 ArmOutPrs "[Excavator]ArmOutPressure(ElectronicPump)";
CM_ SG_ 2566902817 ArmInPrs "[Excavator]ArmInPressure(ElectronicPump)";
CM_ SG_ 2566902817 BoomDnPrs "[Excavator]BoomDownPressure(ElectronicPump)";
CM_ SG_ 2566902817 BoomUpPrs "[Excavator]BoomUpPressure(ElectronicPump)";
CM_ SG_ 2566902817 EmgStrPrs "[Excavator]EmergencySteeringSystemPressure";
CM_ SG_ 2566902817 Pmp3Ang "[Excavator]3rdPumpAngle(ElectronicPump)";
CM_ SG_ 2566902817 RRpmpAng "[Excavator]RearPumpAngle(ElectronicPump)";
CM_ SG_ 2566902817 FrPmpAng "[Excavator]FrontPumpAngle(ElectronicPump)";
CM_ SG_ 2566902817 FuelPrs "[Excavator]FuelPressure";
CM_ SG_ 2566902817 RcwStpVvPrs "[Excavator]RCWStopValvePressure";
CM_ SG_ 2566902817 Pmp3Prs "[Excavator]3rdPumpPressure";
CM_ SG_ 2566902817 BoomCylPrs "[Excavator]BoomCylinderPressure";
CM_ SG_ 2566902817 RrPmpPrs "[Excavator]RearPumpPressure";
CM_ SG_ 2566902817 FrPmpPrs "[Excavator]FrontPumpPressure";
CM_ BO_ 2566903073 "Excavator Analog Actuator Information";
CM_ SG_ 2566903073 FanClutchPwmOutSig "Fan Clutch PWM Output Signal";
CM_ SG_ 2566903073 EfanPwmOutSig "E-Fan PWM Output Signal";
CM_ SG_ 2566903073 CabDnEppr "[Excavator] Cabin Down EPPR";
CM_ SG_ 2566903073 CabRaiseEppr "[Excavator] Cabin Raise EPPR";
CM_ SG_ 2566903073 VariBladeFanEvc "[Excavator]VariableBladeFANEPPR";
CM_ SG_ 2566903073 BoomSwgCcwEvc "[Excavator]BOOMSWINGCCWEPPR";
CM_ SG_ 2566903073 BoomSwgCwEvc "[Excavator]BOOMSWINGCWEPPR";
CM_ SG_ 2566903073 TrvlPmpEvc "[Excavator]TRAVELPUMPEPPR";
CM_ SG_ 2566903073 Pmp3Evc "[Excavator]3rdPumpEPRR";
CM_ SG_ 2566903073 DzDnEvc "[Excavator]DOZERDOWNEPRR";
CM_ SG_ 2566903073 DzUpEvc "[Excavator]DOZERUPEPRR";
CM_ SG_ 2566903073 ArtiBoomDnEvc "[Excavator]Arti.BOOMDOWNEPPR";
CM_ SG_ 2566903073 ArtiBoomUpEvc "[Excavator]Arti.BOOMUPEPPR";
CM_ SG_ 2566903073 SwgLhEvc "[Excavator]SWINGLEFTEPPR";
CM_ SG_ 2566903073 SwgRhEvc "[Excavator]SWINGRIGHTEPPR";
CM_ SG_ 2566903073 TrvlLhRvsEvc "[Excavator]TRAVELLEFTREVERSEEPPR";
CM_ SG_ 2566903073 TrvlLhFwdEvc "[Excavator]TRAVELLEFTFORWARDEPPR";
CM_ SG_ 2566903073 TrvlRhRvsEvc "[Excavator]TRAVELRIGHTREVERSEEPPR";
CM_ SG_ 2566903073 TrvlRhFwdEvc "[Excavator]TRAVELRIGHTFORWARDEPPR";
CM_ SG_ 2566903073 BckDumpEvc "[Excavator]BUCKETDUMPEPPR";
CM_ SG_ 2566903073 BckCrowdEvc "[Excavator]BUCKETCROWDEPPR";
CM_ SG_ 2566903073 Arm2DumpEvc "[Excavator]ARM2DUMPEPPR";
CM_ SG_ 2566903073 Arm2CrowdEvc "[Excavator]ARM2CROWDEPPR";
CM_ SG_ 2566903073 Arm1DumpEvc "[Excavator]ARM1DUMPEPPR";
CM_ SG_ 2566903073 Arm1CrowdEvc "[Excavator]ARM1CROWDEPPR";
CM_ SG_ 2566903073 Boom2UpEvc "[Excavator]BOOM2UPEPPR";
CM_ SG_ 2566903073 Boom1DnEvc "[Excavator]BOOM1DOWNEPPR";
CM_ SG_ 2566903073 Boom1UpEvc "[Excavator]BOOM1UPEPPR";
CM_ SG_ 2566903073 ArmLckEvc "[Excavator]ARMLOCKEPPR";
CM_ SG_ 2566903073 BckCrowdConfEvc "[Excavator]BUCKETCROWDCONF.EPPR";
CM_ SG_ 2566903073 ArmCrowdConfEvc "[Excavator]ARMCROWDCONF.EPPR";
CM_ SG_ 2566903073 BoomUpConfEvc "[Excavator]BOOMUPCONF.EPPR";
CM_ SG_ 2566903073 BypassCutOffBEvc "[Excavator]BYPASSCUT-OFF(B)EPPR";
CM_ SG_ 2566903073 BypassCutOffAEvc "[Excavator]BYPASSCUT-OFF(A)EPPR";
CM_ SG_ 2566903073 Trvl2PmpCmbEvc "[Excavator]TravelIIPumpCombinationPressure Reducing Valve(Wheel)";
CM_ SG_ 2566903073 TrvlFwdEvc "[Excavator]TravelForwardProportional Pressure Reducing Valve(ElectronicPump)";
CM_ SG_ 2566903073 PrsCtrl2Evc "[Excavator]PressureControlProportional Pressure Reducing Valve2";
CM_ SG_ 2566903073 PrsCtrl1Evc "[Excavator]PressureControlProportional Pressure Reducing Valve1";
CM_ SG_ 2566903073 RttCcwEvc "[Excavator]RotatingProportional Pressure Reducing Valve(CCW)";
CM_ SG_ 2566903073 RttCwEvc "[Excavator]RotatingProportional Pressure Reducing Valve(CW)";
CM_ SG_ 2566903073 TwCloseEvc "[Excavator]2-wayProportional Pressure Reducing Valve(Close)";
CM_ SG_ 2566903073 TwOpenEvc "[Excavator]2-wayProportional Pressure Reducing Valve(Open)";
CM_ SG_ 2566903073 FlwCtrlEvc "[Excavator]FlowControlProportional Pressure Reducing Valve";
CM_ SG_ 2566903073 CoolFanEvc "CoolingFanProportional Pressure Reducing Valve";
CM_ SG_ 2566903073 PmpElecEvc "[Excavator]PumpProportional Pressure Reducing Valve(ElectronicPump)";
CM_ SG_ 2566903073 Pmp1Evc "[Excavator]PumpProportional Pressure Reducing Valve1";
CM_ BO_ 2566903329 "Excavator Digital Sensor Information";
CM_ SG_ 2566903329 PowerdStariwayProxSw "Powerd Stairway Proximity Switch";
CM_ SG_ 2566903329 KeySwAccSlave "Key Switch ACC (EPOS Slave)";
CM_ SG_ 2566903329 KeySwAccMaster "Key Switch ACC (EPOS Master)";
CM_ SG_ 2566903329 KeySwBrSlave "Key Switch BR (EPOS Slave)";
CM_ SG_ 2566903329 SeatBeltSw "Seat Belt Switch";
CM_ SG_ 2566903329 Efan3ErrorSt "E-Fan 3 Error State";
CM_ SG_ 2566903329 Efan2ErrorSt "E-Fan 2 Error State";
CM_ SG_ 2566903329 Efan1ErrorSt "E-Fan 1 Error State";
CM_ SG_ 2566903329 AgsSw "AGS Switch";
CM_ SG_ 2566903329 SwgLPltPrsSw "Swing Left Pilot Pressure Switch";
CM_ SG_ 2566903329 SwgRPltPrsSw "Swing Right Pilot Pressure Switch";
CM_ SG_ 2566903329 FineSwgSw "Fine Swing Switch";
CM_ SG_ 2566903329 CbLwPosSw "Cabin Lower Position Close Switch";
CM_ SG_ 2566903329 CbElvActSw "Cabin Elevating Activate Switch";
CM_ SG_ 2566903329 MainStRpmpPrsSw "MainSteeringPumpPressureSwitch";
CM_ SG_ 2566903329 GndSawInitSw "[Excavator]GroundSawinitialswitch";
CM_ SG_ 2566903329 FanErrSig "FanErrorSignal";
CM_ SG_ 2566903329 HydWakeUpSw "HydraulicWakeUpSwitch";
CM_ SG_ 2566903329 EmgStpSw "EmergencyStopSwitch";
CM_ SG_ 2566903329 HhVltChgSw "HighVoltageChargingSwitch";
CM_ SG_ 2566903329 PrkBrkPrsSw "ParkingBrakePressureSwitch";
CM_ SG_ 2566903329 RamLckRvsSw "RamLockReverseSwitch";
CM_ SG_ 2566903329 AirCompPrsSw "AirCompressorPressureSwitch";
CM_ SG_ 2566903329 Mg2DJoyTrigSw "2DMGJoystickTriggerSwitch";
CM_ SG_ 2566903329 KeySwBr "KeySwitchBR";
CM_ SG_ 2566903329 TwSwSelSw "2waySwitchingSelectSwitch";
CM_ SG_ 2566903329 DzOutSw "Dozer/OutriggerSwitch";
CM_ SG_ 2566903329 MrrHtSw "MirrorHeaterSwitch";
CM_ SG_ 2566903329 SwgAlignSw "SwingAlignSwitch";
CM_ SG_ 2566903329 MultiFuncSw "MultiFunctionSwitch";
CM_ SG_ 2566903329 AutoDigSw "AutoDiggingSwitch";
CM_ SG_ 2566903329 TrvlPmpHhSpdSw "TravelPumpHighSpeedSwitch";
CM_ SG_ 2566903329 DoorSw "DOORSswitch";
CM_ SG_ 2566903329 RrAxleRhHallSsSw "RearAxleRHHallSensorSwitch";
CM_ SG_ 2566903329 RrAxleLhHallSsSw "RearAxleLHHallSensorSwitch";
CM_ SG_ 2566903329 FrAxleHallSsSw "FrontAxleHallSensorSwitch";
CM_ SG_ 2566903329 QckCouplerRhSw "RightQuickCouplerSwitch";
CM_ SG_ 2566903329 QckCouplerLhSw "LeftQuickCouplerSwitch";
CM_ SG_ 2566903329 PowMdSw "PowerModeSwitch";
CM_ SG_ 2566903329 WrkMdSw "WorkModeSwitch";
CM_ SG_ 2566903329 AuxMdSelSw "AuxiliaryModeSelectSwitch";
CM_ SG_ 2566903329 SwgBrkRlsSw "SwingBrakeReleaseSwitch";
CM_ SG_ 2566903329 BrkrFltSw "BreakerFloatSwitch";
CM_ SG_ 2566903329 SwgPriSw "SwingPrioritySwitch";
CM_ SG_ 2566903329 RttCwSw "RotatingCWSwitch";
CM_ SG_ 2566903329 RttCcwSw "RotatingCCWSwitch";
CM_ SG_ 2566903329 WiperWasherSw "WiperWasherSwitch";
CM_ SG_ 2566903329 WiperContSw "WiperContinuousSwitch";
CM_ SG_ 2566903329 Wiper2StepSw "Wiper2StepSwitch";
CM_ SG_ 2566903329 Wiper1StepSw "Wiper1StepSwitch";
CM_ SG_ 2566903329 TmsSt "TMSConnectionStatus";
CM_ SG_ 2566903329 ArtiBoomPrsSw "Arti-BoomPressureSwitch";
CM_ SG_ 2566903329 CoolLvSw "CoolantLevelSwitch";
CM_ SG_ 2566903329 RttOprSw "RotatingOperatingSwitch";
CM_ SG_ 2566903329 TwCloseOprSw "2-WayCloseOperatingSwitch";
CM_ SG_ 2566903329 TwOpenOprSw "2-WayOpenOperatingSwitch";
CM_ SG_ 2566903329 RcwCloseSw "RCWCloseSwitch";
CM_ SG_ 2566903329 RcwOprSw "RCWActSwitch";
CM_ SG_ 2566903329 EmgEgStpSw "EngineEmergencyStopSwitch(EmergencyEngineStopSwitch)";
CM_ SG_ 2566903329 OwOptPdlPrsSw "OptPedalPressureSwitch(1way)";
CM_ SG_ 2566903329 SpcSw "SPCSwitch(SPCSwitch)";
CM_ SG_ 2566903329 IhbSw "InhibitSwitch(added-11.09.30)";
CM_ SG_ 2566903329 TrvlAlmSelSw "TravelAlarmSelectSwitch(added-11.07.28)";
CM_ SG_ 2566903329 SwgAlmSelSw "SwingAlarmSelectSwitch(added-11.07.28)";
CM_ SG_ 2566903329 EmgStrSw "EmergencySteeringSwitch";
CM_ SG_ 2566903329 HhBeamSw "HighBeamSwitch";
CM_ SG_ 2566903329 StpLmp "StopLamp(Wheel)";
CM_ SG_ 2566903329 AccPdlSw "AccelPedalSwitch(Wheel)";
CM_ SG_ 2566903329 BrkPrsSw "BrakePressureSwitch(Wheel)";
CM_ SG_ 2566903329 Cruise "Cruise(Wheel)";
CM_ SG_ 2566903329 EgOilPrsSw "EngineOilPressureSwitch";
CM_ SG_ 2566903329 WrkPxPrsSw "WorkPressureSwitch(Px)";
CM_ SG_ 2566903329 TrvlPyPrsSw "TravelPressureSwitch(Py)";
CM_ SG_ 2566903329 IgnSw "StartSwitch";
CM_ SG_ 2566903329 RamLckAutoSw "RamLockAutoSwitch";
CM_ SG_ 2566903329 PreHt "PreHeat";
CM_ SG_ 2566903329 WifWrn "WIFWarning";
CM_ SG_ 2566903329 SwgPrsSw "SwingPressureSwitch";
CM_ SG_ 2566903329 JoyPtnBhl "JoystickPattern(BHL)";
CM_ SG_ 2566903329 JoyPtnIso "JoystickPattern(ISO)";
CM_ SG_ 2566903329 RvsFanSw "ReverseFanSwitch";
CM_ SG_ 2566903329 TwOptPdlPrsSw "OptPedalPressureSwitch(2way)";
CM_ SG_ 2566903329 BrkOilPrsWrn "BrakeOilPressureWarning";
CM_ SG_ 2566903329 OwdWrnSelSw "OverloadWarningSelectSwitch";
CM_ SG_ 2566903329 RetFiltWrn "ReturnFilterClogging";
CM_ SG_ 2566903329 PilotFiltWrn "PilotFilterClogging";
CM_ SG_ 2566903329 AirCleanerWrn "AirCleanerWarning";
CM_ SG_ 2566903329 PilotCutOffSw "PilotCutOffSwitch";
CM_ SG_ 2566903329 ItgtBoomSw "BoomFloatSwitch-->Intelligent BoomSwitch";
CM_ SG_ 2566903329 OneTouchRedSpdSw "OneTouchReducingSpeedSwitch";
CM_ SG_ 2566903329 RamLckSw "RamLockSwitch(Wheel)";
CM_ SG_ 2566903329 PrkSw "ParkingSwitch(Wheel)";
CM_ SG_ 2566903329 AirCndSw "AirconSwitch";
CM_ SG_ 2566903329 JoyDirSelSw "JoystickForward Reverse TravelingSelect(Wheel)";
CM_ SG_ 2566903329 TrvlBwdSw "Reverse TravelingSwitch(Wheel)";
CM_ SG_ 2566903329 TrvlNtrlSw "NeutralSwitch(Wheel)";
CM_ SG_ 2566903329 TrvlFwdSw "ForwardSwitch(Wheel)";
CM_ SG_ 2566903329 HhSpdSelSw "HighSpeedSelectSwitch(Wheel)";
CM_ SG_ 2566903329 LwSpdSelSw "LowSpeedSelectSwitch(Wheel)";
CM_ SG_ 2566903329 InchingSelSw "InchingSelectSwitch(Wheel)";
CM_ SG_ 2566903329 QckCoupler "QuickCoupler";
CM_ SG_ 2566903329 TwSelSw "2-waySelectSwitch";
CM_ SG_ 2566903329 OnwWaySelSw "1-waySelectSwitch";
CM_ SG_ 2566903329 WrkLmpSw "WorkLampSwitch";
CM_ SG_ 2566903329 AutoTrvl2SpdSw "AutoTravelIISpeed(Crawler)";
CM_ SG_ 2566903329 Trvl2SpdSelSw "TravelIISpeedSelect(Crawler)";
CM_ SG_ 2566903329 TrvlSelSw "TravelSelectSwitch(Wheel)";
CM_ SG_ 2566903329 BrkrSw "BreakerActSwitch";
CM_ SG_ 2566903329 PwrMaxSw "PowerMaxSwitch";
CM_ SG_ 2566903329 Alt "Alternator";
CM_ BO_ 2566903585 "Excavator Digital Actuator Information";
CM_ SG_ 2566903585 SwgLoadRedSolR "Swing Load Reduction Solenoid (R)";
CM_ SG_ 2566903585 SwgLoadRedSolF "Swing Load Reduction Solenoid (F)";
CM_ SG_ 2566903585 OptPriSv "Option Priority S/V";
CM_ SG_ 2566903585 PmpDrvCoolSv "Pump Drive Cooling S/V";
CM_ SG_ 2566903585 SecondStarterRly "2nd Starter Relay";
CM_ SG_ 2566903585 FuelFilledLmp "Fuel-Filled Lamp";
CM_ SG_ 2566903585 ExtVocWarnSig "External Voice Warning Signal";
CM_ SG_ 2566903585 EtpRly "ETP Relay";
CM_ SG_ 2566903585 DesRunSig "DES Running Signal";
CM_ SG_ 2566903585 EngRunOutSig "Engine Running Output Signal";
CM_ SG_ 2566903585 AccRly "ACC Relay";
CM_ SG_ 2566903585 SelSv "Select S/V (Rotating <-> Elevating Cabin)";
CM_ SG_ 2566903585 ArmCrowdCutOffSv "Arm Crowd Cut Off S/V";
CM_ SG_ 2566903585 ArmDumpCutOffSv "Arm Dump Cut Off S/V";
CM_ SG_ 2566903585 EmgStrSv "EmergencySteeringSystem Solenoid";
CM_ SG_ 2566903585 TrvlRhPilotCutOffSv "[Excavator]TRAVEL_RHPILOT-CUTS/V";
CM_ SG_ 2566903585 GndSawMdChangeRly "[Excavator]GroundSawModeChangeRelay";
CM_ SG_ 2566903585 HvChgSig "HVChargingSignal";
CM_ SG_ 2566903585 FanPwmSig "FANPWMSignal";
CM_ SG_ 2566903585 TrkExpationSv "TrackExpationS/V";
CM_ SG_ 2566903585 HhVltMainRly "HighVoltageMainRelay";
CM_ SG_ 2566903585 HhVltPreChgRly "HighVoltagePrechargeRelay";
CM_ SG_ 2566903585 PilotBz "PilotBuzzer";
CM_ SG_ 2566903585 QckChgInd "QuickChargingIndicator";
CM_ SG_ 2566903585 QckChgRly "QuickChargingRelay";
CM_ SG_ 2566903585 NormChgInd "NormalChargingIndicator";
CM_ SG_ 2566903585 LwVltMainRly "LowVoltageMainRelay";
CM_ SG_ 2566903585 BoomSwgSelRly "BoomSwingSelectRelay";
CM_ SG_ 2566903585 PmpDeratSv "PumpDeratingS/V";
CM_ SG_ 2566903585 PrkBrkRly "ParkingBrakeRelay";
CM_ SG_ 2566903585 RvsLmpRly "ReverseLampRelay";
CM_ SG_ 2566903585 AirCompRly "AirCompressorRelay";
CM_ SG_ 2566903585 CabLmpRly "CabinLampRelay";
CM_ SG_ 2566903585 AvmWrnSig "AVMWarningSignal";
CM_ SG_ 2566903585 WrkLmpRly "WorkingLampRelay";
CM_ SG_ 2566903585 AirCondCompStpSig "A/CCompressorStopSignal";
CM_ SG_ 2566903585 Chmsl "CHMSL";
CM_ SG_ 2566903585 BoomSusRodSv "BoomSuspensionRodS/V";
CM_ SG_ 2566903585 BoomSusHedSv "BoomSuspensionHeadS/V";
CM_ SG_ 2566903585 MrrHt "MirrorHeater";
CM_ SG_ 2566903585 ClearLmp "ClearanceLamp";
CM_ SG_ 2566903585 HhHeadLmp "HighHeadLamp";
CM_ SG_ 2566903585 LwHeadLmp "LowHeadLamp";
CM_ SG_ 2566903585 FineSwgSv "FineSwingS/N";
CM_ SG_ 2566903585 TurnRhSigLmp "RightTurnSignalLamp";
CM_ SG_ 2566903585 TurnLhSigLmp "LeftTurnSignalLamp";
CM_ SG_ 2566903585 BeaconRly "BeaconRelay";
CM_ SG_ 2566903585 LightRly "LightRelay";
CM_ SG_ 2566903585 LmpRly "LampRelay";
CM_ SG_ 2566903585 RamLckSv "RAMLockS/V";
CM_ SG_ 2566903585 LwSpdTrvlSv "LowSpeedTravel Solenoid";
CM_ SG_ 2566903585 TrvlPmpHhSpd2Sv "TravelPumpHighSpeed2S/V";
CM_ SG_ 2566903585 TrvlPmpHhSpd1Sv "TravelPumpHighSpeed1S/V";
CM_ SG_ 2566903585 WiperWasherRly "WiperWasherRelay";
CM_ SG_ 2566903585 WiperRly "WiperRelay";
CM_ SG_ 2566903585 AutoShutOffRly "AutoShutOffRelay";
CM_ SG_ 2566903585 AirHtRly "AirHeaterRelay";
CM_ SG_ 2566903585 GlowPlugPreHhRly2 "GlowPlugPreHeatRelay2";
CM_ SG_ 2566903585 GlowPlugPreHhRly1 "GlowPlugPreHeatRelay1";
CM_ SG_ 2566903585 HhSpdRly "HighSpeedRelay";
CM_ SG_ 2566903585 LwSpdRly "LowSpeedRelay";
CM_ SG_ 2566903585 InchingRly "InchingRelay";
CM_ SG_ 2566903585 SpareRly "SpareRelay";
CM_ SG_ 2566903585 BackBzRly "BackBuzzerRelay";
CM_ SG_ 2566903585 StartRly "StarterRelay";
CM_ SG_ 2566903585 AutoBrkSv "AutoBrakeS/V";
CM_ SG_ 2566903585 PilotCutOffSv "PILOTCUTOFFS/V";
CM_ SG_ 2566903585 McvEpprCutOffSv "McvEpprCutOffS/V";
CM_ SG_ 2566903585 BsSpoolSc "BsSpoolS/V";
CM_ SG_ 2566903585 QckCouplerSv "QuickCouplerS/V";
CM_ SG_ 2566903585 FreeBoomDnSv "FreeBoomDwS/V";
CM_ SG_ 2566903585 FreeBoomUpSv "FreeBoomUpS/V";
CM_ SG_ 2566903585 TrvlStrgtSv "TravelStraightS/V";
CM_ SG_ 2566903585 RttCcwSv "RotatingCcwS/V";
CM_ SG_ 2566903585 RttCwSv "RotatingCwS/V";
CM_ SG_ 2566903585 Trvl2PmpCmbSv "TravelIIpumpCombination Solenoid";
CM_ SG_ 2566903585 OptPdlSaftySv "OptPedalSafety Solenoid";
CM_ SG_ 2566903585 ForceRgnSv "ForcedRegeneration Solenoid";
CM_ SG_ 2566903585 TwOprSv "TwoWayAct Solenoid(OnlyDX)";
CM_ SG_ 2566903585 UnloadSv "Unload Solenoid";
CM_ SG_ 2566903585 TwRhCloseSv "2-WayRH-CLOSES/V";
CM_ SG_ 2566903585 TwRhOpenSv "2-WayRH-OPENS/V";
CM_ SG_ 2566903585 SwgBrkRelSv "SwingBrakeRelease Solenoid(ElectronicPump)";
CM_ SG_ 2566903585 BypassCutOffSv "Bypass Cut Off Solenoid(ElectronicPump)";
CM_ SG_ 2566903585 RwdSv "Reverse Traveling Solenoid(Wheel)";
CM_ SG_ 2566903585 FwdSv "Forward Solenoid(Wheel)";
CM_ SG_ 2566903585 CruiseSv "Cruise Solenoid(Wheel)";
CM_ SG_ 2566903585 TwoPmpSelSv "2PumpSelect Solenoid";
CM_ SG_ 2566903585 FanRvsSv "Reverse Solenoid";
CM_ SG_ 2566903585 BrkrSelSv "BreakerSelect Solenoid";
CM_ SG_ 2566903585 HhSpdTrvlSv "HighSpeedTravel Solenoid";
CM_ SG_ 2566903585 PowMaxSv "PowerMax Solenoid";
CM_ SG_ 2566903585 BrkrOprSv "BreakerAct Solenoid";
CM_ BO_ 2566903841 "Wheel loader Analog Sensor Information";
CM_ SG_ 2566903841 TmsSecVlt "TMSConnectionVoltage";
CM_ SG_ 2566903841 EvaporatorTmp "Evaporator Temperature";
CM_ SG_ 2566903841 RsvJoy1GripYPos "Reserved-Joystick1GripY-AxisPosition";
CM_ SG_ 2566903841 Joy1GripYPos "Joystick1GripY-AxisPosition";
CM_ SG_ 2566903841 RsvJoy1YPos "Reserved-Joystick1Y-AxisPosition";
CM_ SG_ 2566903841 Joy1YPos "Joystick1Y-AxisPosition";
CM_ SG_ 2566903841 RsvJoy1XPos "Reserved-Joystick1X-AxisPosition";
CM_ SG_ 2566903841 Joy1XPos "Joystick1X-AxisPosition";
CM_ SG_ 2566903841 EmcvLeverOptB "[WheelLoader]EMCVLeverOption(B)";
CM_ SG_ 2566903841 EmcvLeverOptA "[WheelLoader]PMCVLeverOption";
CM_ SG_ 2566903841 EmcvLeverBckB "[WheelLoader]EMCVLeverBucket(B)";
CM_ SG_ 2566903841 EmcvLeverBckA "[WheelLoader]EMCVLeverBucket(A)";
CM_ SG_ 2566903841 EmcvLeverBoomB "[WheelLoader]EMCVLeverBoom(B)";
CM_ SG_ 2566903841 EmcvLeverBoomA "[WheelLoader]EMCVLeverBoom(A)";
CM_ SG_ 2566903841 ElecStrVv "[WheelLoader]ElecSteerValve";
CM_ SG_ 2566903841 ElecStrLeverB "[WheelLoader]ElecSteerLever(B)";
CM_ SG_ 2566903841 ElecStrLeverA "[WheelLoader]Elec.Steer.Lever(A)";
CM_ SG_ 2566903841 AcpSsPrs "ACPsensorPressure";
CM_ SG_ 2566903841 FanSpd "FAN Speed";
CM_ SG_ 2566903841 BatTmp "BatteryVoltage[Default]";
CM_ SG_ 2566903841 AltTmp "AlternatorVoltage";
CM_ SG_ 2566903841 AxleOilTmp "[WheelLoader]AxleOilTemp";
CM_ SG_ 2566903841 HydOilTmp "HydraulicTemperature[Default]";
CM_ SG_ 2566903841 CoolTmp "[Excavator]CoolantTemperature(Mechanical Engine)";
CM_ SG_ 2566903841 OpsSsVlt "OPSSensor(OPSSensor)Voltage";
CM_ SG_ 2566903841 WifSsVlt "WIFSensor(WIFSensor)Voltage";
CM_ SG_ 2566903841 FuelLv "FuelLevel[Default]";
CM_ SG_ 2566903841 BrkPdlB "[WheelLoader]BrakePedal(B)";
CM_ SG_ 2566903841 BrkPdlA "[WheelLoader]BrakePedal(A)";
CM_ SG_ 2566903841 AccPdlVlt "AccelPedalVoltage(Wheel)";
CM_ SG_ 2566903841 BrkChgPriPrs "Brake Charging Priority Pressure";
CM_ SG_ 2566903841 RhThmbWhlVlt "RH Thumbwheel Voltage";
CM_ SG_ 2566903841 CtlLsPrs "[CompactLoader]LSPressure";
CM_ SG_ 2566903841 CtlTowSpdPrs "[CompactLoader]TowSpeedPressure";
CM_ SG_ 2566903841 AngSsBckRef "[WheelLoader]AngleSensorBucket(B)";
CM_ SG_ 2566903841 AngSsBck "[WheelLoader]AngleSensorBucket(A)";
CM_ SG_ 2566903841 AngSsBoomRef "[WheelLoader]AngleSensorBoom(B)";
CM_ SG_ 2566903841 AngSsBoom "[WheelLoader]AngleSensorBoom(A)";
CM_ SG_ 2566903841 CtlBckLoadPrs "[CompactLoader]BucketLoadPressure";
CM_ SG_ 2566903841 CtlEgCtrlDialVlt "[CompactLoader]EngineControlDialVoltage";
CM_ SG_ 2566903841 PrkBrkPrs "ParkingBrakePressure";
CM_ SG_ 2566903841 FanMotPrs "[WheelLoader]FanMotorPressure";
CM_ SG_ 2566903841 BrkOilPrs "[WheelLoader]BrakeOilPressure";
CM_ SG_ 2566903841 StrPrs "[WheelLoader]SteeringPressure";
CM_ SG_ 2566903841 BoomRodPrs "[WheelLoader]BoomRodPressure";
CM_ SG_ 2566903841 BooHeadPrs "[WheelLoader]BoomHeadPressure";
CM_ SG_ 2566903841 MainPrs "[WheelLoader]MainPressure";
CM_ BO_ 2566904097 "Wheel loader Analog Actuator Information";
CM_ SG_ 2566904097 FanClutchPwmOutSig "Fan Clutch PWM Output Signal";
CM_ SG_ 2566904097 CacFanCtrl "CACFANCONTROL";
CM_ SG_ 2566904097 CdsFanCtrl "CONDENSORFANCONTROL";
CM_ SG_ 2566904097 RipperDnEvc "P/VBRIPPER;DOWN";
CM_ SG_ 2566904097 RipperUpEvc "P/VRIPPER;UP";
CM_ SG_ 2566904097 BladeAngLhEvc "P/VBLADE;ANGLELEFT";
CM_ SG_ 2566904097 BladeAngRhEvc "P/VBLADE;ANGLERIGHT";
CM_ SG_ 2566904097 BladeDnEvc "P/VBLADE;DOWN";
CM_ SG_ 2566904097 BladeRaiseEvc "P/VBLADE;RAISE";
CM_ SG_ 2566904097 BladeTiltLhEvc "P/VBLADE;TILTLEFT";
CM_ SG_ 2566904097 BladeTiltRhEvc "P/VBLADE;TILTRIGHT";
CM_ SG_ 2566904097 EbrkPropPrsRedVv "E-brake Proportional Pressure Reducing Valve";
CM_ SG_ 2566904097 McvBackPrsEvc "MCV Backpressure Proportional Pressure Reducing Valve";
CM_ SG_ 2566904097 Spool4BEvc "4THSPOOLBProportional Pressure Reducing Valve";
CM_ SG_ 2566904097 Spool4AEvc "4THSPOOLAProportional Pressure Reducing Valve";
CM_ SG_ 2566904097 Opt2Evc "Option2Proportional Pressure Reducing Valve";
CM_ SG_ 2566904097 Opt1Evc "Option1Proportional Pressure Reducing Valve";
CM_ SG_ 2566904097 BckDumpEvc "BucketDumpProportional Pressure Reducing Valve";
CM_ SG_ 2566904097 BoomCrowdEvc "BucketCrowdProportional Pressure Reducing Valve";
CM_ SG_ 2566904097 BoomFltEvc "BoomFloatProportional Pressure Reducing Valve";
CM_ SG_ 2566904097 BoomRaiseEvc "BoomRaiseProportional Pressure Reducing Valve";
CM_ SG_ 2566904097 FanCtrlEvc "FanControlProportional Pressure Reducing Valve";
CM_ BO_ 2566904353 "Wheel loader Digital Sensor Information";
CM_ SG_ 2566904353 AxleDhlCtrlSw "Axle DHL Control 스위치";
CM_ SG_ 2566904353 QckCplDisengageSw "Quick Coupler Disengage Switch";
CM_ SG_ 2566904353 RttBeaconSw "Rotating Beacon Switch";
CM_ SG_ 2566904353 RvsFanManualSw "Reverse Fan \"Manual\" Switch";
CM_ SG_ 2566904353 RvsFanAutoSw "Reverse Fan \"Auto\" Switch";
CM_ SG_ 2566904353 Aux8Sw "Aux8 Switch";
CM_ SG_ 2566904353 TwoSpeedSw "2 Speed Switch";
CM_ SG_ 2566904353 Aux7Sw "Aux7 Switch";
CM_ SG_ 2566904353 OpsSw "OPSSwitch";
CM_ SG_ 2566904353 HhFlowPinK "HighFlowPinK";
CM_ SG_ 2566904353 HhFlowPinN "HighFlowPinN";
CM_ SG_ 2566904353 DustInd "DustIndicator";
CM_ SG_ 2566904353 FrDoorSw "FrontDoorSwitch";
CM_ SG_ 2566904353 ArmRestLhSw "ArmRestSwitch(LH)";
CM_ SG_ 2566904353 ArmRestRhSw "ArmRestSwitch(RH)";
CM_ SG_ 2566904353 Spool3LeverSw "3rdSpoolLeverSwitch";
CM_ SG_ 2566904353 BckLeverSw "BucketLeverSwitch";
CM_ SG_ 2566904353 EgOilPrsSw "ENGINEOILPRESSURESWITCH";
CM_ SG_ 2566904353 HydLckoutSw "HYDRAULICLOCKOUTSWITCH";
CM_ SG_ 2566904353 TractionCtrlSw "TRACTIONCONTROLSWITCH";
CM_ SG_ 2566904353 AirCleanSw "AirCleanerSwitch";
CM_ SG_ 2566904353 RetFiltSw "ReturnFilterSwitch";
CM_ SG_ 2566904353 QckCouperLckSw "QuickCouplerLockSwitch";
CM_ SG_ 2566904353 DnShftSw "DownShiftSwitch";
CM_ SG_ 2566904353 PreHt "PreHeat";
CM_ SG_ 2566904353 Joy1XDetentPosSt "Joystick1X-AxisDetentPositionStatus";
CM_ SG_ 2566904353 Joy1YDetentPosSt "Joystick1Y-AxisDetentPositionStatus";
CM_ SG_ 2566904353 IhbSw "InhibitSwitch(added-11.09.30)";
CM_ SG_ 2566904353 HstOilFiltWrn "HSTOilFilterWarning";
CM_ SG_ 2566904353 GrboxOvrTmp "GearboxOverTemperature";
CM_ SG_ 2566904353 AgsLmp "AGSLamp";
CM_ SG_ 2566904353 QckCouplerInitSw "QuickCouplerInitiateSwitch";
CM_ SG_ 2566904353 PrkSw "ParkingSwitch";
CM_ SG_ 2566904353 SeatBeltSw "SeatBeltSwitch";
CM_ SG_ 2566904353 ReDefrstSw "ReDefrstSwitch";
CM_ SG_ 2566904353 HormSw "HornSwitch";
CM_ SG_ 2566904353 Fnr2ActSw "2ndFNRActivateSwitch";
CM_ SG_ 2566904353 RearWiperStpSw "RearWiperStopSignal";
CM_ SG_ 2566904353 FrWiperStpSig "FrontWiperStopSignal";
CM_ SG_ 2566904353 DpfForceRgnSw "DPFForcedRegenSwitch";
CM_ SG_ 2566904353 EmgStrPrsSw "EmergencySteerPressureSwitch";
CM_ SG_ 2566904353 MainStrPrsSw "MainSteerPressureSwitch";
CM_ SG_ 2566904353 AccPdlKd "AccelPedalKD";
CM_ SG_ 2566904353 AccPdlIvs "AccelPedalIVS";
CM_ SG_ 2566904353 PrkBrkPrsSw "ParkingBrakePressureSwitch";
CM_ SG_ 2566904353 CoolLv "CoolantLevel";
CM_ SG_ 2566904353 WghCntSw "WeighingCountSwitch";
CM_ SG_ 2566904353 EmgStpSw "EMERGENCYSTOPSwitch";
CM_ SG_ 2566904353 DhlManSw "DHLManualSwitch";
CM_ SG_ 2566904353 FnrR3 "3rdFNR(R)";
CM_ SG_ 2566904353 FnrN3 "3rdFNR(N)";
CM_ SG_ 2566904353 FnrF3 "3rdFNR(F)";
CM_ SG_ 2566904353 FnrR2 "2ndFNR(R)";
CM_ SG_ 2566904353 FnrN2 "2ndFNR(N)";
CM_ SG_ 2566904353 FnrF2 "2ndFNR(F)";
CM_ SG_ 2566904353 FnrR1 "1stFNR(R)";
CM_ SG_ 2566904353 FnrN1 "1stFNR(N)";
CM_ SG_ 2566904353 FnrF1 "1stFNR(F)";
CM_ SG_ 2566904353 StartBrSw "\"Br\"Switch(Starter)";
CM_ SG_ 2566904353 StartAccSw "\"Acc\"Switch(Starter)";
CM_ SG_ 2566904353 StartCSw "\"C\"Switch(Starter)";
CM_ SG_ 2566904353 PilotCutOffSw "PilotCutOffSwitch";
CM_ SG_ 2566904353 ArmRestCutOffSw "ArmRestCutOffSwitch";
CM_ SG_ 2566904353 ElecStrSelSw "ElecSteerSelectSwitch&3rdSelectSwitch";
CM_ BO_ 2566904609 "Wheel loader Digital Actuator Information";
CM_ SG_ 2566904609 DhlSol "DHL Solenoid";
CM_ SG_ 2566904609 GreenBeacon "Green Beacon";
CM_ SG_ 2566904609 Beacon "Beacon";
CM_ SG_ 2566904609 RrWrkLmp "Rear Working Lamp";
CM_ SG_ 2566904609 FrWrkLmp "Front Working Lamp";
CM_ SG_ 2566904609 EfanOutSig "E-Fan Output Signal";
CM_ SG_ 2566904609 RrCabLmpRly "Rear Cabin Lamp Relay";
CM_ SG_ 2566904609 FrCabLmpRly "Front Cabin Lamp Relay";
CM_ SG_ 2566904609 HeadLmpRly "Head Lamp Relay";
CM_ SG_ 2566904609 RideCtrlCutOffSv "Ride Control Cut Off  Solenoid";
CM_ SG_ 2566904609 Aux8 "Aux8Relay";
CM_ SG_ 2566904609 Aux7 "Aux7Relay";
CM_ SG_ 2566904609 Aux6 "Aux6Relay";
CM_ SG_ 2566904609 Aux5 "Aux5Relay";
CM_ SG_ 2566904609 Aux4 "Aux4Relay";
CM_ SG_ 2566904609 Aux3 "Aux3Relay";
CM_ SG_ 2566904609 AuxShutOffSv "AuxShutOff Solenoid";
CM_ SG_ 2566904609 PilotCutOffSv "PilotCutOff Solenoid";
CM_ SG_ 2566904609 FrWiperRly "FrontWiperRelay";
CM_ SG_ 2566904609 SideWasherRly "SideWasherRelay";
CM_ SG_ 2566904609 UreaSuperChgWrnSig "UREASUPERCHARGINGWARNINGSIGNAL";
CM_ SG_ 2566904609 EgRunOutSig "Enginerunningoutputsignal";
CM_ SG_ 2566904609 SideWiperRly "SideWiperRelay";
CM_ SG_ 2566904609 FrWhaserRly "FrontWasherRelay";
CM_ SG_ 2566904609 FrWiperLwSigRly "FrontWiperLowSpeedRelay";
CM_ SG_ 2566904609 FrWiperHhSpdRly "FrontWiperHighSpeedRelay";
CM_ SG_ 2566904609 LwBeamRly "LowBeamRelay";
CM_ SG_ 2566904609 HhBeamRly "HighBeamRelay";
CM_ SG_ 2566904609 IllmLmpRly "IlluminationLampRelay";
CM_ SG_ 2566904609 RttBeaconRly "RotatingBeaconRelay";
CM_ SG_ 2566904609 TurnSigRhRly "TURNSIGNALRHRelay";
CM_ SG_ 2566904609 TurnSigLhRly "TURNSIGNALLHRelay";
CM_ SG_ 2566904609 HormRly "HORNRelay";
CM_ SG_ 2566904609 AccRly "ACCRelay";
CM_ SG_ 2566904609 RrWinHtRly "RearWindowHeatingRelay";
CM_ SG_ 2566904609 AutoShutOffRly "AUTOSHUTOFFRelay";
CM_ SG_ 2566904609 BackUpBzRly "BackUpBuzzerRelay";
CM_ SG_ 2566904609 MrrHtRly "MirrorHeaterRelay";
CM_ SG_ 2566904609 HuelHtRly "FuelHeaterRelay";
CM_ SG_ 2566904609 GlowPlugFuelRly "GlowPlugFuelRelay";
CM_ SG_ 2566904609 GlowPlugRly "GlowPlugRelay";
CM_ SG_ 2566904609 EmgStrTestRly "EMERGENCYSTEERINGTESTRelay";
CM_ SG_ 2566904609 RrWasherRly "RearWasherRelay";
CM_ SG_ 2566904609 RrWiperRly "RearwiperRelay";
CM_ SG_ 2566904609 RrWrkCabLmpRly "RearworkinglampRelay(Cabin)";
CM_ SG_ 2566904609 RrWrkRadLmpRly "RearworkinglampRelay(Radiator)";
CM_ SG_ 2566904609 FrWrkLmpRly "FrontworkinglampRelay";
CM_ SG_ 2566904609 ElecStrSaftyRly "ElecSteerSafetyRelay";
CM_ SG_ 2566904609 PilotBzRly "PilotBuzzerRelay";
CM_ SG_ 2566904609 LisActRly "LISACTIVERelay";
CM_ SG_ 2566904609 HstCutOffRhSv "HSTCutoffRH Solenoid";
CM_ SG_ 2566904609 HstCutOffLhSv "HSTCutoffLH Solenoid";
CM_ SG_ 2566904609 BckMagnet "BucketMagnet";
CM_ SG_ 2566904609 BoomMagnet "BoomMagnet";
CM_ SG_ 2566904609 HstCutOffSv "HSTCUTOFFS/V";
CM_ SG_ 2566904609 HydCutOffSv "HYDRAULICCUTOFFS/V";
CM_ SG_ 2566904609 StartRly "StarterRelay";
CM_ SG_ 2566904609 QckCouplerRly "QuickCouplerRelay";
CM_ SG_ 2566904609 EgStpRly "EningeStopRelay";
CM_ SG_ 2566904609 PrkBrkRlsSv "ParkingBrakeRelease Solenoid";
CM_ SG_ 2566904609 EscortWrkLmpRly "EscortWorkingLampRelay";
CM_ SG_ 2566904609 AxleOilCoolSv "AxleOilCooler Solenoid";
CM_ SG_ 2566904609 UnloadSv "Unloading Solenoid";
CM_ SG_ 2566904609 BrkChgSv "BrakeCharge Solenoid";
CM_ SG_ 2566904609 RvsFanSV "ReverseFAN Solenoid";
CM_ BO_ 2566904865 "CE Type Information";
CM_ SG_ 2566904865 EcuMaker2 "ECU maker 2";
CM_ SG_ 2566904865 MchMaker "Machine Maker";
CM_ SG_ 2566904865 SalesRegion "SalesRegion";
CM_ SG_ 2566904865 TcuType "TCUType";
CM_ SG_ 2566904865 JoyType "JoystickType";
CM_ SG_ 2566904865 McvCtrlType "MCVControlType";
CM_ SG_ 2566904865 McvType "MCVType";
CM_ SG_ 2566904865 PmpCtrlType "PumpControlType";
CM_ SG_ 2566904865 PmpType "PumpType";
CM_ SG_ 2566904865 EcuMaker "ECUmaker";
CM_ SG_ 2566904865 EgMaker "Enginemaker";
CM_ SG_ 2566904865 ModelYearVer "ModelYearVersion";
CM_ SG_ 2566904865 MchType "MachineType";
CM_ SG_ 2566904865 MchClass "MachineClassification";
CM_ SG_ 2566904865 MchGen "MachineGeneration";
CM_ SG_ 2566904865 EmsCtrl "EmissionControl";
CM_ BO_ 2566905121 "Attachment  Setting Data Information";
CM_ SG_ 2566905121 TwUseFlow4 "TwoWayUseFlow4";
CM_ SG_ 2566905121 TwUseFlow3 "TwoWayUseFlow3";
CM_ SG_ 2566905121 TwUseFlow2 "TwoWayUseFlow2";
CM_ SG_ 2566905121 TwUseFlow1 "TwoWayUseFlow1";
CM_ SG_ 2566905121 TwUseFlow0 "TwoWayUseFlow0";
CM_ SG_ 2566905121 TwSetFlow4 "TwoWaySetFlow4";
CM_ SG_ 2566905121 TwSetFlow3 "TwoWaySetFlow3";
CM_ SG_ 2566905121 TwSetFlow2 "TwoWaySetFlow2";
CM_ SG_ 2566905121 TwSetFlow1 "TwoWaySetFlow1";
CM_ SG_ 2566905121 TwSetFlow0 "TwoWaySetFlow0";
CM_ SG_ 2566905121 TwMinFlowAtt4 "TwoWayMinFlow(ATT)4";
CM_ SG_ 2566905121 TwMinFlowAtt3 "TwoWayMinFlow(ATT)3";
CM_ SG_ 2566905121 TwMinFlowAtt2 "TwoWayMinFlow(ATT)2";
CM_ SG_ 2566905121 TwMinFlowAtt1 "TwoWayMinFlow(ATT)1";
CM_ SG_ 2566905121 TwMinFlowAtt0 "TwoWayMinFlow(ATT)0";
CM_ SG_ 2566905121 TwMaxFlowAtt4 "TwoWayMaxFlow(ATT)4";
CM_ SG_ 2566905121 TwMaxFlowAtt3 "TwoWayMaxFlow(ATT)3";
CM_ SG_ 2566905121 TwMaxFlowAtt2 "TwoWayMaxFlow(ATT)2";
CM_ SG_ 2566905121 TwMaxFlowAtt1 "TwoWayMaxFlow(ATT)1";
CM_ SG_ 2566905121 TwMaxFlowAtt0 "TwoWayMaxFlow(ATT)0";
CM_ SG_ 2566905121 TwMaxFlowPmp4 "TwoWayMaxFlow(Pump)4";
CM_ SG_ 2566905121 TwMaxFlowPmp3 "TwoWayMaxFlow(Pump)3";
CM_ SG_ 2566905121 TwMaxFlowPmp2 "TwoWayMaxFlow(Pump)2";
CM_ SG_ 2566905121 TwMaxFlowPmp1 "TwoWayMaxFlow(Pump)1";
CM_ SG_ 2566905121 TwMaxFlowPmp0 "TwoWayMaxFlow(Pump)0";
CM_ SG_ 2566905121 TwPrs4 "TwoWayPress4";
CM_ SG_ 2566905121 TwPrs3 "TwoWayPress3";
CM_ SG_ 2566905121 TwPrs2 "TwoWayPress2";
CM_ SG_ 2566905121 TwPrs1 "TwoWayPress1";
CM_ SG_ 2566905121 TwPrs0 "TwoWayPress0";
CM_ SG_ 2566905121 TwRpm4 "TwoWayRpm4";
CM_ SG_ 2566905121 TwRpm3 "TwoWayRpm3";
CM_ SG_ 2566905121 TwRpm2 "TwoWayRpm2";
CM_ SG_ 2566905121 TwRpm1 "TwoWayRpm1";
CM_ SG_ 2566905121 TwRpm0 "TwoWayRpm0";
CM_ SG_ 2566905121 Tw4BrkrBtnType "TWoWay4;ThumbWheelType";
CM_ SG_ 2566905121 Tw4TwoPmpOpt "TWoWay4;2PumpOption";
CM_ SG_ 2566905121 Tw4SelAttNo "TWoWay4;SelectedATTNumber(1~5)";
CM_ SG_ 2566905121 Tw4SelAttType "TWoWay4;SelectedATTType(OnewayorTwoway)";
CM_ SG_ 2566905121 Tw3BrkrBtnType "TWoWay3;ThumbWheelType";
CM_ SG_ 2566905121 Tw3TwoPmpOpt "TWoWay3;2PumpOption";
CM_ SG_ 2566905121 Tw3SelAttNo "TWoWay3;SelectedATTNumber(1~5)";
CM_ SG_ 2566905121 Tw3SelAttType "TWoWay3;SelectedATTType(OnewayorTwoway)";
CM_ SG_ 2566905121 Tw2BrkrBtnType "TWoWay2;ThumbWheelType";
CM_ SG_ 2566905121 Tw2TwoPmpOpt "TWoWay2;2PumpOption";
CM_ SG_ 2566905121 Tw2SelAttNo "TWoWay2;SelectedATTNumber(1~5)";
CM_ SG_ 2566905121 Tw2SelAttType "TWoWay2;SelectedATTType(OnewayorTwoway)";
CM_ SG_ 2566905121 Tw1BrkrBtnType "TWoWay1;ThumbWheelType";
CM_ SG_ 2566905121 Tw1TwoPmpOpt "TWoWay1;2PumpOption";
CM_ SG_ 2566905121 Tw1SelAttNo "TWoWay1;SelectedATTNumber(1~5)";
CM_ SG_ 2566905121 Tw1SelAttType "TWoWay1;SelectedATTType(OnewayorTwoway)";
CM_ SG_ 2566905121 Tw0BrkrBtnType "TWoWay0;ThumbWheelType";
CM_ SG_ 2566905121 Tw0TwoPmpOpt "TWoWay0;2PumpOption";
CM_ SG_ 2566905121 Tw0SelAttNo "TWoWay0;SelectedATTNumber(1~5)";
CM_ SG_ 2566905121 Tw0SelAttType "TWoWay0;SelectedATTType(OnewayorTwoway)";
CM_ SG_ 2566905121 OwUseFlow4 "OneWayUseFlow4";
CM_ SG_ 2566905121 OwUseFlow3 "OneWayUseFlow3";
CM_ SG_ 2566905121 OwUseFlow2 "OneWayUseFlow2";
CM_ SG_ 2566905121 OwUseFlow1 "OneWayUseFlow1";
CM_ SG_ 2566905121 OwUseFlow0 "OneWayUseFlow0";
CM_ SG_ 2566905121 OwSetFlow4 "OneWaySetFlow4";
CM_ SG_ 2566905121 OwSetFlow3 "OneWaySetFlow3";
CM_ SG_ 2566905121 OwSetFlow2 "OneWaySetFlow2";
CM_ SG_ 2566905121 OwSetFlow1 "OneWaySetFlow1";
CM_ SG_ 2566905121 OwSetFlow0 "OneWaySetFlow0";
CM_ SG_ 2566905121 OwMinFlowAtt4 "OneWayMinFlow(ATT)4";
CM_ SG_ 2566905121 OwMinFlowAtt3 "OneWayMinFlow(ATT)3";
CM_ SG_ 2566905121 OwMinFlowAtt2 "OneWayMinFlow(ATT)2";
CM_ SG_ 2566905121 OwMinFlowAtt1 "OneWayMinFlow(ATT)1";
CM_ SG_ 2566905121 OwMinFlowAtt0 "OneWayMinFlow(ATT)0";
CM_ SG_ 2566905121 OwMaxFlowAtt4 "OneWayMaxFlow(ATT)4";
CM_ SG_ 2566905121 OwMaxFlowAtt3 "OneWayMaxFlow(ATT)3";
CM_ SG_ 2566905121 OwMaxFlowAtt2 "OneWayMaxFlow(ATT)2";
CM_ SG_ 2566905121 OwMaxFlowAtt1 "OneWayMaxFlow(ATT)1";
CM_ SG_ 2566905121 OwMaxFlowAtt0 "OneWayMaxFlow(ATT)0";
CM_ SG_ 2566905121 OwMaxFlowPmp4 "OneWayMaxFlow(Pump)4";
CM_ SG_ 2566905121 OwMaxFlowPmp3 "OneWayMaxFlow(Pump)3";
CM_ SG_ 2566905121 OwMaxFlowPmp2 "OneWayMaxFlow(Pump)2";
CM_ SG_ 2566905121 OwMaxFlowPmp1 "OneWayMaxFlow(Pump)1";
CM_ SG_ 2566905121 OwMaxFlowPmp0 "OneWayMaxFlow(Pump)0";
CM_ SG_ 2566905121 OwPrs4 "OneWayPress4";
CM_ SG_ 2566905121 OwPrs3 "OneWayPress3";
CM_ SG_ 2566905121 OwPrs2 "OneWayPress2";
CM_ SG_ 2566905121 OwPrs1 "OneWayPress1";
CM_ SG_ 2566905121 OwPrs0 "OneWayPress0";
CM_ SG_ 2566905121 OwRpm4 "OneWayRpm4";
CM_ SG_ 2566905121 OwRpm3 "OneWayRpm3";
CM_ SG_ 2566905121 OwRpm2 "OneWayRpm2";
CM_ SG_ 2566905121 OwRpm1 "OneWayRpm1";
CM_ SG_ 2566905121 OwRpm0 "OneWayRpm0";
CM_ SG_ 2566905121 RttCurStep "RotatingCurrentStep";
CM_ SG_ 2566905121 TwCurStep "TwoWayCurrentStep";
CM_ SG_ 2566905121 Ow4BrkrBtnType "OneWay4;BreakerButtonType";
CM_ SG_ 2566905121 Ow4TwoPmpOpt "OneWay4;2PumpOption";
CM_ SG_ 2566905121 Ow4SelAttNo "OneWay4;SelectedATTNumber(1~5)";
CM_ SG_ 2566905121 Ow4SelAttType "OneWay4;SelectedATTType(OnewayorTwoway)";
CM_ SG_ 2566905121 OwCurStep "OneWayCurrentStep";
CM_ SG_ 2566905121 Ow3BrkrBtnType "OneWay3;BreakerButtonType";
CM_ SG_ 2566905121 Ow3TwoPmpOpt "OneWay3;2PumpOption";
CM_ SG_ 2566905121 Ow3SelAttNo "OneWay3;SelectedATTNumber(1~5)";
CM_ SG_ 2566905121 Ow3SelAttType "OneWay3;SelectedATTType(OnewayorTwoway)";
CM_ SG_ 2566905121 Ow2BrkrBtnType "OneWay2;BreakerButtonType";
CM_ SG_ 2566905121 Ow2TwoPmpOpt "OneWay2;2PumpOption";
CM_ SG_ 2566905121 Ow2SelAttNo "OneWay2;SelectedATTNumber(1~5)";
CM_ SG_ 2566905121 Ow2SelAttType "OneWay2;SelectedATTType(OnewayorTwoway)";
CM_ SG_ 2566905121 Ow1BrkrBtnType "OneWay1;BreakerButtonType";
CM_ SG_ 2566905121 Ow1TwoPmpOpt "OneWay1;2PumpOption";
CM_ SG_ 2566905121 Ow1SelAttNo "OneWay1;SelectedATTNumber(1~5)";
CM_ SG_ 2566905121 Ow1SelAttType "OneWay1;SelectedATTType(OnewayorTwoway)";
CM_ SG_ 2566905121 Ow0BrkrBtnType "OneWay0;BreakerButtonType";
CM_ SG_ 2566905121 Ow0TwoPmpOpt "OneWay0;2PumpOption";
CM_ SG_ 2566905121 Ow0SelAttNo "OneWay0;SelectedATTNumber(1~5)";
CM_ SG_ 2566905121 Ow0SelAttType "OneWay0;SelectedATTType(OnewayorTwoway)";
CM_ SG_ 2566905121 MaxFlow "MaxFlow";
CM_ SG_ 2566905121 MinFlow "MinFlow";
CM_ SG_ 2566905121 MaxPrsTw "MaxPressTwo";
CM_ SG_ 2566905121 MinPrsTw "MinPressTwo";
CM_ SG_ 2566905121 MaxPrsOw "MaxPressOne";
CM_ SG_ 2566905121 MinPrsOw "MinPressOne";
CM_ SG_ 2566905121 MaxSpd "MaxSpeed";
CM_ SG_ 2566905121 MinSpd "MinSpeed";
CM_ SG_ 2566905121 SelAttTw "SelectedAttachmentTwoway";
CM_ SG_ 2566905121 SelAttOw "SelectedAttachmentOneway";
CM_ BO_ 2566905377 "Fuel Used Data Information";
CM_ SG_ 2566905377 PSmartMd "P smart Mode";
CM_ SG_ 2566905377 TotFuelUsed "Total Fuel Used";
CM_ SG_ 2566905377 LiftMd "Lift Mode";
CM_ SG_ 2566905377 TrvlStd "TravelStandard";
CM_ SG_ 2566905377 TrvlPow "TravelPower";
CM_ SG_ 2566905377 Idle "Idle";
CM_ SG_ 2566905377 AutoIdle "AutoIdle";
CM_ SG_ 2566905377 EcnMd "EconomyMode";
CM_ SG_ 2566905377 StdMd "StandardMode";
CM_ SG_ 2566905377 PowMd "PowerMode";
CM_ SG_ 2566905377 PowPlusMd "Power+Mode";
CM_ BO_ 2566905633 "Used Hour Data Information";
CM_ SG_ 2566905633 AcptPrsAbove2600 "ACPT Pressure (Above 2600 kPa)";
CM_ SG_ 2566905633 AcptPrs21002500 "ACPT Pressure (2100~2500 kPa)";
CM_ SG_ 2566905633 AcptPrs16002000 "ACPT Pressure (1600~2000 kPa)";
CM_ SG_ 2566905633 AcptPrs10001500 "ACPT Pressure (1000~1500 kPa)";
CM_ SG_ 2566905633 AcptPrsBelow900 "ACPT Pressure (Below 900 kPa)";
CM_ SG_ 2566905633 HydOilTmpAbove16 "Hyd. Oil Temperature (Above 16℃)";
CM_ SG_ 2566905633 HydOilTmp11to15 "Hyd. Oil Temperature  (11~15℃)";
CM_ SG_ 2566905633 HydOilTmp5to10 "Hyd. Oil Temperature (5~10℃)";
CM_ SG_ 2566905633 EvaporatorTmpBelow4 "Evaporator Temperature (Below 4℃)";
CM_ SG_ 2566905633 PSmartMd "P smart Mode";
CM_ SG_ 2566905633 TotOprHr "TotalOpertionHour";
CM_ SG_ 2566905633 CoolTempAbove106 "CoolantTmeperature(Above106℃)";
CM_ SG_ 2566905633 CoolTemp101105 "CoolantTmeperature(101~105℃)";
CM_ SG_ 2566905633 CoolTemp96100 "CoolantTmeperature(96~100℃)";
CM_ SG_ 2566905633 CoolTemp9195 "CoolantTmeperature(91~95℃)";
CM_ SG_ 2566905633 CoolTemp8190 "CoolantTmeperature(81~90℃)";
CM_ SG_ 2566905633 CoolTempBelow80 "CoolantTmeperature(Below80℃)";
CM_ SG_ 2566905633 HydOilTmpAbove96 "Hyd.OilTemperature(Above96℃)";
CM_ SG_ 2566905633 HydOilTmp9195 "Hyd.OilTemperature(91~95℃)";
CM_ SG_ 2566905633 HydOilTmp8190 "Hyd.OilTemperature(81~90℃)";
CM_ SG_ 2566905633 HydOilTmp7180 "Hyd.OilTemperature(71~80℃)";
CM_ SG_ 2566905633 HydOilTmp5170 "Hyd.OilTemperature(51~70℃)";
CM_ SG_ 2566905633 HydOilTmpBelow50 "Hyd.OilTemperature(Below50℃)";
CM_ SG_ 2566905633 TwMd "TwoWayMode";
CM_ SG_ 2566905633 BrkrMd "BreakerMode";
CM_ SG_ 2566905633 LiftMd "LiftMode";
CM_ SG_ 2566905633 TrvlStd "TravelStandard";
CM_ SG_ 2566905633 TrvlPow "TravelPower";
CM_ SG_ 2566905633 Idle "Idle";
CM_ SG_ 2566905633 AutoIdle "AutoIdle";
CM_ SG_ 2566905633 EcnMd "EconomyMode";
CM_ SG_ 2566905633 StdMd "StandardMode";
CM_ SG_ 2566905633 PowMd "PowerMode";
CM_ SG_ 2566905633 PowPlusMd "Power+Mode";
CM_ BO_ 2566905889 "Real Time Failure Information";
CM_ SG_ 2566905889 Afc7 "…RealTimeFailureNCode(11bits)+FMI(5bits)";
CM_ SG_ 2566905889 Afc6 "RealTimeFailure6Code(11bits)+FMI(5bits)";
CM_ SG_ 2566905889 Afc5 "RealTimeFailure5Code(11bits)+FMI(5bits)";
CM_ SG_ 2566905889 Afc4 "RealTimeFailure4Code(11bits)+FMI(5bits)";
CM_ SG_ 2566905889 Afc3 "RealTimeFailure3Code(11bits)+FMI(5bits)";
CM_ SG_ 2566905889 Afc2 "RealTimeFailure2Code(11bits)+FMI(5bits)";
CM_ SG_ 2566905889 Afc1 "RealTimeFailure1Code(11bits)+FMI(5bits)";
CM_ BO_ 2566906145 "Failure Log Information";
CM_ SG_ 2566906145 RealTimeFailNCdFmi "Real Time Failure N Code (11bits)+FMI(5bits)";
CM_ SG_ 2566906145 RealTimeFail6CdFmi "Real Time Failure 6 Code (11bits)+FMI(5bits)";
CM_ SG_ 2566906145 RealTimeFail5CdFmi "Real Time Failure 5 Code (11bits)+FMI(5bits)";
CM_ SG_ 2566906145 RealTimeFail4CdFmi "Real Time Failure 4 Code (11bits)+FMI(5bits)";
CM_ SG_ 2566906145 RealTimeFail3CdFmi "Real Time Failure 3 Code (11bits)+FMI(5bits)";
CM_ SG_ 2566906145 RealTimeFail2CdFmi "Real Time Failure 2 Code (11bits)+FMI(5bits)";
CM_ SG_ 2566906145 RealTimeFail1CdFmi "Real Time Failure 1 Code (11bits)+FMI(5bits)";
CM_ BO_ 2566906401 "AVM Real Time Failure Information";
CM_ BO_ 2566906657 "TMS Security Status : GP/DMS/TGU -> EPOS";
CM_ SG_ 2566906657 SecSt "Security Status";
CM_ SG_ 2566906657 TmsSecCode "TMS Security Random Code";
CM_ BO_ 2566907169 "VCU Software Version ";
CM_ SG_ 2566907169 McuSwVerYear "VCUSWVersion:Year";
CM_ SG_ 2566907169 McuSwVerDay "VCUSWVersion;Day";
CM_ SG_ 2566907169 McuSwVerMonth "VCUSWVersion;Month";
CM_ SG_ 2566907169 McuSwVer "VCUSWVersion";
CM_ BO_ 2566907681 "ECO Guidance Information";
CM_ SG_ 2566907681 IccoFunCrcmdScore "ICCOFunctionUseRecomendedScroe";
CM_ SG_ 2566907681 UnssHydReliefScore "UnnecessaryHydraulicReliefScroe";
CM_ SG_ 2566907681 InIntentBrkPreventScore "InIntent Braking PreventionScroe";
CM_ SG_ 2566907681 EmgStpPreventScore "EmergencyStopPreventionScroe";
CM_ SG_ 2566907681 EgMdDnRcmdScore "EngineModeDownRecomendedScroe";
CM_ SG_ 2566907681 LckUpRcmdScore "LockUpUseRecomendedScroe";
CM_ SG_ 2566907681 GrNeutRpmUpScore "GearNeutralStatusRpmUpScroe";
CM_ SG_ 2566907681 IdlePrvtScore "Idle Prevention Status Score";
CM_ SG_ 2566907681 ManGrMaxSpdRcmdScore "ManualGearMaxSpeedTravelScroe";
CM_ SG_ 2566907681 Auto14RcmdScore "1-4AutoUseRecomendedScroe";
CM_ SG_ 2566907681 LisVhcSpdSetDnChngRcmdScore "LISVehicel Speed Set Down ChangeRecomendedScroe";
CM_ SG_ 2566907681 LisVhcSpdSetUpChngRcmdScore "LISVehicle Speed Set Up Change RecomendedScroe";
CM_ SG_ 2566907681 LisFunCrcmdScore "LISFunctionUseRecomendedScroe";
CM_ SG_ 2566907681 EcoGudCtrl "ECO Guidance Control";
BA_DEF_ BO_  "Channel" STRING ;
BA_DEF_ BO_  "VssMsg" STRING ;
BA_DEF_ SG_  "VssSig" STRING ;
BA_DEF_ BO_  "GenMsgCycleTime" INT 0 65535;
BA_DEF_ SG_  "SystemSignalLongSymbol" STRING ;
BA_DEF_DEF_  "Channel" "";
BA_DEF_DEF_  "VssMsg" "";
BA_DEF_DEF_  "VssSig" "";
BA_DEF_DEF_  "GenMsgCycleTime" 0;
BA_DEF_DEF_  "SystemSignalLongSymbol" "";
BA_ "VssMsg" BO_ 2566902305 "Mch.MCU.FOUHI";
BA_ "Channel" BO_ 2566902305 "can1";
BA_ "VssMsg" BO_ 2566902561 "Mch.MCU.FOCPHI";
BA_ "Channel" BO_ 2566902561 "can1";
BA_ "VssMsg" BO_ 2566902817 "Mch.MCU.XASI";
BA_ "Channel" BO_ 2566902817 "can1";
BA_ "VssMsg" BO_ 2566903073 "Mch.MCU.XAAI";
BA_ "Channel" BO_ 2566903073 "can1";
BA_ "VssMsg" BO_ 2566903329 "Mch.MCU.XDSI";
BA_ "Channel" BO_ 2566903329 "can1";
BA_ "VssMsg" BO_ 2566903585 "Mch.MCU.XDAI";
BA_ "Channel" BO_ 2566903585 "can1";
BA_ "VssMsg" BO_ 2566903841 "Mch.MCU.LASI";
BA_ "Channel" BO_ 2566903841 "can1";
BA_ "VssMsg" BO_ 2566904097 "Mch.MCU.LAAI";
BA_ "Channel" BO_ 2566904097 "can1";
BA_ "VssMsg" BO_ 2566904353 "Mch.MCU.LDSI";
BA_ "Channel" BO_ 2566904353 "can1";
BA_ "VssMsg" BO_ 2566904609 "Mch.MCU.LDAI";
BA_ "Channel" BO_ 2566904609 "can1";
BA_ "VssMsg" BO_ 2566904865 "Mch.MCU.CETI";
BA_ "Channel" BO_ 2566904865 "can1";
BA_ "VssMsg" BO_ 2566905121 "Mch.MCU.ASDI";
BA_ "Channel" BO_ 2566905121 "can1";
BA_ "VssMsg" BO_ 2566905377 "Mch.MCU.FUDI";
BA_ "Channel" BO_ 2566905377 "can1";
BA_ "VssMsg" BO_ 2566905633 "Mch.MCU.UHDI";
BA_ "Channel" BO_ 2566905633 "can1";
BA_ "VssMsg" BO_ 2566905889 "Mch.MCU.RTFI";
BA_ "Channel" BO_ 2566905889 "can1";
BA_ "VssMsg" BO_ 2566906145 "Mch.MCU.FLI";
BA_ "Channel" BO_ 2566906145 "can1";
BA_ "VssMsg" BO_ 2566906401 "Mch.MCU.ARTFI";
BA_ "Channel" BO_ 2566906401 "can1";
BA_ "VssMsg" BO_ 2566906657 "Mch.MCU.TSS";
BA_ "Channel" BO_ 2566906657 "can1";
BA_ "VssMsg" BO_ 2566907169 "Mch.MCU.VSWVER";
BA_ "Channel" BO_ 2566907169 "can1";
BA_ "VssMsg" BO_ 2566907681 "Mch.MCU.ECOGI";
BA_ "Channel" BO_ 2566907681 "can1";
BA_ "VssSig" SG_ 2566902305 AirClnOutFiltUsedHr "Mch.MCU.FOUHI.AirClnOutFiltUsedHr";
BA_ "VssSig" SG_ 2566902305 AirClnInFiltUsedHr "Mch.MCU.FOUHI.AirClnInFiltUsedHr";
BA_ "VssSig" SG_ 2566902305 PmpDrvAirCtrgHr "Mch.MCU.FOUHI.PmpDrvAirCtrgHr";
BA_ "VssSig" SG_ 2566902305 PmpDrvOilHr "Mch.MCU.FOUHI.PmpDrvOilHr";
BA_ "VssSig" SG_ 2566902305 HstFiltHr "Mch.MCU.FOUHI.HstFiltHr";
BA_ "VssSig" SG_ 2566902305 AxleOilFiltHr "Mch.MCU.FOUHI.AxleOilFiltHr";
BA_ "VssSig" SG_ 2566902305 AtsSparkPlugHr "Mch.MCU.FOUHI.AtsSparkPlugHr";
BA_ "VssSig" SG_ 2566902305 EgCrkcaseBreatherElementHr "Mch.MCU.FOUHI.EgCrkcaseBreatherElementHr";
BA_ "VssSig" SG_ 2566902305 AirCndFiltInHr "Mch.MCU.FOUHI.AirCndFiltInHr";
BA_ "VssSig" SG_ 2566902305 AirCndFiltOutHr "Mch.MCU.FOUHI.AirCndFiltOutHr";
BA_ "VssSig" SG_ 2566902305 EgOilCtrCleanerFiltHr "Mch.MCU.FOUHI.EgOilCtrCleanerFiltHr";
BA_ "VssSig" SG_ 2566902305 DefBreatherFiltHr "Mch.MCU.FOUHI.DefBreatherFiltHr";
BA_ "VssSig" SG_ 2566902305 DefFiltHr "Mch.MCU.FOUHI.DefFiltHr";
BA_ "VssSig" SG_ 2566902305 OilBathPrecleanerHr "Mch.MCU.FOUHI.OilBathPrecleanerHr";
BA_ "VssSig" SG_ 2566902305 DefHr "Mch.MCU.FOUHI.DefHr";
BA_ "VssSig" SG_ 2566902305 AxleOilHr "Mch.MCU.FOUHI.AxleOilHr";
BA_ "VssSig" SG_ 2566902305 TrmsOilFiltHr "Mch.MCU.FOUHI.TrmsOilFiltHr";
BA_ "VssSig" SG_ 2566902305 TrmsOilHr "Mch.MCU.FOUHI.TrmsOilHr";
BA_ "VssSig" SG_ 2566902305 BreatherOilSepFiltHr "Mch.MCU.FOUHI.BreatherOilSepFiltHr";
BA_ "VssSig" SG_ 2566902305 DpfHr "Mch.MCU.FOUHI.DpfHr";
BA_ "VssSig" SG_ 2566902305 CoolHr "Mch.MCU.FOUHI.CoolHr";
BA_ "VssSig" SG_ 2566902305 HydOilHr "Mch.MCU.FOUHI.HydOilHr";
BA_ "VssSig" SG_ 2566902305 EgOilHr "Mch.MCU.FOUHI.EgOilHr";
BA_ "VssSig" SG_ 2566902305 PilotFiltHr "Mch.MCU.FOUHI.PilotFiltHr";
BA_ "VssSig" SG_ 2566902305 RetFiltHr "Mch.MCU.FOUHI.RetFiltHr";
BA_ "VssSig" SG_ 2566902305 EgOilFiltHr "Mch.MCU.FOUHI.EgOilFiltHr";
BA_ "VssSig" SG_ 2566902305 AirCleanerHr "Mch.MCU.FOUHI.AirCleanerHr";
BA_ "VssSig" SG_ 2566902305 FuleFiltHr "Mch.MCU.FOUHI.FuleFiltHr";
BA_ "VssSig" SG_ 2566902561 AirClnOutFilt "Mch.MCU.FOCPHI.AirClnOutFilt";
BA_ "VssSig" SG_ 2566902561 AirClnInFilt "Mch.MCU.FOCPHI.AirClnInFilt";
BA_ "VssSig" SG_ 2566902561 PmpDrvAirCtrgPrd "Mch.MCU.FOCPHI.PmpDrvAirCtrgPrd";
BA_ "VssSig" SG_ 2566902561 PmpDrvOilPrd "Mch.MCU.FOCPHI.PmpDrvOilPrd";
BA_ "VssSig" SG_ 2566902561 HstFiltPrd "Mch.MCU.FOCPHI.HstFiltPrd";
BA_ "VssSig" SG_ 2566902561 AxleOilFiltPrd "Mch.MCU.FOCPHI.AxleOilFiltPrd";
BA_ "VssSig" SG_ 2566902561 AtsSparkPlugPrd "Mch.MCU.FOCPHI.AtsSparkPlugPrd";
BA_ "VssSig" SG_ 2566902561 EgCrkcaseBreatherElementPrd "Mch.MCU.FOCPHI.EgCrkcaseBreatherElementPrd";
BA_ "VssSig" SG_ 2566902561 AirCndFiltInPrd "Mch.MCU.FOCPHI.AirCndFiltInPrd";
BA_ "VssSig" SG_ 2566902561 AirCndFiltOutPrd "Mch.MCU.FOCPHI.AirCndFiltOutPrd";
BA_ "VssSig" SG_ 2566902561 EgOilCtrCleanerFiltPrd "Mch.MCU.FOCPHI.EgOilCtrCleanerFiltPrd";
BA_ "VssSig" SG_ 2566902561 DefBreatherFiltPrd "Mch.MCU.FOCPHI.DefBreatherFiltPrd";
BA_ "VssSig" SG_ 2566902561 DefFiltPrd "Mch.MCU.FOCPHI.DefFiltPrd";
BA_ "VssSig" SG_ 2566902561 OilBathPrecleanerPrd "Mch.MCU.FOCPHI.OilBathPrecleanerPrd";
BA_ "VssSig" SG_ 2566902561 DefPrd "Mch.MCU.FOCPHI.DefPrd";
BA_ "VssSig" SG_ 2566902561 AxleOilPrd "Mch.MCU.FOCPHI.AxleOilPrd";
BA_ "VssSig" SG_ 2566902561 TrmsOilFiltPrd "Mch.MCU.FOCPHI.TrmsOilFiltPrd";
BA_ "VssSig" SG_ 2566902561 TrmsOilPrd "Mch.MCU.FOCPHI.TrmsOilPrd";
BA_ "VssSig" SG_ 2566902561 BreatherOilSepFiltPrd "Mch.MCU.FOCPHI.BreatherOilSepFiltPrd";
BA_ "VssSig" SG_ 2566902561 DpfPrd "Mch.MCU.FOCPHI.DpfPrd";
BA_ "VssSig" SG_ 2566902561 CoolPrd "Mch.MCU.FOCPHI.CoolPrd";
BA_ "VssSig" SG_ 2566902561 HydOilPrd "Mch.MCU.FOCPHI.HydOilPrd";
BA_ "VssSig" SG_ 2566902561 EgOilPrd "Mch.MCU.FOCPHI.EgOilPrd";
BA_ "VssSig" SG_ 2566902561 PilotFiltPrd "Mch.MCU.FOCPHI.PilotFiltPrd";
BA_ "VssSig" SG_ 2566902561 RetFiltPrd "Mch.MCU.FOCPHI.RetFiltPrd";
BA_ "VssSig" SG_ 2566902561 EgOilFiltPrd "Mch.MCU.FOCPHI.EgOilFiltPrd";
BA_ "VssSig" SG_ 2566902561 AirCleanerPrd "Mch.MCU.FOCPHI.AirCleanerPrd";
BA_ "VssSig" SG_ 2566902561 FuleFiltPrd "Mch.MCU.FOCPHI.FuleFiltPrd";
BA_ "VssSig" SG_ 2566902817 PmpDrvOilTmp "Mch.MCU.XASI.PmpDrvOilTmp";
BA_ "VssSig" SG_ 2566902817 EvaporatorTmp "Mch.MCU.XASI.EvaporatorTmp";
BA_ "VssSig" SG_ 2566902817 FanSpd "Mch.MCU.XASI.FanSpd";
BA_ "VssSig" SG_ 2566902817 BladeFanPchSsVlt "Mch.MCU.XASI.BladeFanPchSsVlt";
BA_ "VssSig" SG_ 2566902817 RamLckPrs "Mch.MCU.XASI.RamLckPrs";
BA_ "VssSig" SG_ 2566902817 TrailerDnPilotPrs "Mch.MCU.XASI.TrailerDnPilotPrs";
BA_ "VssSig" SG_ 2566902817 BoomHead2Prs "Mch.MCU.XASI.BoomHead2Prs";
BA_ "VssSig" SG_ 2566902817 ArmRodPrs "Mch.MCU.XASI.ArmRodPrs";
BA_ "VssSig" SG_ 2566902817 ArmHEadPrs "Mch.MCU.XASI.ArmHEadPrs";
BA_ "VssSig" SG_ 2566902817 BoodRodPrs "Mch.MCU.XASI.BoodRodPrs";
BA_ "VssSig" SG_ 2566902817 BoomHeadPrs "Mch.MCU.XASI.BoomHeadPrs";
BA_ "VssSig" SG_ 2566902817 BckRodPrsSs "Mch.MCU.XASI.BckRodPrsSs";
BA_ "VssSig" SG_ 2566902817 BckHeadPrsSs "Mch.MCU.XASI.BckHeadPrsSs";
BA_ "VssSig" SG_ 2566902817 TpsVlt "Mch.MCU.XASI.TpsVlt";
BA_ "VssSig" SG_ 2566902817 PchAng "Mch.MCU.XASI.PchAng";
BA_ "VssSig" SG_ 2566902817 RoolAng "Mch.MCU.XASI.RoolAng";
BA_ "VssSig" SG_ 2566902817 TmsSecVlt "Mch.MCU.XASI.TmsSecVlt";
BA_ "VssSig" SG_ 2566902817 VhcTrvlSpdSsFreq "Mch.MCU.XASI.VhcTrvlSpdSsFreq";
BA_ "VssSig" SG_ 2566902817 AirClnDiffPrsSs2 "Mch.MCU.XASI.AirClnDiffPrsSs2";
BA_ "VssSig" SG_ 2566902817 FanClutchSpdSsFdbkSig "Mch.MCU.XASI.FanClutchSpdSsFdbkSig";
BA_ "VssSig" SG_ 2566902817 FlwCtrlLeverRh "Mch.MCU.XASI.FlwCtrlLeverRh";
BA_ "VssSig" SG_ 2566902817 FlwCtrlLeverLh "Mch.MCU.XASI.FlwCtrlLeverLh";
BA_ "VssSig" SG_ 2566902817 FlwCtrlAddLeverLh "Mch.MCU.XASI.FlwCtrlAddLeverLh";
BA_ "VssSig" SG_ 2566902817 AirClnDiffPrsSs1 "Mch.MCU.XASI.AirClnDiffPrsSs1";
BA_ "VssSig" SG_ 2566902817 BatVlt "Mch.MCU.XASI.BatVlt";
BA_ "VssSig" SG_ 2566902817 AltVlt "Mch.MCU.XASI.AltVlt";
BA_ "VssSig" SG_ 2566902817 DzLvrOutVlt "Mch.MCU.XASI.DzLvrOutVlt";
BA_ "VssSig" SG_ 2566902817 WirelessChgStLmpVlt "Mch.MCU.XASI.WirelessChgStLmpVlt";
BA_ "VssSig" SG_ 2566902817 CbElvLvrVlt "Mch.MCU.XASI.CbElvLvrVlt";
BA_ "VssSig" SG_ 2566902817 HydOilTmp "Mch.MCU.XASI.HydOilTmp";
BA_ "VssSig" SG_ 2566902817 MecaCoolTmp "Mch.MCU.XASI.MecaCoolTmp";
BA_ "VssSig" SG_ 2566902817 GndSawDnSsPrs "Mch.MCU.XASI.GndSawDnSsPrs";
BA_ "VssSig" SG_ 2566902817 GndSawUpSsPrs "Mch.MCU.XASI.GndSawUpSsPrs";
BA_ "VssSig" SG_ 2566902817 WifSsVlt "Mch.MCU.XASI.WifSsVlt";
BA_ "VssSig" SG_ 2566902817 FuelLv "Mch.MCU.XASI.FuelLv";
BA_ "VssSig" SG_ 2566902817 FuelLvAddFuelTnk "Mch.MCU.XASI.FuelLvAddFuelTnk";
BA_ "VssSig" SG_ 2566902817 AcpSsPrs "Mch.MCU.XASI.AcpSsPrs";
BA_ "VssSig" SG_ 2566902817 AccPdlVlt "Mch.MCU.XASI.AccPdlVlt";
BA_ "VssSig" SG_ 2566902817 EgCtrlDialVlt "Mch.MCU.XASI.EgCtrlDialVlt";
BA_ "VssSig" SG_ 2566902817 LsPrs "Mch.MCU.XASI.LsPrs";
BA_ "VssSig" SG_ 2566902817 P3NegaconPrs "Mch.MCU.XASI.P3NegaconPrs";
BA_ "VssSig" SG_ 2566902817 RrNegaconPrs "Mch.MCU.XASI.RrNegaconPrs";
BA_ "VssSig" SG_ 2566902817 FrNegaconPrs "Mch.MCU.XASI.FrNegaconPrs";
BA_ "VssSig" SG_ 2566902817 PilotTrvlPtPrs "Mch.MCU.XASI.PilotTrvlPtPrs";
BA_ "VssSig" SG_ 2566902817 PilotWrkPaPrs "Mch.MCU.XASI.PilotWrkPaPrs";
BA_ "VssSig" SG_ 2566902817 ArmLckPrs "Mch.MCU.XASI.ArmLckPrs";
BA_ "VssSig" SG_ 2566902817 BckCrowdConfPrs "Mch.MCU.XASI.BckCrowdConfPrs";
BA_ "VssSig" SG_ 2566902817 ArmCrowdConfPrs "Mch.MCU.XASI.ArmCrowdConfPrs";
BA_ "VssSig" SG_ 2566902817 BoomUpConfPrs "Mch.MCU.XASI.BoomUpConfPrs";
BA_ "VssSig" SG_ 2566902817 Opt3Prs "Mch.MCU.XASI.Opt3Prs";
BA_ "VssSig" SG_ 2566902817 Opt2Prs "Mch.MCU.XASI.Opt2Prs";
BA_ "VssSig" SG_ 2566902817 Opt1Prs "Mch.MCU.XASI.Opt1Prs";
BA_ "VssSig" SG_ 2566902817 SwgPrs "Mch.MCU.XASI.SwgPrs";
BA_ "VssSig" SG_ 2566902817 TrvlLhPrs "Mch.MCU.XASI.TrvlLhPrs";
BA_ "VssSig" SG_ 2566902817 TrvlRhPrs "Mch.MCU.XASI.TrvlRhPrs";
BA_ "VssSig" SG_ 2566902817 BckDumpPrs "Mch.MCU.XASI.BckDumpPrs";
BA_ "VssSig" SG_ 2566902817 BckCrowdPrs "Mch.MCU.XASI.BckCrowdPrs";
BA_ "VssSig" SG_ 2566902817 ArmOutPrs "Mch.MCU.XASI.ArmOutPrs";
BA_ "VssSig" SG_ 2566902817 ArmInPrs "Mch.MCU.XASI.ArmInPrs";
BA_ "VssSig" SG_ 2566902817 BoomDnPrs "Mch.MCU.XASI.BoomDnPrs";
BA_ "VssSig" SG_ 2566902817 BoomUpPrs "Mch.MCU.XASI.BoomUpPrs";
BA_ "VssSig" SG_ 2566902817 EmgStrPrs "Mch.MCU.XASI.EmgStrPrs";
BA_ "VssSig" SG_ 2566902817 Pmp3Ang "Mch.MCU.XASI.Pmp3Ang";
BA_ "VssSig" SG_ 2566902817 RRpmpAng "Mch.MCU.XASI.RRpmpAng";
BA_ "VssSig" SG_ 2566902817 FrPmpAng "Mch.MCU.XASI.FrPmpAng";
BA_ "VssSig" SG_ 2566902817 FuelPrs "Mch.MCU.XASI.FuelPrs";
BA_ "VssSig" SG_ 2566902817 RcwStpVvPrs "Mch.MCU.XASI.RcwStpVvPrs";
BA_ "VssSig" SG_ 2566902817 Pmp3Prs "Mch.MCU.XASI.Pmp3Prs";
BA_ "VssSig" SG_ 2566902817 BoomCylPrs "Mch.MCU.XASI.BoomCylPrs";
BA_ "VssSig" SG_ 2566902817 RrPmpPrs "Mch.MCU.XASI.RrPmpPrs";
BA_ "VssSig" SG_ 2566902817 FrPmpPrs "Mch.MCU.XASI.FrPmpPrs";
BA_ "VssSig" SG_ 2566903073 FanClutchPwmOutSig "Mch.MCU.XAAI.FanClutchPwmOutSig";
BA_ "VssSig" SG_ 2566903073 EfanPwmOutSig "Mch.MCU.XAAI.EfanPwmOutSig";
BA_ "VssSig" SG_ 2566903073 CabDnEppr "Mch.MCU.XAAI.CabDnEppr";
BA_ "VssSig" SG_ 2566903073 CabRaiseEppr "Mch.MCU.XAAI.CabRaiseEppr";
BA_ "VssSig" SG_ 2566903073 VariBladeFanEvc "Mch.MCU.XAAI.VariBladeFanEvc";
BA_ "VssSig" SG_ 2566903073 BoomSwgCcwEvc "Mch.MCU.XAAI.BoomSwgCcwEvc";
BA_ "VssSig" SG_ 2566903073 BoomSwgCwEvc "Mch.MCU.XAAI.BoomSwgCwEvc";
BA_ "VssSig" SG_ 2566903073 TrvlPmpEvc "Mch.MCU.XAAI.TrvlPmpEvc";
BA_ "VssSig" SG_ 2566903073 Pmp3Evc "Mch.MCU.XAAI.Pmp3Evc";
BA_ "VssSig" SG_ 2566903073 DzDnEvc "Mch.MCU.XAAI.DzDnEvc";
BA_ "VssSig" SG_ 2566903073 DzUpEvc "Mch.MCU.XAAI.DzUpEvc";
BA_ "VssSig" SG_ 2566903073 ArtiBoomDnEvc "Mch.MCU.XAAI.ArtiBoomDnEvc";
BA_ "VssSig" SG_ 2566903073 ArtiBoomUpEvc "Mch.MCU.XAAI.ArtiBoomUpEvc";
BA_ "VssSig" SG_ 2566903073 SwgLhEvc "Mch.MCU.XAAI.SwgLhEvc";
BA_ "VssSig" SG_ 2566903073 SwgRhEvc "Mch.MCU.XAAI.SwgRhEvc";
BA_ "VssSig" SG_ 2566903073 TrvlLhRvsEvc "Mch.MCU.XAAI.TrvlLhRvsEvc";
BA_ "VssSig" SG_ 2566903073 TrvlLhFwdEvc "Mch.MCU.XAAI.TrvlLhFwdEvc";
BA_ "VssSig" SG_ 2566903073 TrvlRhRvsEvc "Mch.MCU.XAAI.TrvlRhRvsEvc";
BA_ "VssSig" SG_ 2566903073 TrvlRhFwdEvc "Mch.MCU.XAAI.TrvlRhFwdEvc";
BA_ "VssSig" SG_ 2566903073 BckDumpEvc "Mch.MCU.XAAI.BckDumpEvc";
BA_ "VssSig" SG_ 2566903073 BckCrowdEvc "Mch.MCU.XAAI.BckCrowdEvc";
BA_ "VssSig" SG_ 2566903073 Arm2DumpEvc "Mch.MCU.XAAI.Arm2DumpEvc";
BA_ "VssSig" SG_ 2566903073 Arm2CrowdEvc "Mch.MCU.XAAI.Arm2CrowdEvc";
BA_ "VssSig" SG_ 2566903073 Arm1DumpEvc "Mch.MCU.XAAI.Arm1DumpEvc";
BA_ "VssSig" SG_ 2566903073 Arm1CrowdEvc "Mch.MCU.XAAI.Arm1CrowdEvc";
BA_ "VssSig" SG_ 2566903073 Boom2UpEvc "Mch.MCU.XAAI.Boom2UpEvc";
BA_ "VssSig" SG_ 2566903073 Boom1DnEvc "Mch.MCU.XAAI.Boom1DnEvc";
BA_ "VssSig" SG_ 2566903073 Boom1UpEvc "Mch.MCU.XAAI.Boom1UpEvc";
BA_ "VssSig" SG_ 2566903073 ArmLckEvc "Mch.MCU.XAAI.ArmLckEvc";
BA_ "VssSig" SG_ 2566903073 BckCrowdConfEvc "Mch.MCU.XAAI.BckCrowdConfEvc";
BA_ "VssSig" SG_ 2566903073 ArmCrowdConfEvc "Mch.MCU.XAAI.ArmCrowdConfEvc";
BA_ "VssSig" SG_ 2566903073 BoomUpConfEvc "Mch.MCU.XAAI.BoomUpConfEvc";
BA_ "VssSig" SG_ 2566903073 BypassCutOffBEvc "Mch.MCU.XAAI.BypassCutOffBEvc";
BA_ "VssSig" SG_ 2566903073 BypassCutOffAEvc "Mch.MCU.XAAI.BypassCutOffAEvc";
BA_ "VssSig" SG_ 2566903073 Trvl2PmpCmbEvc "Mch.MCU.XAAI.Trvl2PmpCmbEvc";
BA_ "VssSig" SG_ 2566903073 TrvlFwdEvc "Mch.MCU.XAAI.TrvlFwdEvc";
BA_ "VssSig" SG_ 2566903073 PrsCtrl2Evc "Mch.MCU.XAAI.PrsCtrl2Evc";
BA_ "VssSig" SG_ 2566903073 PrsCtrl1Evc "Mch.MCU.XAAI.PrsCtrl1Evc";
BA_ "VssSig" SG_ 2566903073 RttCcwEvc "Mch.MCU.XAAI.RttCcwEvc";
BA_ "VssSig" SG_ 2566903073 RttCwEvc "Mch.MCU.XAAI.RttCwEvc";
BA_ "VssSig" SG_ 2566903073 TwCloseEvc "Mch.MCU.XAAI.TwCloseEvc";
BA_ "VssSig" SG_ 2566903073 TwOpenEvc "Mch.MCU.XAAI.TwOpenEvc";
BA_ "VssSig" SG_ 2566903073 FlwCtrlEvc "Mch.MCU.XAAI.FlwCtrlEvc";
BA_ "VssSig" SG_ 2566903073 CoolFanEvc "Mch.MCU.XAAI.CoolFanEvc";
BA_ "VssSig" SG_ 2566903073 PmpElecEvc "Mch.MCU.XAAI.PmpElecEvc";
BA_ "VssSig" SG_ 2566903073 Pmp1Evc "Mch.MCU.XAAI.Pmp1Evc";
BA_ "VssSig" SG_ 2566903329 PowerdStariwayProxSw "Mch.MCU.XDSI.PowerdStariwayProxSw";
BA_ "VssSig" SG_ 2566903329 KeySwAccSlave "Mch.MCU.XDSI.KeySwAccSlave";
BA_ "VssSig" SG_ 2566903329 KeySwAccMaster "Mch.MCU.XDSI.KeySwAccMaster";
BA_ "VssSig" SG_ 2566903329 KeySwBrSlave "Mch.MCU.XDSI.KeySwBrSlave";
BA_ "VssSig" SG_ 2566903329 SeatBeltSw "Mch.MCU.XDSI.SeatBeltSw";
BA_ "VssSig" SG_ 2566903329 Efan3ErrorSt "Mch.MCU.XDSI.Efan3ErrorSt";
BA_ "VssSig" SG_ 2566903329 Efan2ErrorSt "Mch.MCU.XDSI.Efan2ErrorSt";
BA_ "VssSig" SG_ 2566903329 Efan1ErrorSt "Mch.MCU.XDSI.Efan1ErrorSt";
BA_ "VssSig" SG_ 2566903329 AgsSw "Mch.MCU.XDSI.AgsSw";
BA_ "VssSig" SG_ 2566903329 SwgLPltPrsSw "Mch.MCU.XDSI.SwgLPltPrsSw";
BA_ "VssSig" SG_ 2566903329 SwgRPltPrsSw "Mch.MCU.XDSI.SwgRPltPrsSw";
BA_ "VssSig" SG_ 2566903329 FineSwgSw "Mch.MCU.XDSI.FineSwgSw";
BA_ "VssSig" SG_ 2566903329 CbLwPosSw "Mch.MCU.XDSI.CbLwPosSw";
BA_ "VssSig" SG_ 2566903329 CbElvActSw "Mch.MCU.XDSI.CbElvActSw";
BA_ "VssSig" SG_ 2566903329 MainStRpmpPrsSw "Mch.MCU.XDSI.MainStRpmpPrsSw";
BA_ "VssSig" SG_ 2566903329 GndSawInitSw "Mch.MCU.XDSI.GndSawInitSw";
BA_ "VssSig" SG_ 2566903329 FanErrSig "Mch.MCU.XDSI.FanErrSig";
BA_ "VssSig" SG_ 2566903329 HydWakeUpSw "Mch.MCU.XDSI.HydWakeUpSw";
BA_ "VssSig" SG_ 2566903329 EmgStpSw "Mch.MCU.XDSI.EmgStpSw";
BA_ "VssSig" SG_ 2566903329 HhVltChgSw "Mch.MCU.XDSI.HhVltChgSw";
BA_ "VssSig" SG_ 2566903329 PrkBrkPrsSw "Mch.MCU.XDSI.PrkBrkPrsSw";
BA_ "VssSig" SG_ 2566903329 RamLckRvsSw "Mch.MCU.XDSI.RamLckRvsSw";
BA_ "VssSig" SG_ 2566903329 AirCompPrsSw "Mch.MCU.XDSI.AirCompPrsSw";
BA_ "VssSig" SG_ 2566903329 Mg2DJoyTrigSw "Mch.MCU.XDSI.Mg2DJoyTrigSw";
BA_ "VssSig" SG_ 2566903329 KeySwBr "Mch.MCU.XDSI.KeySwBr";
BA_ "VssSig" SG_ 2566903329 TwSwSelSw "Mch.MCU.XDSI.TwSwSelSw";
BA_ "VssSig" SG_ 2566903329 DzOutSw "Mch.MCU.XDSI.DzOutSw";
BA_ "VssSig" SG_ 2566903329 MrrHtSw "Mch.MCU.XDSI.MrrHtSw";
BA_ "VssSig" SG_ 2566903329 SwgAlignSw "Mch.MCU.XDSI.SwgAlignSw";
BA_ "VssSig" SG_ 2566903329 MultiFuncSw "Mch.MCU.XDSI.MultiFuncSw";
BA_ "VssSig" SG_ 2566903329 AutoDigSw "Mch.MCU.XDSI.AutoDigSw";
BA_ "VssSig" SG_ 2566903329 TrvlPmpHhSpdSw "Mch.MCU.XDSI.TrvlPmpHhSpdSw";
BA_ "VssSig" SG_ 2566903329 DoorSw "Mch.MCU.XDSI.DoorSw";
BA_ "VssSig" SG_ 2566903329 RrAxleRhHallSsSw "Mch.MCU.XDSI.RrAxleRhHallSsSw";
BA_ "VssSig" SG_ 2566903329 RrAxleLhHallSsSw "Mch.MCU.XDSI.RrAxleLhHallSsSw";
BA_ "VssSig" SG_ 2566903329 FrAxleHallSsSw "Mch.MCU.XDSI.FrAxleHallSsSw";
BA_ "VssSig" SG_ 2566903329 QckCouplerRhSw "Mch.MCU.XDSI.QckCouplerRhSw";
BA_ "VssSig" SG_ 2566903329 QckCouplerLhSw "Mch.MCU.XDSI.QckCouplerLhSw";
BA_ "VssSig" SG_ 2566903329 PowMdSw "Mch.MCU.XDSI.PowMdSw";
BA_ "VssSig" SG_ 2566903329 WrkMdSw "Mch.MCU.XDSI.WrkMdSw";
BA_ "VssSig" SG_ 2566903329 AuxMdSelSw "Mch.MCU.XDSI.AuxMdSelSw";
BA_ "VssSig" SG_ 2566903329 SwgBrkRlsSw "Mch.MCU.XDSI.SwgBrkRlsSw";
BA_ "VssSig" SG_ 2566903329 BrkrFltSw "Mch.MCU.XDSI.BrkrFltSw";
BA_ "VssSig" SG_ 2566903329 SwgPriSw "Mch.MCU.XDSI.SwgPriSw";
BA_ "VssSig" SG_ 2566903329 RttCwSw "Mch.MCU.XDSI.RttCwSw";
BA_ "VssSig" SG_ 2566903329 RttCcwSw "Mch.MCU.XDSI.RttCcwSw";
BA_ "VssSig" SG_ 2566903329 WiperWasherSw "Mch.MCU.XDSI.WiperWasherSw";
BA_ "VssSig" SG_ 2566903329 WiperContSw "Mch.MCU.XDSI.WiperContSw";
BA_ "VssSig" SG_ 2566903329 Wiper2StepSw "Mch.MCU.XDSI.Wiper2StepSw";
BA_ "VssSig" SG_ 2566903329 Wiper1StepSw "Mch.MCU.XDSI.Wiper1StepSw";
BA_ "VssSig" SG_ 2566903329 TmsSt "Mch.MCU.XDSI.TmsSt";
BA_ "VssSig" SG_ 2566903329 ArtiBoomPrsSw "Mch.MCU.XDSI.ArtiBoomPrsSw";
BA_ "VssSig" SG_ 2566903329 CoolLvSw "Mch.MCU.XDSI.CoolLvSw";
BA_ "VssSig" SG_ 2566903329 RttOprSw "Mch.MCU.XDSI.RttOprSw";
BA_ "VssSig" SG_ 2566903329 TwCloseOprSw "Mch.MCU.XDSI.TwCloseOprSw";
BA_ "VssSig" SG_ 2566903329 TwOpenOprSw "Mch.MCU.XDSI.TwOpenOprSw";
BA_ "VssSig" SG_ 2566903329 RcwCloseSw "Mch.MCU.XDSI.RcwCloseSw";
BA_ "VssSig" SG_ 2566903329 RcwOprSw "Mch.MCU.XDSI.RcwOprSw";
BA_ "VssSig" SG_ 2566903329 EmgEgStpSw "Mch.MCU.XDSI.EmgEgStpSw";
BA_ "VssSig" SG_ 2566903329 OwOptPdlPrsSw "Mch.MCU.XDSI.OwOptPdlPrsSw";
BA_ "VssSig" SG_ 2566903329 SpcSw "Mch.MCU.XDSI.SpcSw";
BA_ "VssSig" SG_ 2566903329 IhbSw "Mch.MCU.XDSI.IhbSw";
BA_ "VssSig" SG_ 2566903329 TrvlAlmSelSw "Mch.MCU.XDSI.TrvlAlmSelSw";
BA_ "VssSig" SG_ 2566903329 SwgAlmSelSw "Mch.MCU.XDSI.SwgAlmSelSw";
BA_ "VssSig" SG_ 2566903329 EmgStrSw "Mch.MCU.XDSI.EmgStrSw";
BA_ "VssSig" SG_ 2566903329 HhBeamSw "Mch.MCU.XDSI.HhBeamSw";
BA_ "VssSig" SG_ 2566903329 StpLmp "Mch.MCU.XDSI.StpLmp";
BA_ "VssSig" SG_ 2566903329 AccPdlSw "Mch.MCU.XDSI.AccPdlSw";
BA_ "VssSig" SG_ 2566903329 BrkPrsSw "Mch.MCU.XDSI.BrkPrsSw";
BA_ "VssSig" SG_ 2566903329 Cruise "Mch.MCU.XDSI.Cruise";
BA_ "VssSig" SG_ 2566903329 EgOilPrsSw "Mch.MCU.XDSI.EgOilPrsSw";
BA_ "VssSig" SG_ 2566903329 WrkPxPrsSw "Mch.MCU.XDSI.WrkPxPrsSw";
BA_ "VssSig" SG_ 2566903329 TrvlPyPrsSw "Mch.MCU.XDSI.TrvlPyPrsSw";
BA_ "VssSig" SG_ 2566903329 IgnSw "Mch.MCU.XDSI.IgnSw";
BA_ "VssSig" SG_ 2566903329 RamLckAutoSw "Mch.MCU.XDSI.RamLckAutoSw";
BA_ "VssSig" SG_ 2566903329 PreHt "Mch.MCU.XDSI.PreHt";
BA_ "VssSig" SG_ 2566903329 WifWrn "Mch.MCU.XDSI.WifWrn";
BA_ "VssSig" SG_ 2566903329 SwgPrsSw "Mch.MCU.XDSI.SwgPrsSw";
BA_ "VssSig" SG_ 2566903329 JoyPtnBhl "Mch.MCU.XDSI.JoyPtnBhl";
BA_ "VssSig" SG_ 2566903329 JoyPtnIso "Mch.MCU.XDSI.JoyPtnIso";
BA_ "VssSig" SG_ 2566903329 RvsFanSw "Mch.MCU.XDSI.RvsFanSw";
BA_ "VssSig" SG_ 2566903329 TwOptPdlPrsSw "Mch.MCU.XDSI.TwOptPdlPrsSw";
BA_ "VssSig" SG_ 2566903329 BrkOilPrsWrn "Mch.MCU.XDSI.BrkOilPrsWrn";
BA_ "VssSig" SG_ 2566903329 OwdWrnSelSw "Mch.MCU.XDSI.OwdWrnSelSw";
BA_ "VssSig" SG_ 2566903329 RetFiltWrn "Mch.MCU.XDSI.RetFiltWrn";
BA_ "VssSig" SG_ 2566903329 PilotFiltWrn "Mch.MCU.XDSI.PilotFiltWrn";
BA_ "VssSig" SG_ 2566903329 AirCleanerWrn "Mch.MCU.XDSI.AirCleanerWrn";
BA_ "VssSig" SG_ 2566903329 PilotCutOffSw "Mch.MCU.XDSI.PilotCutOffSw";
BA_ "VssSig" SG_ 2566903329 ItgtBoomSw "Mch.MCU.XDSI.ItgtBoomSw";
BA_ "VssSig" SG_ 2566903329 OneTouchRedSpdSw "Mch.MCU.XDSI.OneTouchRedSpdSw";
BA_ "VssSig" SG_ 2566903329 RamLckSw "Mch.MCU.XDSI.RamLckSw";
BA_ "VssSig" SG_ 2566903329 PrkSw "Mch.MCU.XDSI.PrkSw";
BA_ "VssSig" SG_ 2566903329 AirCndSw "Mch.MCU.XDSI.AirCndSw";
BA_ "VssSig" SG_ 2566903329 JoyDirSelSw "Mch.MCU.XDSI.JoyDirSelSw";
BA_ "VssSig" SG_ 2566903329 TrvlBwdSw "Mch.MCU.XDSI.TrvlBwdSw";
BA_ "VssSig" SG_ 2566903329 TrvlNtrlSw "Mch.MCU.XDSI.TrvlNtrlSw";
BA_ "VssSig" SG_ 2566903329 TrvlFwdSw "Mch.MCU.XDSI.TrvlFwdSw";
BA_ "VssSig" SG_ 2566903329 HhSpdSelSw "Mch.MCU.XDSI.HhSpdSelSw";
BA_ "VssSig" SG_ 2566903329 LwSpdSelSw "Mch.MCU.XDSI.LwSpdSelSw";
BA_ "VssSig" SG_ 2566903329 InchingSelSw "Mch.MCU.XDSI.InchingSelSw";
BA_ "VssSig" SG_ 2566903329 QckCoupler "Mch.MCU.XDSI.QckCoupler";
BA_ "VssSig" SG_ 2566903329 TwSelSw "Mch.MCU.XDSI.TwSelSw";
BA_ "VssSig" SG_ 2566903329 OnwWaySelSw "Mch.MCU.XDSI.OnwWaySelSw";
BA_ "VssSig" SG_ 2566903329 WrkLmpSw "Mch.MCU.XDSI.WrkLmpSw";
BA_ "VssSig" SG_ 2566903329 AutoTrvl2SpdSw "Mch.MCU.XDSI.AutoTrvl2SpdSw";
BA_ "VssSig" SG_ 2566903329 Trvl2SpdSelSw "Mch.MCU.XDSI.Trvl2SpdSelSw";
BA_ "VssSig" SG_ 2566903329 TrvlSelSw "Mch.MCU.XDSI.TrvlSelSw";
BA_ "VssSig" SG_ 2566903329 BrkrSw "Mch.MCU.XDSI.BrkrSw";
BA_ "VssSig" SG_ 2566903329 PwrMaxSw "Mch.MCU.XDSI.PwrMaxSw";
BA_ "VssSig" SG_ 2566903329 Alt "Mch.MCU.XDSI.Alt";
BA_ "VssSig" SG_ 2566903585 SwgLoadRedSolR "Mch.MCU.XDAI.SwgLoadRedSolR";
BA_ "VssSig" SG_ 2566903585 SwgLoadRedSolF "Mch.MCU.XDAI.SwgLoadRedSolF";
BA_ "VssSig" SG_ 2566903585 OptPriSv "Mch.MCU.XDAI.OptPriSv";
BA_ "VssSig" SG_ 2566903585 PmpDrvCoolSv "Mch.MCU.XDAI.PmpDrvCoolSv";
BA_ "VssSig" SG_ 2566903585 SecondStarterRly "Mch.MCU.XDAI.SecondStarterRly";
BA_ "VssSig" SG_ 2566903585 FuelFilledLmp "Mch.MCU.XDAI.FuelFilledLmp";
BA_ "VssSig" SG_ 2566903585 ExtVocWarnSig "Mch.MCU.XDAI.ExtVocWarnSig";
BA_ "VssSig" SG_ 2566903585 EtpRly "Mch.MCU.XDAI.EtpRly";
BA_ "VssSig" SG_ 2566903585 DesRunSig "Mch.MCU.XDAI.DesRunSig";
BA_ "VssSig" SG_ 2566903585 EngRunOutSig "Mch.MCU.XDAI.EngRunOutSig";
BA_ "VssSig" SG_ 2566903585 AccRly "Mch.MCU.XDAI.AccRly";
BA_ "VssSig" SG_ 2566903585 SelSv "Mch.MCU.XDAI.SelSv";
BA_ "VssSig" SG_ 2566903585 ArmCrowdCutOffSv "Mch.MCU.XDAI.ArmCrowdCutOffSv";
BA_ "VssSig" SG_ 2566903585 ArmDumpCutOffSv "Mch.MCU.XDAI.ArmDumpCutOffSv";
BA_ "VssSig" SG_ 2566903585 EmgStrSv "Mch.MCU.XDAI.EmgStrSv";
BA_ "VssSig" SG_ 2566903585 TrvlRhPilotCutOffSv "Mch.MCU.XDAI.TrvlRhPilotCutOffSv";
BA_ "VssSig" SG_ 2566903585 GndSawMdChangeRly "Mch.MCU.XDAI.GndSawMdChangeRly";
BA_ "VssSig" SG_ 2566903585 HvChgSig "Mch.MCU.XDAI.HvChgSig";
BA_ "VssSig" SG_ 2566903585 FanPwmSig "Mch.MCU.XDAI.FanPwmSig";
BA_ "VssSig" SG_ 2566903585 TrkExpationSv "Mch.MCU.XDAI.TrkExpationSv";
BA_ "VssSig" SG_ 2566903585 HhVltMainRly "Mch.MCU.XDAI.HhVltMainRly";
BA_ "VssSig" SG_ 2566903585 HhVltPreChgRly "Mch.MCU.XDAI.HhVltPreChgRly";
BA_ "VssSig" SG_ 2566903585 PilotBz "Mch.MCU.XDAI.PilotBz";
BA_ "VssSig" SG_ 2566903585 QckChgInd "Mch.MCU.XDAI.QckChgInd";
BA_ "VssSig" SG_ 2566903585 QckChgRly "Mch.MCU.XDAI.QckChgRly";
BA_ "VssSig" SG_ 2566903585 NormChgInd "Mch.MCU.XDAI.NormChgInd";
BA_ "VssSig" SG_ 2566903585 LwVltMainRly "Mch.MCU.XDAI.LwVltMainRly";
BA_ "VssSig" SG_ 2566903585 BoomSwgSelRly "Mch.MCU.XDAI.BoomSwgSelRly";
BA_ "VssSig" SG_ 2566903585 PmpDeratSv "Mch.MCU.XDAI.PmpDeratSv";
BA_ "VssSig" SG_ 2566903585 PrkBrkRly "Mch.MCU.XDAI.PrkBrkRly";
BA_ "VssSig" SG_ 2566903585 RvsLmpRly "Mch.MCU.XDAI.RvsLmpRly";
BA_ "VssSig" SG_ 2566903585 AirCompRly "Mch.MCU.XDAI.AirCompRly";
BA_ "VssSig" SG_ 2566903585 CabLmpRly "Mch.MCU.XDAI.CabLmpRly";
BA_ "VssSig" SG_ 2566903585 AvmWrnSig "Mch.MCU.XDAI.AvmWrnSig";
BA_ "VssSig" SG_ 2566903585 WrkLmpRly "Mch.MCU.XDAI.WrkLmpRly";
BA_ "VssSig" SG_ 2566903585 AirCondCompStpSig "Mch.MCU.XDAI.AirCondCompStpSig";
BA_ "VssSig" SG_ 2566903585 Chmsl "Mch.MCU.XDAI.Chmsl";
BA_ "VssSig" SG_ 2566903585 BoomSusRodSv "Mch.MCU.XDAI.BoomSusRodSv";
BA_ "VssSig" SG_ 2566903585 BoomSusHedSv "Mch.MCU.XDAI.BoomSusHedSv";
BA_ "VssSig" SG_ 2566903585 MrrHt "Mch.MCU.XDAI.MrrHt";
BA_ "VssSig" SG_ 2566903585 ClearLmp "Mch.MCU.XDAI.ClearLmp";
BA_ "VssSig" SG_ 2566903585 HhHeadLmp "Mch.MCU.XDAI.HhHeadLmp";
BA_ "VssSig" SG_ 2566903585 LwHeadLmp "Mch.MCU.XDAI.LwHeadLmp";
BA_ "VssSig" SG_ 2566903585 FineSwgSv "Mch.MCU.XDAI.FineSwgSv";
BA_ "VssSig" SG_ 2566903585 TurnRhSigLmp "Mch.MCU.XDAI.TurnRhSigLmp";
BA_ "VssSig" SG_ 2566903585 TurnLhSigLmp "Mch.MCU.XDAI.TurnLhSigLmp";
BA_ "VssSig" SG_ 2566903585 BeaconRly "Mch.MCU.XDAI.BeaconRly";
BA_ "VssSig" SG_ 2566903585 LightRly "Mch.MCU.XDAI.LightRly";
BA_ "VssSig" SG_ 2566903585 LmpRly "Mch.MCU.XDAI.LmpRly";
BA_ "VssSig" SG_ 2566903585 RamLckSv "Mch.MCU.XDAI.RamLckSv";
BA_ "VssSig" SG_ 2566903585 LwSpdTrvlSv "Mch.MCU.XDAI.LwSpdTrvlSv";
BA_ "VssSig" SG_ 2566903585 TrvlPmpHhSpd2Sv "Mch.MCU.XDAI.TrvlPmpHhSpd2Sv";
BA_ "VssSig" SG_ 2566903585 TrvlPmpHhSpd1Sv "Mch.MCU.XDAI.TrvlPmpHhSpd1Sv";
BA_ "VssSig" SG_ 2566903585 WiperWasherRly "Mch.MCU.XDAI.WiperWasherRly";
BA_ "VssSig" SG_ 2566903585 WiperRly "Mch.MCU.XDAI.WiperRly";
BA_ "VssSig" SG_ 2566903585 AutoShutOffRly "Mch.MCU.XDAI.AutoShutOffRly";
BA_ "VssSig" SG_ 2566903585 AirHtRly "Mch.MCU.XDAI.AirHtRly";
BA_ "VssSig" SG_ 2566903585 GlowPlugPreHhRly2 "Mch.MCU.XDAI.GlowPlugPreHhRly2";
BA_ "VssSig" SG_ 2566903585 GlowPlugPreHhRly1 "Mch.MCU.XDAI.GlowPlugPreHhRly1";
BA_ "VssSig" SG_ 2566903585 HhSpdRly "Mch.MCU.XDAI.HhSpdRly";
BA_ "VssSig" SG_ 2566903585 LwSpdRly "Mch.MCU.XDAI.LwSpdRly";
BA_ "VssSig" SG_ 2566903585 InchingRly "Mch.MCU.XDAI.InchingRly";
BA_ "VssSig" SG_ 2566903585 SpareRly "Mch.MCU.XDAI.SpareRly";
BA_ "VssSig" SG_ 2566903585 BackBzRly "Mch.MCU.XDAI.BackBzRly";
BA_ "VssSig" SG_ 2566903585 StartRly "Mch.MCU.XDAI.StartRly";
BA_ "VssSig" SG_ 2566903585 AutoBrkSv "Mch.MCU.XDAI.AutoBrkSv";
BA_ "VssSig" SG_ 2566903585 PilotCutOffSv "Mch.MCU.XDAI.PilotCutOffSv";
BA_ "VssSig" SG_ 2566903585 McvEpprCutOffSv "Mch.MCU.XDAI.McvEpprCutOffSv";
BA_ "VssSig" SG_ 2566903585 BsSpoolSc "Mch.MCU.XDAI.BsSpoolSc";
BA_ "VssSig" SG_ 2566903585 QckCouplerSv "Mch.MCU.XDAI.QckCouplerSv";
BA_ "VssSig" SG_ 2566903585 FreeBoomDnSv "Mch.MCU.XDAI.FreeBoomDnSv";
BA_ "VssSig" SG_ 2566903585 FreeBoomUpSv "Mch.MCU.XDAI.FreeBoomUpSv";
BA_ "VssSig" SG_ 2566903585 TrvlStrgtSv "Mch.MCU.XDAI.TrvlStrgtSv";
BA_ "VssSig" SG_ 2566903585 RttCcwSv "Mch.MCU.XDAI.RttCcwSv";
BA_ "VssSig" SG_ 2566903585 RttCwSv "Mch.MCU.XDAI.RttCwSv";
BA_ "VssSig" SG_ 2566903585 Trvl2PmpCmbSv "Mch.MCU.XDAI.Trvl2PmpCmbSv";
BA_ "VssSig" SG_ 2566903585 OptPdlSaftySv "Mch.MCU.XDAI.OptPdlSaftySv";
BA_ "VssSig" SG_ 2566903585 ForceRgnSv "Mch.MCU.XDAI.ForceRgnSv";
BA_ "VssSig" SG_ 2566903585 TwOprSv "Mch.MCU.XDAI.TwOprSv";
BA_ "VssSig" SG_ 2566903585 UnloadSv "Mch.MCU.XDAI.UnloadSv";
BA_ "VssSig" SG_ 2566903585 TwRhCloseSv "Mch.MCU.XDAI.TwRhCloseSv";
BA_ "VssSig" SG_ 2566903585 TwRhOpenSv "Mch.MCU.XDAI.TwRhOpenSv";
BA_ "VssSig" SG_ 2566903585 SwgBrkRelSv "Mch.MCU.XDAI.SwgBrkRelSv";
BA_ "VssSig" SG_ 2566903585 BypassCutOffSv "Mch.MCU.XDAI.BypassCutOffSv";
BA_ "VssSig" SG_ 2566903585 RwdSv "Mch.MCU.XDAI.RwdSv";
BA_ "VssSig" SG_ 2566903585 FwdSv "Mch.MCU.XDAI.FwdSv";
BA_ "VssSig" SG_ 2566903585 CruiseSv "Mch.MCU.XDAI.CruiseSv";
BA_ "VssSig" SG_ 2566903585 TwoPmpSelSv "Mch.MCU.XDAI.TwoPmpSelSv";
BA_ "VssSig" SG_ 2566903585 FanRvsSv "Mch.MCU.XDAI.FanRvsSv";
BA_ "VssSig" SG_ 2566903585 BrkrSelSv "Mch.MCU.XDAI.BrkrSelSv";
BA_ "VssSig" SG_ 2566903585 HhSpdTrvlSv "Mch.MCU.XDAI.HhSpdTrvlSv";
BA_ "VssSig" SG_ 2566903585 PowMaxSv "Mch.MCU.XDAI.PowMaxSv";
BA_ "VssSig" SG_ 2566903585 BrkrOprSv "Mch.MCU.XDAI.BrkrOprSv";
BA_ "VssSig" SG_ 2566903841 TmsSecVlt "Mch.MCU.LASI.TmsSecVlt";
BA_ "VssSig" SG_ 2566903841 EvaporatorTmp "Mch.MCU.LASI.EvaporatorTmp";
BA_ "VssSig" SG_ 2566903841 RsvJoy1GripYPos "Mch.MCU.LASI.RsvJoy1GripYPos";
BA_ "VssSig" SG_ 2566903841 Joy1GripYPos "Mch.MCU.LASI.Joy1GripYPos";
BA_ "VssSig" SG_ 2566903841 RsvJoy1YPos "Mch.MCU.LASI.RsvJoy1YPos";
BA_ "VssSig" SG_ 2566903841 Joy1YPos "Mch.MCU.LASI.Joy1YPos";
BA_ "VssSig" SG_ 2566903841 RsvJoy1XPos "Mch.MCU.LASI.RsvJoy1XPos";
BA_ "VssSig" SG_ 2566903841 Joy1XPos "Mch.MCU.LASI.Joy1XPos";
BA_ "VssSig" SG_ 2566903841 EmcvLeverOptB "Mch.MCU.LASI.EmcvLeverOptB";
BA_ "VssSig" SG_ 2566903841 EmcvLeverOptA "Mch.MCU.LASI.EmcvLeverOptA";
BA_ "VssSig" SG_ 2566903841 EmcvLeverBckB "Mch.MCU.LASI.EmcvLeverBckB";
BA_ "VssSig" SG_ 2566903841 EmcvLeverBckA "Mch.MCU.LASI.EmcvLeverBckA";
BA_ "VssSig" SG_ 2566903841 EmcvLeverBoomB "Mch.MCU.LASI.EmcvLeverBoomB";
BA_ "VssSig" SG_ 2566903841 EmcvLeverBoomA "Mch.MCU.LASI.EmcvLeverBoomA";
BA_ "VssSig" SG_ 2566903841 ElecStrVv "Mch.MCU.LASI.ElecStrVv";
BA_ "VssSig" SG_ 2566903841 ElecStrLeverB "Mch.MCU.LASI.ElecStrLeverB";
BA_ "VssSig" SG_ 2566903841 ElecStrLeverA "Mch.MCU.LASI.ElecStrLeverA";
BA_ "VssSig" SG_ 2566903841 AcpSsPrs "Mch.MCU.LASI.AcpSsPrs";
BA_ "VssSig" SG_ 2566903841 FanSpd "Mch.MCU.LASI.FanSpd";
BA_ "VssSig" SG_ 2566903841 BatTmp "Mch.MCU.LASI.BatTmp";
BA_ "VssSig" SG_ 2566903841 AltTmp "Mch.MCU.LASI.AltTmp";
BA_ "VssSig" SG_ 2566903841 AxleOilTmp "Mch.MCU.LASI.AxleOilTmp";
BA_ "VssSig" SG_ 2566903841 HydOilTmp "Mch.MCU.LASI.HydOilTmp";
BA_ "VssSig" SG_ 2566903841 CoolTmp "Mch.MCU.LASI.CoolTmp";
BA_ "VssSig" SG_ 2566903841 OpsSsVlt "Mch.MCU.LASI.OpsSsVlt";
BA_ "VssSig" SG_ 2566903841 WifSsVlt "Mch.MCU.LASI.WifSsVlt";
BA_ "VssSig" SG_ 2566903841 FuelLv "Mch.MCU.LASI.FuelLv";
BA_ "VssSig" SG_ 2566903841 BrkPdlB "Mch.MCU.LASI.BrkPdlB";
BA_ "VssSig" SG_ 2566903841 BrkPdlA "Mch.MCU.LASI.BrkPdlA";
BA_ "VssSig" SG_ 2566903841 AccPdlVlt "Mch.MCU.LASI.AccPdlVlt";
BA_ "VssSig" SG_ 2566903841 BrkChgPriPrs "Mch.MCU.LASI.BrkChgPriPrs";
BA_ "VssSig" SG_ 2566903841 RhThmbWhlVlt "Mch.MCU.LASI.RhThmbWhlVlt";
BA_ "VssSig" SG_ 2566903841 CtlLsPrs "Mch.MCU.LASI.CtlLsPrs";
BA_ "VssSig" SG_ 2566903841 CtlTowSpdPrs "Mch.MCU.LASI.CtlTowSpdPrs";
BA_ "VssSig" SG_ 2566903841 AngSsBckRef "Mch.MCU.LASI.AngSsBckRef";
BA_ "VssSig" SG_ 2566903841 AngSsBck "Mch.MCU.LASI.AngSsBck";
BA_ "VssSig" SG_ 2566903841 AngSsBoomRef "Mch.MCU.LASI.AngSsBoomRef";
BA_ "VssSig" SG_ 2566903841 AngSsBoom "Mch.MCU.LASI.AngSsBoom";
BA_ "VssSig" SG_ 2566903841 CtlBckLoadPrs "Mch.MCU.LASI.CtlBckLoadPrs";
BA_ "VssSig" SG_ 2566903841 CtlEgCtrlDialVlt "Mch.MCU.LASI.CtlEgCtrlDialVlt";
BA_ "VssSig" SG_ 2566903841 PrkBrkPrs "Mch.MCU.LASI.PrkBrkPrs";
BA_ "VssSig" SG_ 2566903841 FanMotPrs "Mch.MCU.LASI.FanMotPrs";
BA_ "VssSig" SG_ 2566903841 BrkOilPrs "Mch.MCU.LASI.BrkOilPrs";
BA_ "VssSig" SG_ 2566903841 StrPrs "Mch.MCU.LASI.StrPrs";
BA_ "VssSig" SG_ 2566903841 BoomRodPrs "Mch.MCU.LASI.BoomRodPrs";
BA_ "VssSig" SG_ 2566903841 BooHeadPrs "Mch.MCU.LASI.BooHeadPrs";
BA_ "VssSig" SG_ 2566903841 MainPrs "Mch.MCU.LASI.MainPrs";
BA_ "VssSig" SG_ 2566904097 FanClutchPwmOutSig "Mch.MCU.LAAI.FanClutchPwmOutSig";
BA_ "VssSig" SG_ 2566904097 CacFanCtrl "Mch.MCU.LAAI.CacFanCtrl";
BA_ "VssSig" SG_ 2566904097 CdsFanCtrl "Mch.MCU.LAAI.CdsFanCtrl";
BA_ "VssSig" SG_ 2566904097 RipperDnEvc "Mch.MCU.LAAI.RipperDnEvc";
BA_ "VssSig" SG_ 2566904097 RipperUpEvc "Mch.MCU.LAAI.RipperUpEvc";
BA_ "VssSig" SG_ 2566904097 BladeAngLhEvc "Mch.MCU.LAAI.BladeAngLhEvc";
BA_ "VssSig" SG_ 2566904097 BladeAngRhEvc "Mch.MCU.LAAI.BladeAngRhEvc";
BA_ "VssSig" SG_ 2566904097 BladeDnEvc "Mch.MCU.LAAI.BladeDnEvc";
BA_ "VssSig" SG_ 2566904097 BladeRaiseEvc "Mch.MCU.LAAI.BladeRaiseEvc";
BA_ "VssSig" SG_ 2566904097 BladeTiltLhEvc "Mch.MCU.LAAI.BladeTiltLhEvc";
BA_ "VssSig" SG_ 2566904097 BladeTiltRhEvc "Mch.MCU.LAAI.BladeTiltRhEvc";
BA_ "VssSig" SG_ 2566904097 EbrkPropPrsRedVv "Mch.MCU.LAAI.EbrkPropPrsRedVv";
BA_ "VssSig" SG_ 2566904097 McvBackPrsEvc "Mch.MCU.LAAI.McvBackPrsEvc";
BA_ "VssSig" SG_ 2566904097 Spool4BEvc "Mch.MCU.LAAI.Spool4BEvc";
BA_ "VssSig" SG_ 2566904097 Spool4AEvc "Mch.MCU.LAAI.Spool4AEvc";
BA_ "VssSig" SG_ 2566904097 Opt2Evc "Mch.MCU.LAAI.Opt2Evc";
BA_ "VssSig" SG_ 2566904097 Opt1Evc "Mch.MCU.LAAI.Opt1Evc";
BA_ "VssSig" SG_ 2566904097 BckDumpEvc "Mch.MCU.LAAI.BckDumpEvc";
BA_ "VssSig" SG_ 2566904097 BoomCrowdEvc "Mch.MCU.LAAI.BoomCrowdEvc";
BA_ "VssSig" SG_ 2566904097 BoomFltEvc "Mch.MCU.LAAI.BoomFltEvc";
BA_ "VssSig" SG_ 2566904097 BoomRaiseEvc "Mch.MCU.LAAI.BoomRaiseEvc";
BA_ "VssSig" SG_ 2566904097 FanCtrlEvc "Mch.MCU.LAAI.FanCtrlEvc";
BA_ "VssSig" SG_ 2566904353 AxleDhlCtrlSw "Mch.MCU.LDSI.AxleDhlCtrlSw";
BA_ "VssSig" SG_ 2566904353 QckCplDisengageSw "Mch.MCU.LDSI.QckCplDisengageSw";
BA_ "VssSig" SG_ 2566904353 RttBeaconSw "Mch.MCU.LDSI.RttBeaconSw";
BA_ "VssSig" SG_ 2566904353 RvsFanManualSw "Mch.MCU.LDSI.RvsFanManualSw";
BA_ "VssSig" SG_ 2566904353 RvsFanAutoSw "Mch.MCU.LDSI.RvsFanAutoSw";
BA_ "VssSig" SG_ 2566904353 Aux8Sw "Mch.MCU.LDSI.Aux8Sw";
BA_ "VssSig" SG_ 2566904353 TwoSpeedSw "Mch.MCU.LDSI.TwoSpeedSw";
BA_ "VssSig" SG_ 2566904353 Aux7Sw "Mch.MCU.LDSI.Aux7Sw";
BA_ "VssSig" SG_ 2566904353 OpsSw "Mch.MCU.LDSI.OpsSw";
BA_ "VssSig" SG_ 2566904353 HhFlowPinK "Mch.MCU.LDSI.HhFlowPinK";
BA_ "VssSig" SG_ 2566904353 HhFlowPinN "Mch.MCU.LDSI.HhFlowPinN";
BA_ "VssSig" SG_ 2566904353 DustInd "Mch.MCU.LDSI.DustInd";
BA_ "VssSig" SG_ 2566904353 FrDoorSw "Mch.MCU.LDSI.FrDoorSw";
BA_ "VssSig" SG_ 2566904353 ArmRestLhSw "Mch.MCU.LDSI.ArmRestLhSw";
BA_ "VssSig" SG_ 2566904353 ArmRestRhSw "Mch.MCU.LDSI.ArmRestRhSw";
BA_ "VssSig" SG_ 2566904353 Spool3LeverSw "Mch.MCU.LDSI.Spool3LeverSw";
BA_ "VssSig" SG_ 2566904353 BckLeverSw "Mch.MCU.LDSI.BckLeverSw";
BA_ "VssSig" SG_ 2566904353 EgOilPrsSw "Mch.MCU.LDSI.EgOilPrsSw";
BA_ "VssSig" SG_ 2566904353 HydLckoutSw "Mch.MCU.LDSI.HydLckoutSw";
BA_ "VssSig" SG_ 2566904353 TractionCtrlSw "Mch.MCU.LDSI.TractionCtrlSw";
BA_ "VssSig" SG_ 2566904353 AirCleanSw "Mch.MCU.LDSI.AirCleanSw";
BA_ "VssSig" SG_ 2566904353 RetFiltSw "Mch.MCU.LDSI.RetFiltSw";
BA_ "VssSig" SG_ 2566904353 QckCouperLckSw "Mch.MCU.LDSI.QckCouperLckSw";
BA_ "VssSig" SG_ 2566904353 DnShftSw "Mch.MCU.LDSI.DnShftSw";
BA_ "VssSig" SG_ 2566904353 PreHt "Mch.MCU.LDSI.PreHt";
BA_ "VssSig" SG_ 2566904353 Joy1XDetentPosSt "Mch.MCU.LDSI.Joy1XDetentPosSt";
BA_ "VssSig" SG_ 2566904353 Joy1YDetentPosSt "Mch.MCU.LDSI.Joy1YDetentPosSt";
BA_ "VssSig" SG_ 2566904353 IhbSw "Mch.MCU.LDSI.IhbSw";
BA_ "VssSig" SG_ 2566904353 HstOilFiltWrn "Mch.MCU.LDSI.HstOilFiltWrn";
BA_ "VssSig" SG_ 2566904353 GrboxOvrTmp "Mch.MCU.LDSI.GrboxOvrTmp";
BA_ "VssSig" SG_ 2566904353 AgsLmp "Mch.MCU.LDSI.AgsLmp";
BA_ "VssSig" SG_ 2566904353 QckCouplerInitSw "Mch.MCU.LDSI.QckCouplerInitSw";
BA_ "VssSig" SG_ 2566904353 PrkSw "Mch.MCU.LDSI.PrkSw";
BA_ "VssSig" SG_ 2566904353 SeatBeltSw "Mch.MCU.LDSI.SeatBeltSw";
BA_ "VssSig" SG_ 2566904353 ReDefrstSw "Mch.MCU.LDSI.ReDefrstSw";
BA_ "VssSig" SG_ 2566904353 HormSw "Mch.MCU.LDSI.HormSw";
BA_ "VssSig" SG_ 2566904353 Fnr2ActSw "Mch.MCU.LDSI.Fnr2ActSw";
BA_ "VssSig" SG_ 2566904353 RearWiperStpSw "Mch.MCU.LDSI.RearWiperStpSw";
BA_ "VssSig" SG_ 2566904353 FrWiperStpSig "Mch.MCU.LDSI.FrWiperStpSig";
BA_ "VssSig" SG_ 2566904353 DpfForceRgnSw "Mch.MCU.LDSI.DpfForceRgnSw";
BA_ "VssSig" SG_ 2566904353 EmgStrPrsSw "Mch.MCU.LDSI.EmgStrPrsSw";
BA_ "VssSig" SG_ 2566904353 MainStrPrsSw "Mch.MCU.LDSI.MainStrPrsSw";
BA_ "VssSig" SG_ 2566904353 AccPdlKd "Mch.MCU.LDSI.AccPdlKd";
BA_ "VssSig" SG_ 2566904353 AccPdlIvs "Mch.MCU.LDSI.AccPdlIvs";
BA_ "VssSig" SG_ 2566904353 PrkBrkPrsSw "Mch.MCU.LDSI.PrkBrkPrsSw";
BA_ "VssSig" SG_ 2566904353 CoolLv "Mch.MCU.LDSI.CoolLv";
BA_ "VssSig" SG_ 2566904353 WghCntSw "Mch.MCU.LDSI.WghCntSw";
BA_ "VssSig" SG_ 2566904353 EmgStpSw "Mch.MCU.LDSI.EmgStpSw";
BA_ "VssSig" SG_ 2566904353 DhlManSw "Mch.MCU.LDSI.DhlManSw";
BA_ "VssSig" SG_ 2566904353 FnrR3 "Mch.MCU.LDSI.FnrR3";
BA_ "VssSig" SG_ 2566904353 FnrN3 "Mch.MCU.LDSI.FnrN3";
BA_ "VssSig" SG_ 2566904353 FnrF3 "Mch.MCU.LDSI.FnrF3";
BA_ "VssSig" SG_ 2566904353 FnrR2 "Mch.MCU.LDSI.FnrR2";
BA_ "VssSig" SG_ 2566904353 FnrN2 "Mch.MCU.LDSI.FnrN2";
BA_ "VssSig" SG_ 2566904353 FnrF2 "Mch.MCU.LDSI.FnrF2";
BA_ "VssSig" SG_ 2566904353 FnrR1 "Mch.MCU.LDSI.FnrR1";
BA_ "VssSig" SG_ 2566904353 FnrN1 "Mch.MCU.LDSI.FnrN1";
BA_ "VssSig" SG_ 2566904353 FnrF1 "Mch.MCU.LDSI.FnrF1";
BA_ "VssSig" SG_ 2566904353 StartBrSw "Mch.MCU.LDSI.StartBrSw";
BA_ "VssSig" SG_ 2566904353 StartAccSw "Mch.MCU.LDSI.StartAccSw";
BA_ "VssSig" SG_ 2566904353 StartCSw "Mch.MCU.LDSI.StartCSw";
BA_ "VssSig" SG_ 2566904353 PilotCutOffSw "Mch.MCU.LDSI.PilotCutOffSw";
BA_ "VssSig" SG_ 2566904353 ArmRestCutOffSw "Mch.MCU.LDSI.ArmRestCutOffSw";
BA_ "VssSig" SG_ 2566904353 ElecStrSelSw "Mch.MCU.LDSI.ElecStrSelSw";
BA_ "VssSig" SG_ 2566904609 DhlSol "Mch.MCU.LDAI.DhlSol";
BA_ "VssSig" SG_ 2566904609 GreenBeacon "Mch.MCU.LDAI.GreenBeacon";
BA_ "VssSig" SG_ 2566904609 Beacon "Mch.MCU.LDAI.Beacon";
BA_ "VssSig" SG_ 2566904609 RrWrkLmp "Mch.MCU.LDAI.RrWrkLmp";
BA_ "VssSig" SG_ 2566904609 FrWrkLmp "Mch.MCU.LDAI.FrWrkLmp";
BA_ "VssSig" SG_ 2566904609 EfanOutSig "Mch.MCU.LDAI.EfanOutSig";
BA_ "VssSig" SG_ 2566904609 RrCabLmpRly "Mch.MCU.LDAI.RrCabLmpRly";
BA_ "VssSig" SG_ 2566904609 FrCabLmpRly "Mch.MCU.LDAI.FrCabLmpRly";
BA_ "VssSig" SG_ 2566904609 HeadLmpRly "Mch.MCU.LDAI.HeadLmpRly";
BA_ "VssSig" SG_ 2566904609 RideCtrlCutOffSv "Mch.MCU.LDAI.RideCtrlCutOffSv";
BA_ "VssSig" SG_ 2566904609 Aux8 "Mch.MCU.LDAI.Aux8";
BA_ "VssSig" SG_ 2566904609 Aux7 "Mch.MCU.LDAI.Aux7";
BA_ "VssSig" SG_ 2566904609 Aux6 "Mch.MCU.LDAI.Aux6";
BA_ "VssSig" SG_ 2566904609 Aux5 "Mch.MCU.LDAI.Aux5";
BA_ "VssSig" SG_ 2566904609 Aux4 "Mch.MCU.LDAI.Aux4";
BA_ "VssSig" SG_ 2566904609 Aux3 "Mch.MCU.LDAI.Aux3";
BA_ "VssSig" SG_ 2566904609 AuxShutOffSv "Mch.MCU.LDAI.AuxShutOffSv";
BA_ "VssSig" SG_ 2566904609 PilotCutOffSv "Mch.MCU.LDAI.PilotCutOffSv";
BA_ "VssSig" SG_ 2566904609 FrWiperRly "Mch.MCU.LDAI.FrWiperRly";
BA_ "VssSig" SG_ 2566904609 SideWasherRly "Mch.MCU.LDAI.SideWasherRly";
BA_ "VssSig" SG_ 2566904609 UreaSuperChgWrnSig "Mch.MCU.LDAI.UreaSuperChgWrnSig";
BA_ "VssSig" SG_ 2566904609 EgRunOutSig "Mch.MCU.LDAI.EgRunOutSig";
BA_ "VssSig" SG_ 2566904609 SideWiperRly "Mch.MCU.LDAI.SideWiperRly";
BA_ "VssSig" SG_ 2566904609 FrWhaserRly "Mch.MCU.LDAI.FrWhaserRly";
BA_ "VssSig" SG_ 2566904609 FrWiperLwSigRly "Mch.MCU.LDAI.FrWiperLwSigRly";
BA_ "VssSig" SG_ 2566904609 FrWiperHhSpdRly "Mch.MCU.LDAI.FrWiperHhSpdRly";
BA_ "VssSig" SG_ 2566904609 LwBeamRly "Mch.MCU.LDAI.LwBeamRly";
BA_ "VssSig" SG_ 2566904609 HhBeamRly "Mch.MCU.LDAI.HhBeamRly";
BA_ "VssSig" SG_ 2566904609 IllmLmpRly "Mch.MCU.LDAI.IllmLmpRly";
BA_ "VssSig" SG_ 2566904609 RttBeaconRly "Mch.MCU.LDAI.RttBeaconRly";
BA_ "VssSig" SG_ 2566904609 TurnSigRhRly "Mch.MCU.LDAI.TurnSigRhRly";
BA_ "VssSig" SG_ 2566904609 TurnSigLhRly "Mch.MCU.LDAI.TurnSigLhRly";
BA_ "VssSig" SG_ 2566904609 HormRly "Mch.MCU.LDAI.HormRly";
BA_ "VssSig" SG_ 2566904609 AccRly "Mch.MCU.LDAI.AccRly";
BA_ "VssSig" SG_ 2566904609 RrWinHtRly "Mch.MCU.LDAI.RrWinHtRly";
BA_ "VssSig" SG_ 2566904609 AutoShutOffRly "Mch.MCU.LDAI.AutoShutOffRly";
BA_ "VssSig" SG_ 2566904609 BackUpBzRly "Mch.MCU.LDAI.BackUpBzRly";
BA_ "VssSig" SG_ 2566904609 MrrHtRly "Mch.MCU.LDAI.MrrHtRly";
BA_ "VssSig" SG_ 2566904609 HuelHtRly "Mch.MCU.LDAI.HuelHtRly";
BA_ "VssSig" SG_ 2566904609 GlowPlugFuelRly "Mch.MCU.LDAI.GlowPlugFuelRly";
BA_ "VssSig" SG_ 2566904609 GlowPlugRly "Mch.MCU.LDAI.GlowPlugRly";
BA_ "VssSig" SG_ 2566904609 EmgStrTestRly "Mch.MCU.LDAI.EmgStrTestRly";
BA_ "VssSig" SG_ 2566904609 RrWasherRly "Mch.MCU.LDAI.RrWasherRly";
BA_ "VssSig" SG_ 2566904609 RrWiperRly "Mch.MCU.LDAI.RrWiperRly";
BA_ "VssSig" SG_ 2566904609 RrWrkCabLmpRly "Mch.MCU.LDAI.RrWrkCabLmpRly";
BA_ "VssSig" SG_ 2566904609 RrWrkRadLmpRly "Mch.MCU.LDAI.RrWrkRadLmpRly";
BA_ "VssSig" SG_ 2566904609 FrWrkLmpRly "Mch.MCU.LDAI.FrWrkLmpRly";
BA_ "VssSig" SG_ 2566904609 ElecStrSaftyRly "Mch.MCU.LDAI.ElecStrSaftyRly";
BA_ "VssSig" SG_ 2566904609 PilotBzRly "Mch.MCU.LDAI.PilotBzRly";
BA_ "VssSig" SG_ 2566904609 LisActRly "Mch.MCU.LDAI.LisActRly";
BA_ "VssSig" SG_ 2566904609 HstCutOffRhSv "Mch.MCU.LDAI.HstCutOffRhSv";
BA_ "VssSig" SG_ 2566904609 HstCutOffLhSv "Mch.MCU.LDAI.HstCutOffLhSv";
BA_ "VssSig" SG_ 2566904609 BckMagnet "Mch.MCU.LDAI.BckMagnet";
BA_ "VssSig" SG_ 2566904609 BoomMagnet "Mch.MCU.LDAI.BoomMagnet";
BA_ "VssSig" SG_ 2566904609 HstCutOffSv "Mch.MCU.LDAI.HstCutOffSv";
BA_ "VssSig" SG_ 2566904609 HydCutOffSv "Mch.MCU.LDAI.HydCutOffSv";
BA_ "VssSig" SG_ 2566904609 StartRly "Mch.MCU.LDAI.StartRly";
BA_ "VssSig" SG_ 2566904609 QckCouplerRly "Mch.MCU.LDAI.QckCouplerRly";
BA_ "VssSig" SG_ 2566904609 EgStpRly "Mch.MCU.LDAI.EgStpRly";
BA_ "VssSig" SG_ 2566904609 PrkBrkRlsSv "Mch.MCU.LDAI.PrkBrkRlsSv";
BA_ "VssSig" SG_ 2566904609 EscortWrkLmpRly "Mch.MCU.LDAI.EscortWrkLmpRly";
BA_ "VssSig" SG_ 2566904609 AxleOilCoolSv "Mch.MCU.LDAI.AxleOilCoolSv";
BA_ "VssSig" SG_ 2566904609 UnloadSv "Mch.MCU.LDAI.UnloadSv";
BA_ "VssSig" SG_ 2566904609 BrkChgSv "Mch.MCU.LDAI.BrkChgSv";
BA_ "VssSig" SG_ 2566904609 RvsFanSV "Mch.MCU.LDAI.RvsFanSV";
BA_ "VssSig" SG_ 2566904865 EcuMaker2 "Mch.MCU.CETI.EcuMaker2";
BA_ "VssSig" SG_ 2566904865 MchMaker "Mch.MCU.CETI.MchMaker";
BA_ "VssSig" SG_ 2566904865 SalesRegion "Mch.MCU.CETI.SalesRegion";
BA_ "VssSig" SG_ 2566904865 TcuType "Mch.MCU.CETI.TcuType";
BA_ "VssSig" SG_ 2566904865 JoyType "Mch.MCU.CETI.JoyType";
BA_ "VssSig" SG_ 2566904865 McvCtrlType "Mch.MCU.CETI.McvCtrlType";
BA_ "VssSig" SG_ 2566904865 McvType "Mch.MCU.CETI.McvType";
BA_ "VssSig" SG_ 2566904865 PmpCtrlType "Mch.MCU.CETI.PmpCtrlType";
BA_ "VssSig" SG_ 2566904865 PmpType "Mch.MCU.CETI.PmpType";
BA_ "VssSig" SG_ 2566904865 EcuMaker "Mch.MCU.CETI.EcuMaker";
BA_ "VssSig" SG_ 2566904865 EgMaker "Mch.MCU.CETI.EgMaker";
BA_ "VssSig" SG_ 2566904865 ModelYearVer "Mch.MCU.CETI.ModelYearVer";
BA_ "VssSig" SG_ 2566904865 MchType "Mch.MCU.CETI.MchType";
BA_ "VssSig" SG_ 2566904865 MchClass "Mch.MCU.CETI.MchClass";
BA_ "VssSig" SG_ 2566904865 MchGen "Mch.MCU.CETI.MchGen";
BA_ "VssSig" SG_ 2566904865 EmsCtrl "Mch.MCU.CETI.EmsCtrl";
BA_ "VssSig" SG_ 2566905121 TwUseFlow4 "Mch.MCU.ASDI.TwUseFlow4";
BA_ "VssSig" SG_ 2566905121 TwUseFlow3 "Mch.MCU.ASDI.TwUseFlow3";
BA_ "VssSig" SG_ 2566905121 TwUseFlow2 "Mch.MCU.ASDI.TwUseFlow2";
BA_ "VssSig" SG_ 2566905121 TwUseFlow1 "Mch.MCU.ASDI.TwUseFlow1";
BA_ "VssSig" SG_ 2566905121 TwUseFlow0 "Mch.MCU.ASDI.TwUseFlow0";
BA_ "VssSig" SG_ 2566905121 TwSetFlow4 "Mch.MCU.ASDI.TwSetFlow4";
BA_ "VssSig" SG_ 2566905121 TwSetFlow3 "Mch.MCU.ASDI.TwSetFlow3";
BA_ "VssSig" SG_ 2566905121 TwSetFlow2 "Mch.MCU.ASDI.TwSetFlow2";
BA_ "VssSig" SG_ 2566905121 TwSetFlow1 "Mch.MCU.ASDI.TwSetFlow1";
BA_ "VssSig" SG_ 2566905121 TwSetFlow0 "Mch.MCU.ASDI.TwSetFlow0";
BA_ "VssSig" SG_ 2566905121 TwMinFlowAtt4 "Mch.MCU.ASDI.TwMinFlowAtt4";
BA_ "VssSig" SG_ 2566905121 TwMinFlowAtt3 "Mch.MCU.ASDI.TwMinFlowAtt3";
BA_ "VssSig" SG_ 2566905121 TwMinFlowAtt2 "Mch.MCU.ASDI.TwMinFlowAtt2";
BA_ "VssSig" SG_ 2566905121 TwMinFlowAtt1 "Mch.MCU.ASDI.TwMinFlowAtt1";
BA_ "VssSig" SG_ 2566905121 TwMinFlowAtt0 "Mch.MCU.ASDI.TwMinFlowAtt0";
BA_ "VssSig" SG_ 2566905121 TwMaxFlowAtt4 "Mch.MCU.ASDI.TwMaxFlowAtt4";
BA_ "VssSig" SG_ 2566905121 TwMaxFlowAtt3 "Mch.MCU.ASDI.TwMaxFlowAtt3";
BA_ "VssSig" SG_ 2566905121 TwMaxFlowAtt2 "Mch.MCU.ASDI.TwMaxFlowAtt2";
BA_ "VssSig" SG_ 2566905121 TwMaxFlowAtt1 "Mch.MCU.ASDI.TwMaxFlowAtt1";
BA_ "VssSig" SG_ 2566905121 TwMaxFlowAtt0 "Mch.MCU.ASDI.TwMaxFlowAtt0";
BA_ "VssSig" SG_ 2566905121 TwMaxFlowPmp4 "Mch.MCU.ASDI.TwMaxFlowPmp4";
BA_ "VssSig" SG_ 2566905121 TwMaxFlowPmp3 "Mch.MCU.ASDI.TwMaxFlowPmp3";
BA_ "VssSig" SG_ 2566905121 TwMaxFlowPmp2 "Mch.MCU.ASDI.TwMaxFlowPmp2";
BA_ "VssSig" SG_ 2566905121 TwMaxFlowPmp1 "Mch.MCU.ASDI.TwMaxFlowPmp1";
BA_ "VssSig" SG_ 2566905121 TwMaxFlowPmp0 "Mch.MCU.ASDI.TwMaxFlowPmp0";
BA_ "VssSig" SG_ 2566905121 TwPrs4 "Mch.MCU.ASDI.TwPrs4";
BA_ "VssSig" SG_ 2566905121 TwPrs3 "Mch.MCU.ASDI.TwPrs3";
BA_ "VssSig" SG_ 2566905121 TwPrs2 "Mch.MCU.ASDI.TwPrs2";
BA_ "VssSig" SG_ 2566905121 TwPrs1 "Mch.MCU.ASDI.TwPrs1";
BA_ "VssSig" SG_ 2566905121 TwPrs0 "Mch.MCU.ASDI.TwPrs0";
BA_ "VssSig" SG_ 2566905121 TwRpm4 "Mch.MCU.ASDI.TwRpm4";
BA_ "VssSig" SG_ 2566905121 TwRpm3 "Mch.MCU.ASDI.TwRpm3";
BA_ "VssSig" SG_ 2566905121 TwRpm2 "Mch.MCU.ASDI.TwRpm2";
BA_ "VssSig" SG_ 2566905121 TwRpm1 "Mch.MCU.ASDI.TwRpm1";
BA_ "VssSig" SG_ 2566905121 TwRpm0 "Mch.MCU.ASDI.TwRpm0";
BA_ "VssSig" SG_ 2566905121 Tw4BrkrBtnType "Mch.MCU.ASDI.Tw4BrkrBtnType";
BA_ "VssSig" SG_ 2566905121 Tw4TwoPmpOpt "Mch.MCU.ASDI.Tw4TwoPmpOpt";
BA_ "VssSig" SG_ 2566905121 Tw4SelAttNo "Mch.MCU.ASDI.Tw4SelAttNo";
BA_ "VssSig" SG_ 2566905121 Tw4SelAttType "Mch.MCU.ASDI.Tw4SelAttType";
BA_ "VssSig" SG_ 2566905121 Tw3BrkrBtnType "Mch.MCU.ASDI.Tw3BrkrBtnType";
BA_ "VssSig" SG_ 2566905121 Tw3TwoPmpOpt "Mch.MCU.ASDI.Tw3TwoPmpOpt";
BA_ "VssSig" SG_ 2566905121 Tw3SelAttNo "Mch.MCU.ASDI.Tw3SelAttNo";
BA_ "VssSig" SG_ 2566905121 Tw3SelAttType "Mch.MCU.ASDI.Tw3SelAttType";
BA_ "VssSig" SG_ 2566905121 Tw2BrkrBtnType "Mch.MCU.ASDI.Tw2BrkrBtnType";
BA_ "VssSig" SG_ 2566905121 Tw2TwoPmpOpt "Mch.MCU.ASDI.Tw2TwoPmpOpt";
BA_ "VssSig" SG_ 2566905121 Tw2SelAttNo "Mch.MCU.ASDI.Tw2SelAttNo";
BA_ "VssSig" SG_ 2566905121 Tw2SelAttType "Mch.MCU.ASDI.Tw2SelAttType";
BA_ "VssSig" SG_ 2566905121 Tw1BrkrBtnType "Mch.MCU.ASDI.Tw1BrkrBtnType";
BA_ "VssSig" SG_ 2566905121 Tw1TwoPmpOpt "Mch.MCU.ASDI.Tw1TwoPmpOpt";
BA_ "VssSig" SG_ 2566905121 Tw1SelAttNo "Mch.MCU.ASDI.Tw1SelAttNo";
BA_ "VssSig" SG_ 2566905121 Tw1SelAttType "Mch.MCU.ASDI.Tw1SelAttType";
BA_ "VssSig" SG_ 2566905121 Tw0BrkrBtnType "Mch.MCU.ASDI.Tw0BrkrBtnType";
BA_ "VssSig" SG_ 2566905121 Tw0TwoPmpOpt "Mch.MCU.ASDI.Tw0TwoPmpOpt";
BA_ "VssSig" SG_ 2566905121 Tw0SelAttNo "Mch.MCU.ASDI.Tw0SelAttNo";
BA_ "VssSig" SG_ 2566905121 Tw0SelAttType "Mch.MCU.ASDI.Tw0SelAttType";
BA_ "VssSig" SG_ 2566905121 OwUseFlow4 "Mch.MCU.ASDI.OwUseFlow4";
BA_ "VssSig" SG_ 2566905121 OwUseFlow3 "Mch.MCU.ASDI.OwUseFlow3";
BA_ "VssSig" SG_ 2566905121 OwUseFlow2 "Mch.MCU.ASDI.OwUseFlow2";
BA_ "VssSig" SG_ 2566905121 OwUseFlow1 "Mch.MCU.ASDI.OwUseFlow1";
BA_ "VssSig" SG_ 2566905121 OwUseFlow0 "Mch.MCU.ASDI.OwUseFlow0";
BA_ "VssSig" SG_ 2566905121 OwSetFlow4 "Mch.MCU.ASDI.OwSetFlow4";
BA_ "VssSig" SG_ 2566905121 OwSetFlow3 "Mch.MCU.ASDI.OwSetFlow3";
BA_ "VssSig" SG_ 2566905121 OwSetFlow2 "Mch.MCU.ASDI.OwSetFlow2";
BA_ "VssSig" SG_ 2566905121 OwSetFlow1 "Mch.MCU.ASDI.OwSetFlow1";
BA_ "VssSig" SG_ 2566905121 OwSetFlow0 "Mch.MCU.ASDI.OwSetFlow0";
BA_ "VssSig" SG_ 2566905121 OwMinFlowAtt4 "Mch.MCU.ASDI.OwMinFlowAtt4";
BA_ "VssSig" SG_ 2566905121 OwMinFlowAtt3 "Mch.MCU.ASDI.OwMinFlowAtt3";
BA_ "VssSig" SG_ 2566905121 OwMinFlowAtt2 "Mch.MCU.ASDI.OwMinFlowAtt2";
BA_ "VssSig" SG_ 2566905121 OwMinFlowAtt1 "Mch.MCU.ASDI.OwMinFlowAtt1";
BA_ "VssSig" SG_ 2566905121 OwMinFlowAtt0 "Mch.MCU.ASDI.OwMinFlowAtt0";
BA_ "VssSig" SG_ 2566905121 OwMaxFlowAtt4 "Mch.MCU.ASDI.OwMaxFlowAtt4";
BA_ "VssSig" SG_ 2566905121 OwMaxFlowAtt3 "Mch.MCU.ASDI.OwMaxFlowAtt3";
BA_ "VssSig" SG_ 2566905121 OwMaxFlowAtt2 "Mch.MCU.ASDI.OwMaxFlowAtt2";
BA_ "VssSig" SG_ 2566905121 OwMaxFlowAtt1 "Mch.MCU.ASDI.OwMaxFlowAtt1";
BA_ "VssSig" SG_ 2566905121 OwMaxFlowAtt0 "Mch.MCU.ASDI.OwMaxFlowAtt0";
BA_ "VssSig" SG_ 2566905121 OwMaxFlowPmp4 "Mch.MCU.ASDI.OwMaxFlowPmp4";
BA_ "VssSig" SG_ 2566905121 OwMaxFlowPmp3 "Mch.MCU.ASDI.OwMaxFlowPmp3";
BA_ "VssSig" SG_ 2566905121 OwMaxFlowPmp2 "Mch.MCU.ASDI.OwMaxFlowPmp2";
BA_ "VssSig" SG_ 2566905121 OwMaxFlowPmp1 "Mch.MCU.ASDI.OwMaxFlowPmp1";
BA_ "VssSig" SG_ 2566905121 OwMaxFlowPmp0 "Mch.MCU.ASDI.OwMaxFlowPmp0";
BA_ "VssSig" SG_ 2566905121 OwPrs4 "Mch.MCU.ASDI.OwPrs4";
BA_ "VssSig" SG_ 2566905121 OwPrs3 "Mch.MCU.ASDI.OwPrs3";
BA_ "VssSig" SG_ 2566905121 OwPrs2 "Mch.MCU.ASDI.OwPrs2";
BA_ "VssSig" SG_ 2566905121 OwPrs1 "Mch.MCU.ASDI.OwPrs1";
BA_ "VssSig" SG_ 2566905121 OwPrs0 "Mch.MCU.ASDI.OwPrs0";
BA_ "VssSig" SG_ 2566905121 OwRpm4 "Mch.MCU.ASDI.OwRpm4";
BA_ "VssSig" SG_ 2566905121 OwRpm3 "Mch.MCU.ASDI.OwRpm3";
BA_ "VssSig" SG_ 2566905121 OwRpm2 "Mch.MCU.ASDI.OwRpm2";
BA_ "VssSig" SG_ 2566905121 OwRpm1 "Mch.MCU.ASDI.OwRpm1";
BA_ "VssSig" SG_ 2566905121 OwRpm0 "Mch.MCU.ASDI.OwRpm0";
BA_ "VssSig" SG_ 2566905121 RttCurStep "Mch.MCU.ASDI.RttCurStep";
BA_ "VssSig" SG_ 2566905121 TwCurStep "Mch.MCU.ASDI.TwCurStep";
BA_ "VssSig" SG_ 2566905121 Ow4BrkrBtnType "Mch.MCU.ASDI.Ow4BrkrBtnType";
BA_ "VssSig" SG_ 2566905121 Ow4TwoPmpOpt "Mch.MCU.ASDI.Ow4TwoPmpOpt";
BA_ "VssSig" SG_ 2566905121 Ow4SelAttNo "Mch.MCU.ASDI.Ow4SelAttNo";
BA_ "VssSig" SG_ 2566905121 Ow4SelAttType "Mch.MCU.ASDI.Ow4SelAttType";
BA_ "VssSig" SG_ 2566905121 OwCurStep "Mch.MCU.ASDI.OwCurStep";
BA_ "VssSig" SG_ 2566905121 Ow3BrkrBtnType "Mch.MCU.ASDI.Ow3BrkrBtnType";
BA_ "VssSig" SG_ 2566905121 Ow3TwoPmpOpt "Mch.MCU.ASDI.Ow3TwoPmpOpt";
BA_ "VssSig" SG_ 2566905121 Ow3SelAttNo "Mch.MCU.ASDI.Ow3SelAttNo";
BA_ "VssSig" SG_ 2566905121 Ow3SelAttType "Mch.MCU.ASDI.Ow3SelAttType";
BA_ "VssSig" SG_ 2566905121 Ow2BrkrBtnType "Mch.MCU.ASDI.Ow2BrkrBtnType";
BA_ "VssSig" SG_ 2566905121 Ow2TwoPmpOpt "Mch.MCU.ASDI.Ow2TwoPmpOpt";
BA_ "VssSig" SG_ 2566905121 Ow2SelAttNo "Mch.MCU.ASDI.Ow2SelAttNo";
BA_ "VssSig" SG_ 2566905121 Ow2SelAttType "Mch.MCU.ASDI.Ow2SelAttType";
BA_ "VssSig" SG_ 2566905121 Ow1BrkrBtnType "Mch.MCU.ASDI.Ow1BrkrBtnType";
BA_ "VssSig" SG_ 2566905121 Ow1TwoPmpOpt "Mch.MCU.ASDI.Ow1TwoPmpOpt";
BA_ "VssSig" SG_ 2566905121 Ow1SelAttNo "Mch.MCU.ASDI.Ow1SelAttNo";
BA_ "VssSig" SG_ 2566905121 Ow1SelAttType "Mch.MCU.ASDI.Ow1SelAttType";
BA_ "VssSig" SG_ 2566905121 Ow0BrkrBtnType "Mch.MCU.ASDI.Ow0BrkrBtnType";
BA_ "VssSig" SG_ 2566905121 Ow0TwoPmpOpt "Mch.MCU.ASDI.Ow0TwoPmpOpt";
BA_ "VssSig" SG_ 2566905121 Ow0SelAttNo "Mch.MCU.ASDI.Ow0SelAttNo";
BA_ "VssSig" SG_ 2566905121 Ow0SelAttType "Mch.MCU.ASDI.Ow0SelAttType";
BA_ "VssSig" SG_ 2566905121 MaxFlow "Mch.MCU.ASDI.MaxFlow";
BA_ "VssSig" SG_ 2566905121 MinFlow "Mch.MCU.ASDI.MinFlow";
BA_ "VssSig" SG_ 2566905121 MaxPrsTw "Mch.MCU.ASDI.MaxPrsTw";
BA_ "VssSig" SG_ 2566905121 MinPrsTw "Mch.MCU.ASDI.MinPrsTw";
BA_ "VssSig" SG_ 2566905121 MaxPrsOw "Mch.MCU.ASDI.MaxPrsOw";
BA_ "VssSig" SG_ 2566905121 MinPrsOw "Mch.MCU.ASDI.MinPrsOw";
BA_ "VssSig" SG_ 2566905121 MaxSpd "Mch.MCU.ASDI.MaxSpd";
BA_ "VssSig" SG_ 2566905121 MinSpd "Mch.MCU.ASDI.MinSpd";
BA_ "VssSig" SG_ 2566905121 SelAttTw "Mch.MCU.ASDI.SelAttTw";
BA_ "VssSig" SG_ 2566905121 SelAttOw "Mch.MCU.ASDI.SelAttOw";
BA_ "VssSig" SG_ 2566905377 PSmartMd "Mch.MCU.FUDI.PSmartMd";
BA_ "VssSig" SG_ 2566905377 TotFuelUsed "Mch.MCU.FUDI.TotFuelUsed";
BA_ "VssSig" SG_ 2566905377 LiftMd "Mch.MCU.FUDI.LiftMd";
BA_ "VssSig" SG_ 2566905377 TrvlStd "Mch.MCU.FUDI.TrvlStd";
BA_ "VssSig" SG_ 2566905377 TrvlPow "Mch.MCU.FUDI.TrvlPow";
BA_ "VssSig" SG_ 2566905377 Idle "Mch.MCU.FUDI.Idle";
BA_ "VssSig" SG_ 2566905377 AutoIdle "Mch.MCU.FUDI.AutoIdle";
BA_ "VssSig" SG_ 2566905377 EcnMd "Mch.MCU.FUDI.EcnMd";
BA_ "VssSig" SG_ 2566905377 StdMd "Mch.MCU.FUDI.StdMd";
BA_ "VssSig" SG_ 2566905377 PowMd "Mch.MCU.FUDI.PowMd";
BA_ "VssSig" SG_ 2566905377 PowPlusMd "Mch.MCU.FUDI.PowPlusMd";
BA_ "VssSig" SG_ 2566905633 AcptPrsAbove2600 "Mch.MCU.UHDI.AcptPrsAbove2600";
BA_ "VssSig" SG_ 2566905633 AcptPrs21002500 "Mch.MCU.UHDI.AcptPrs21002500";
BA_ "VssSig" SG_ 2566905633 AcptPrs16002000 "Mch.MCU.UHDI.AcptPrs16002000";
BA_ "VssSig" SG_ 2566905633 AcptPrs10001500 "Mch.MCU.UHDI.AcptPrs10001500";
BA_ "VssSig" SG_ 2566905633 AcptPrsBelow900 "Mch.MCU.UHDI.AcptPrsBelow900";
BA_ "VssSig" SG_ 2566905633 HydOilTmpAbove16 "Mch.MCU.UHDI.HydOilTmpAbove16";
BA_ "VssSig" SG_ 2566905633 HydOilTmp11to15 "Mch.MCU.UHDI.HydOilTmp11to15";
BA_ "VssSig" SG_ 2566905633 HydOilTmp5to10 "Mch.MCU.UHDI.HydOilTmp5to10";
BA_ "VssSig" SG_ 2566905633 EvaporatorTmpBelow4 "Mch.MCU.UHDI.EvaporatorTmpBelow4";
BA_ "VssSig" SG_ 2566905633 PSmartMd "Mch.MCU.UHDI.PSmartMd";
BA_ "VssSig" SG_ 2566905633 TotOprHr "Mch.MCU.UHDI.TotOprHr";
BA_ "VssSig" SG_ 2566905633 CoolTempAbove106 "Mch.MCU.UHDI.CoolTempAbove106";
BA_ "VssSig" SG_ 2566905633 CoolTemp101105 "Mch.MCU.UHDI.CoolTemp101105";
BA_ "VssSig" SG_ 2566905633 CoolTemp96100 "Mch.MCU.UHDI.CoolTemp96100";
BA_ "VssSig" SG_ 2566905633 CoolTemp9195 "Mch.MCU.UHDI.CoolTemp9195";
BA_ "VssSig" SG_ 2566905633 CoolTemp8190 "Mch.MCU.UHDI.CoolTemp8190";
BA_ "VssSig" SG_ 2566905633 CoolTempBelow80 "Mch.MCU.UHDI.CoolTempBelow80";
BA_ "VssSig" SG_ 2566905633 HydOilTmpAbove96 "Mch.MCU.UHDI.HydOilTmpAbove96";
BA_ "VssSig" SG_ 2566905633 HydOilTmp9195 "Mch.MCU.UHDI.HydOilTmp9195";
BA_ "VssSig" SG_ 2566905633 HydOilTmp8190 "Mch.MCU.UHDI.HydOilTmp8190";
BA_ "VssSig" SG_ 2566905633 HydOilTmp7180 "Mch.MCU.UHDI.HydOilTmp7180";
BA_ "VssSig" SG_ 2566905633 HydOilTmp5170 "Mch.MCU.UHDI.HydOilTmp5170";
BA_ "VssSig" SG_ 2566905633 HydOilTmpBelow50 "Mch.MCU.UHDI.HydOilTmpBelow50";
BA_ "VssSig" SG_ 2566905633 TwMd "Mch.MCU.UHDI.TwMd";
BA_ "VssSig" SG_ 2566905633 BrkrMd "Mch.MCU.UHDI.BrkrMd";
BA_ "VssSig" SG_ 2566905633 LiftMd "Mch.MCU.UHDI.LiftMd";
BA_ "VssSig" SG_ 2566905633 TrvlStd "Mch.MCU.UHDI.TrvlStd";
BA_ "VssSig" SG_ 2566905633 TrvlPow "Mch.MCU.UHDI.TrvlPow";
BA_ "VssSig" SG_ 2566905633 Idle "Mch.MCU.UHDI.Idle";
BA_ "VssSig" SG_ 2566905633 AutoIdle "Mch.MCU.UHDI.AutoIdle";
BA_ "VssSig" SG_ 2566905633 EcnMd "Mch.MCU.UHDI.EcnMd";
BA_ "VssSig" SG_ 2566905633 StdMd "Mch.MCU.UHDI.StdMd";
BA_ "VssSig" SG_ 2566905633 PowMd "Mch.MCU.UHDI.PowMd";
BA_ "VssSig" SG_ 2566905633 PowPlusMd "Mch.MCU.UHDI.PowPlusMd";
BA_ "VssSig" SG_ 2566905889 Afc7 "Mch.MCU.RTFI.Afc7";
BA_ "VssSig" SG_ 2566905889 Afc6 "Mch.MCU.RTFI.Afc6";
BA_ "VssSig" SG_ 2566905889 Afc5 "Mch.MCU.RTFI.Afc5";
BA_ "VssSig" SG_ 2566905889 Afc4 "Mch.MCU.RTFI.Afc4";
BA_ "VssSig" SG_ 2566905889 Afc3 "Mch.MCU.RTFI.Afc3";
BA_ "VssSig" SG_ 2566905889 Afc2 "Mch.MCU.RTFI.Afc2";
BA_ "VssSig" SG_ 2566905889 Afc1 "Mch.MCU.RTFI.Afc1";
BA_ "VssSig" SG_ 2566906145 RealTimeFailNCdFmi "Mch.MCU.FLI.RealTimeFailNCdFmi";
BA_ "VssSig" SG_ 2566906145 RealTimeFail6CdFmi "Mch.MCU.FLI.RealTimeFail6CdFmi";
BA_ "VssSig" SG_ 2566906145 RealTimeFail5CdFmi "Mch.MCU.FLI.RealTimeFail5CdFmi";
BA_ "VssSig" SG_ 2566906145 RealTimeFail4CdFmi "Mch.MCU.FLI.RealTimeFail4CdFmi";
BA_ "VssSig" SG_ 2566906145 RealTimeFail3CdFmi "Mch.MCU.FLI.RealTimeFail3CdFmi";
BA_ "VssSig" SG_ 2566906145 RealTimeFail2CdFmi "Mch.MCU.FLI.RealTimeFail2CdFmi";
BA_ "VssSig" SG_ 2566906145 RealTimeFail1CdFmi "Mch.MCU.FLI.RealTimeFail1CdFmi";
BA_ "VssSig" SG_ 2566906657 SecSt "Mch.MCU.TSS.SecSt";
BA_ "VssSig" SG_ 2566906657 TmsSecCode "Mch.MCU.TSS.TmsSecCode";
BA_ "VssSig" SG_ 2566907169 McuSwVerYear "Mch.MCU.VSWVER.McuSwVerYear";
BA_ "VssSig" SG_ 2566907169 McuSwVerDay "Mch.MCU.VSWVER.McuSwVerDay";
BA_ "VssSig" SG_ 2566907169 McuSwVerMonth "Mch.MCU.VSWVER.McuSwVerMonth";
BA_ "VssSig" SG_ 2566907169 McuSwVer "Mch.MCU.VSWVER.McuSwVer";
BA_ "VssSig" SG_ 2566907681 IccoFunCrcmdScore "Mch.MCU.ECOGI.IccoFunCrcmdScore";
BA_ "VssSig" SG_ 2566907681 UnssHydReliefScore "Mch.MCU.ECOGI.UnssHydReliefScore";
BA_ "VssSig" SG_ 2566907681 InIntentBrkPreventScore "Mch.MCU.ECOGI.InIntentBrkPreventScore";
BA_ "VssSig" SG_ 2566907681 EmgStpPreventScore "Mch.MCU.ECOGI.EmgStpPreventScore";
BA_ "VssSig" SG_ 2566907681 EgMdDnRcmdScore "Mch.MCU.ECOGI.EgMdDnRcmdScore";
BA_ "VssSig" SG_ 2566907681 LckUpRcmdScore "Mch.MCU.ECOGI.LckUpRcmdScore";
BA_ "VssSig" SG_ 2566907681 GrNeutRpmUpScore "Mch.MCU.ECOGI.GrNeutRpmUpScore";
BA_ "VssSig" SG_ 2566907681 IdlePrvtScore "Mch.MCU.ECOGI.IdlePrvtScore";
BA_ "VssSig" SG_ 2566907681 ManGrMaxSpdRcmdScore "Mch.MCU.ECOGI.ManGrMaxSpdRcmdScore";
BA_ "VssSig" SG_ 2566907681 Auto14RcmdScore "Mch.MCU.ECOGI.Auto14RcmdScore";
BA_ "VssSig" SG_ 2566907681 LisVhcSpdSetDnChngRcmdScore "Mch.MCU.ECOGI.LisVhcSpdSetDnChngRcmdScore";
BA_ "VssSig" SG_ 2566907681 LisVhcSpdSetUpChngRcmdScore "Mch.MCU.ECOGI.LisVhcSpdSetUpChngRcmdScore";
BA_ "VssSig" SG_ 2566907681 LisFunCrcmdScore "Mch.MCU.ECOGI.LisFunCrcmdScore";
BA_ "VssSig" SG_ 2566907681 EcoGudCtrl "Mch.MCU.ECOGI.EcoGudCtrl";
VAL_ 2566903329 PowerdStariwayProxSw 0 "OFF" 1 "ON" 2 "ERROR" 3 "NOT_AVAILABLE" ;
VAL_ 2566903329 KeySwAccSlave 0 "OFF" 1 "ON" 2 "ERROR" 3 "NOT_AVAILABLE" ;
VAL_ 2566903329 KeySwAccMaster 0 "OFF" 1 "ON" 2 "ERROR" 3 "NOT_AVAILABLE" ;
VAL_ 2566903329 KeySwBrSlave 0 "OFF" 1 "ON" 2 "ERROR" 3 "NOT_AVAILABLE" ;
VAL_ 2566903329 SeatBeltSw 0 "OFF" 1 "ON" 2 "ERROR" 3 "NOT_AVAILABLE" ;
VAL_ 2566903329 Efan3ErrorSt 0 "OFF" 1 "ON" 2 "ERROR" 3 "NOT_AVAILABLE" ;
VAL_ 2566903329 Efan2ErrorSt 0 "OFF" 1 "ON" 2 "ERROR" 3 "NOT_AVAILABLE" ;
VAL_ 2566903329 Efan1ErrorSt 0 "OFF" 1 "ON" 2 "ERROR" 3 "NOT_AVAILABLE" ;
VAL_ 2566903329 AgsSw 0 "OFF" 1 "ON" 2 "ERROR" 3 "NOT_AVAILABLE" ;
VAL_ 2566903329 SwgLPltPrsSw 0 "OFF" 1 "ON" 2 "ERROR" 3 "NOT_AVAILABLE" ;
VAL_ 2566903329 SwgRPltPrsSw 0 "OFF" 1 "ON" 2 "ERROR" 3 "NOT_AVAILABLE" ;
VAL_ 2566903329 FineSwgSw 0 "OFF" 1 "ON" 2 "ERROR" 3 "NOT_AVAILABLE" ;
VAL_ 2566903329 CbLwPosSw 0 "OFF" 1 "ON" 2 "ERROR" 3 "NOT_AVAILABLE" ;
VAL_ 2566903329 CbElvActSw 0 "OFF" 1 "ON" 2 "ERROR" 3 "NOT_AVAILABLE" ;
VAL_ 2566903329 MainStRpmpPrsSw 0 "OFF" 1 "ON" 2 "ERROR" 3 "NOT_AVAILABLE" ;
VAL_ 2566903329 GndSawInitSw 0 "OFF" 1 "ON" 2 "ERROR" 3 "NOT_AVAILABLE" ;
VAL_ 2566903329 FanErrSig 0 "OFF" 1 "ON" 2 "ERROR" 3 "NOT_AVAILABLE" ;
VAL_ 2566903329 HydWakeUpSw 0 "OFF" 1 "ON" 2 "ERROR" 3 "NOT_AVAILABLE" ;
VAL_ 2566903329 EmgStpSw 0 "OFF" 1 "ON" 2 "ERROR" 3 "NOT_AVAILABLE" ;
VAL_ 2566903329 HhVltChgSw 0 "OFF" 1 "ON" 2 "ERROR" 3 "NOT_AVAILABLE" ;
VAL_ 2566903329 PrkBrkPrsSw 0 "OFF" 1 "ON" 2 "ERROR" 3 "NOT_AVAILABLE" ;
VAL_ 2566903329 RamLckRvsSw 0 "OFF" 1 "ON" 2 "ERROR" 3 "NOT_AVAILABLE" ;
VAL_ 2566903329 AirCompPrsSw 0 "OFF" 1 "ON" 2 "ERROR" 3 "NOT_AVAILABLE" ;
VAL_ 2566903329 Mg2DJoyTrigSw 0 "OFF" 1 "ON" 2 "ERROR" 3 "NOT_AVAILABLE" ;
VAL_ 2566903329 KeySwBr 0 "OFF" 1 "ON" 2 "ERROR" 3 "NOT_AVAILABLE" ;
VAL_ 2566903329 TwSwSelSw 0 "OFF" 1 "ON" 2 "ERROR" 3 "NOT_AVAILABLE" ;
VAL_ 2566903329 DzOutSw 0 "OFF" 1 "ON" 2 "ERROR" 3 "NOT_AVAILABLE" ;
VAL_ 2566903329 MrrHtSw 0 "OFF" 1 "ON" 2 "ERROR" 3 "NOT_AVAILABLE" ;
VAL_ 2566903329 SwgAlignSw 0 "OFF" 1 "ON" 2 "ERROR" 3 "NOT_AVAILABLE" ;
VAL_ 2566903329 MultiFuncSw 0 "OFF" 1 "ON" 2 "ERROR" 3 "NOT_AVAILABLE" ;
VAL_ 2566903329 AutoDigSw 0 "OFF" 1 "ON" 2 "ERROR" 3 "NOT_AVAILABLE" ;
VAL_ 2566903329 TrvlPmpHhSpdSw 0 "OFF" 1 "ON" 2 "ERROR" 3 "NOT_AVAILABLE" ;
VAL_ 2566903329 DoorSw 0 "OFF" 1 "ON" 2 "ERROR" 3 "NOT_AVAILABLE" ;
VAL_ 2566903329 RrAxleRhHallSsSw 0 "OFF" 1 "ON" 2 "ERROR" 3 "NOT_AVAILABLE" ;
VAL_ 2566903329 RrAxleLhHallSsSw 0 "OFF" 1 "ON" 2 "ERROR" 3 "NOT_AVAILABLE" ;
VAL_ 2566903329 FrAxleHallSsSw 0 "OFF" 1 "ON" 2 "ERROR" 3 "NOT_AVAILABLE" ;
VAL_ 2566903329 QckCouplerRhSw 0 "OFF" 1 "ON" 2 "ERROR" 3 "NOT_AVAILABLE" ;
VAL_ 2566903329 QckCouplerLhSw 0 "OFF" 1 "ON" 2 "ERROR" 3 "NOT_AVAILABLE" ;
VAL_ 2566903329 PowMdSw 0 "OFF" 1 "ON" 2 "ERROR" 3 "NOT_AVAILABLE" ;
VAL_ 2566903329 WrkMdSw 0 "OFF" 1 "ON" 2 "ERROR" 3 "NOT_AVAILABLE" ;
VAL_ 2566903329 AuxMdSelSw 0 "OFF" 1 "ON" 2 "ERROR" 3 "NOT_AVAILABLE" ;
VAL_ 2566903329 SwgBrkRlsSw 0 "OFF" 1 "ON" 2 "ERROR" 3 "NOT_AVAILABLE" ;
VAL_ 2566903329 BrkrFltSw 0 "OFF" 1 "ON" 2 "ERROR" 3 "NOT_AVAILABLE" ;
VAL_ 2566903329 SwgPriSw 0 "OFF" 1 "ON" 2 "ERROR" 3 "NOT_AVAILABLE" ;
VAL_ 2566903329 RttCwSw 0 "OFF" 1 "ON" 2 "ERROR" 3 "NOT_AVAILABLE" ;
VAL_ 2566903329 RttCcwSw 0 "OFF" 1 "ON" 2 "ERROR" 3 "NOT_AVAILABLE" ;
VAL_ 2566903329 WiperWasherSw 0 "OFF" 1 "ON" 2 "ERROR" 3 "NOT_AVAILABLE" ;
VAL_ 2566903329 WiperContSw 0 "OFF" 1 "ON" 2 "ERROR" 3 "NOT_AVAILABLE" ;
VAL_ 2566903329 Wiper2StepSw 0 "OFF" 1 "ON" 2 "ERROR" 3 "NOT_AVAILABLE" ;
VAL_ 2566903329 Wiper1StepSw 0 "OFF" 1 "ON" 2 "ERROR" 3 "NOT_AVAILABLE" ;
VAL_ 2566903329 TmsSt 0 "OFF" 1 "ON" 2 "ERROR" 3 "NOT_AVAILABLE" ;
VAL_ 2566903329 ArtiBoomPrsSw 0 "OFF" 1 "ON" 2 "ERROR" 3 "NOT_AVAILABLE" ;
VAL_ 2566903329 CoolLvSw 0 "OFF" 1 "ON" 2 "ERROR" 3 "NOT_AVAILABLE" ;
VAL_ 2566903329 RttOprSw 0 "OFF" 1 "ON" 2 "ERROR" 3 "NOT_AVAILABLE" ;
VAL_ 2566903329 TwCloseOprSw 0 "OFF" 1 "ON" 2 "ERROR" 3 "NOT_AVAILABLE" ;
VAL_ 2566903329 TwOpenOprSw 0 "OFF" 1 "ON" 2 "ERROR" 3 "NOT_AVAILABLE" ;
VAL_ 2566903329 RcwCloseSw 0 "OFF" 1 "ON" 2 "ERROR" 3 "NOT_AVAILABLE" ;
VAL_ 2566903329 RcwOprSw 0 "OFF" 1 "ON" 2 "ERROR" 3 "NOT_AVAILABLE" ;
VAL_ 2566903329 EmgEgStpSw 0 "OFF" 1 "ON" 2 "ERROR" 3 "NOT_AVAILABLE" ;
VAL_ 2566903329 OwOptPdlPrsSw 0 "OFF" 1 "ON" 2 "ERROR" 3 "NOT_AVAILABLE" ;
VAL_ 2566903329 SpcSw 0 "OFF" 1 "ON" 2 "ERROR" 3 "NOT_AVAILABLE" ;
VAL_ 2566903329 IhbSw 0 "OFF" 1 "ON" 2 "ERROR" 3 "NOT_AVAILABLE" ;
VAL_ 2566903329 TrvlAlmSelSw 0 "OFF" 1 "ON" 2 "ERROR" 3 "NOT_AVAILABLE" ;
VAL_ 2566903329 SwgAlmSelSw 0 "OFF" 1 "ON" 2 "ERROR" 3 "NOT_AVAILABLE" ;
VAL_ 2566903329 EmgStrSw 0 "OFF" 1 "ON" 2 "ERROR" 3 "NOT_AVAILABLE" ;
VAL_ 2566903329 HhBeamSw 0 "OFF" 1 "ON" 2 "ERROR" 3 "NOT_AVAILABLE" ;
VAL_ 2566903329 StpLmp 0 "OFF" 1 "ON" 2 "ERROR" 3 "NOT_AVAILABLE" ;
VAL_ 2566903329 AccPdlSw 0 "OFF" 1 "ON" 2 "ERROR" 3 "NOT_AVAILABLE" ;
VAL_ 2566903329 BrkPrsSw 0 "OFF" 1 "ON" 2 "ERROR" 3 "NOT_AVAILABLE" ;
VAL_ 2566903329 Cruise 0 "OFF" 1 "ON" 2 "ERROR" 3 "NOT_AVAILABLE" ;
VAL_ 2566903329 EgOilPrsSw 0 "OFF" 1 "ON" 2 "ERROR" 3 "NOT_AVAILABLE" ;
VAL_ 2566903329 WrkPxPrsSw 0 "OFF" 1 "ON" 2 "ERROR" 3 "NOT_AVAILABLE" ;
VAL_ 2566903329 TrvlPyPrsSw 0 "OFF" 1 "ON" 2 "ERROR" 3 "NOT_AVAILABLE" ;
VAL_ 2566903329 IgnSw 0 "OFF" 1 "ON" 2 "ERROR" 3 "NOT_AVAILABLE" ;
VAL_ 2566903329 RamLckAutoSw 0 "OFF" 1 "ON" 2 "ERROR" 3 "NOT_AVAILABLE" ;
VAL_ 2566903329 PreHt 0 "OFF" 1 "ON" 2 "ERROR" 3 "NOT_AVAILABLE" ;
VAL_ 2566903329 WifWrn 0 "OFF" 1 "ON" 2 "ERROR" 3 "NOT_AVAILABLE" ;
VAL_ 2566903329 SwgPrsSw 0 "OFF" 1 "ON" 2 "ERROR" 3 "NOT_AVAILABLE" ;
VAL_ 2566903329 JoyPtnBhl 0 "OFF" 1 "ON" 2 "ERROR" 3 "NOT_AVAILABLE" ;
VAL_ 2566903329 JoyPtnIso 0 "OFF" 1 "ON" 2 "ERROR" 3 "NOT_AVAILABLE" ;
VAL_ 2566903329 RvsFanSw 0 "OFF" 1 "ON" 2 "ERROR" 3 "NOT_AVAILABLE" ;
VAL_ 2566903329 TwOptPdlPrsSw 0 "OFF" 1 "ON" 2 "ERROR" 3 "NOT_AVAILABLE" ;
VAL_ 2566903329 BrkOilPrsWrn 0 "OFF" 1 "ON" 2 "ERROR" 3 "NOT_AVAILABLE" ;
VAL_ 2566903329 OwdWrnSelSw 0 "OFF" 1 "ON" 2 "ERROR" 3 "NOT_AVAILABLE" ;
VAL_ 2566903329 RetFiltWrn 0 "OFF" 1 "ON" 2 "ERROR" 3 "NOT_AVAILABLE" ;
VAL_ 2566903329 PilotFiltWrn 0 "OFF" 1 "ON" 2 "ERROR" 3 "NOT_AVAILABLE" ;
VAL_ 2566903329 AirCleanerWrn 0 "OFF" 1 "ON" 2 "ERROR" 3 "NOT_AVAILABLE" ;
VAL_ 2566903329 PilotCutOffSw 0 "OFF" 1 "ON" 2 "ERROR" 3 "NOT_AVAILABLE" ;
VAL_ 2566903329 ItgtBoomSw 0 "OFF" 1 "ON" 2 "ERROR" 3 "NOT_AVAILABLE" ;
VAL_ 2566903329 OneTouchRedSpdSw 0 "OFF" 1 "ON" 2 "ERROR" 3 "NOT_AVAILABLE" ;
VAL_ 2566903329 RamLckSw 0 "OFF" 1 "ON" 2 "ERROR" 3 "NOT_AVAILABLE" ;
VAL_ 2566903329 PrkSw 0 "OFF" 1 "ON" 2 "ERROR" 3 "NOT_AVAILABLE" ;
VAL_ 2566903329 AirCndSw 0 "OFF" 1 "ON" 2 "ERROR" 3 "NOT_AVAILABLE" ;
VAL_ 2566903329 JoyDirSelSw 0 "OFF" 1 "ON" 2 "ERROR" 3 "NOT_AVAILABLE" ;
VAL_ 2566903329 TrvlBwdSw 0 "OFF" 1 "ON" 2 "ERROR" 3 "NOT_AVAILABLE" ;
VAL_ 2566903329 TrvlNtrlSw 0 "OFF" 1 "ON" 2 "ERROR" 3 "NOT_AVAILABLE" ;
VAL_ 2566903329 TrvlFwdSw 0 "OFF" 1 "ON" 2 "ERROR" 3 "NOT_AVAILABLE" ;
VAL_ 2566903329 HhSpdSelSw 0 "OFF" 1 "ON" 2 "ERROR" 3 "NOT_AVAILABLE" ;
VAL_ 2566903329 LwSpdSelSw 0 "OFF" 1 "ON" 2 "ERROR" 3 "NOT_AVAILABLE" ;
VAL_ 2566903329 InchingSelSw 0 "OFF" 1 "ON" 2 "ERROR" 3 "NOT_AVAILABLE" ;
VAL_ 2566903329 QckCoupler 0 "OFF" 1 "ON" 2 "ERROR" 3 "NOT_AVAILABLE" ;
VAL_ 2566903329 TwSelSw 0 "OFF" 1 "ON" 2 "ERROR" 3 "NOT_AVAILABLE" ;
VAL_ 2566903329 OnwWaySelSw 0 "OFF" 1 "ON" 2 "ERROR" 3 "NOT_AVAILABLE" ;
VAL_ 2566903329 WrkLmpSw 0 "OFF" 1 "ON" 2 "ERROR" 3 "NOT_AVAILABLE" ;
VAL_ 2566903329 AutoTrvl2SpdSw 0 "OFF" 1 "ON" 2 "ERROR" 3 "NOT_AVAILABLE" ;
VAL_ 2566903329 Trvl2SpdSelSw 0 "OFF" 1 "ON" 2 "ERROR" 3 "NOT_AVAILABLE" ;
VAL_ 2566903329 TrvlSelSw 0 "OFF" 1 "ON" 2 "ERROR" 3 "NOT_AVAILABLE" ;
VAL_ 2566903329 BrkrSw 0 "OFF" 1 "ON" 2 "ERROR" 3 "NOT_AVAILABLE" ;
VAL_ 2566903329 PwrMaxSw 0 "OFF" 1 "ON" 2 "ERROR" 3 "NOT_AVAILABLE" ;
VAL_ 2566903329 Alt 0 "OFF" 1 "ON" 2 "ERROR" 3 "NOT_AVAILABLE" ;
VAL_ 2566903585 SwgLoadRedSolR 0 "OFF" 1 "ON" 2 "ERROR" 3 "NOT_AVAILABLE" ;
VAL_ 2566903585 SwgLoadRedSolF 0 "OFF" 1 "ON" 2 "ERROR" 3 "NOT_AVAILABLE" ;
VAL_ 2566903585 OptPriSv 0 "OFF" 1 "ON" 2 "ERROR" 3 "NOT_AVAILABLE" ;
VAL_ 2566903585 PmpDrvCoolSv 0 "OFF" 1 "ON" 2 "ERROR" 3 "NOT_AVAILABLE" ;
VAL_ 2566903585 SecondStarterRly 0 "OFF" 1 "ON" 2 "ERROR" 3 "NOT_AVAILABLE" ;
VAL_ 2566903585 FuelFilledLmp 0 "OFF" 1 "ON" 2 "ERROR" 3 "NOT_AVAILABLE" ;
VAL_ 2566903585 ExtVocWarnSig 0 "OFF" 1 "ON" 2 "ERROR" 3 "NOT_AVAILABLE" ;
VAL_ 2566903585 EtpRly 0 "OFF" 1 "ON" 2 "ERROR" 3 "NOT_AVAILABLE" ;
VAL_ 2566903585 DesRunSig 0 "OFF" 1 "ON" 2 "ERROR" 3 "NOT_AVAILABLE" ;
VAL_ 2566903585 EngRunOutSig 0 "OFF" 1 "ON" 2 "ERROR" 3 "NOT_AVAILABLE" ;
VAL_ 2566903585 AccRly 0 "OFF" 1 "ON" 2 "ERROR" 3 "NOT_AVAILABLE" ;
VAL_ 2566903585 SelSv 0 "OFF" 1 "ON" 2 "ERROR" 3 "NOT_AVAILABLE" ;
VAL_ 2566903585 EmgStrSv 0 "OFF" 1 "ON" 2 "ERROR" 3 "NOT_AVAILABLE" ;
VAL_ 2566903585 TrvlRhPilotCutOffSv 0 "OFF" 1 "ON" 2 "ERROR" 3 "NOT_AVAILABLE" ;
VAL_ 2566903585 GndSawMdChangeRly 0 "OFF" 1 "ON" 2 "ERROR" 3 "NOT_AVAILABLE" ;
VAL_ 2566903585 HvChgSig 0 "OFF" 1 "ON" 2 "ERROR" 3 "NOT_AVAILABLE" ;
VAL_ 2566903585 FanPwmSig 0 "OFF" 1 "ON" 2 "ERROR" 3 "NOT_AVAILABLE" ;
VAL_ 2566903585 TrkExpationSv 0 "OFF" 1 "ON" 2 "ERROR" 3 "NOT_AVAILABLE" ;
VAL_ 2566903585 HhVltMainRly 0 "OFF" 1 "ON" 2 "ERROR" 3 "NOT_AVAILABLE" ;
VAL_ 2566903585 HhVltPreChgRly 0 "OFF" 1 "ON" 2 "ERROR" 3 "NOT_AVAILABLE" ;
VAL_ 2566903585 PilotBz 0 "OFF" 1 "ON" 2 "ERROR" 3 "NOT_AVAILABLE" ;
VAL_ 2566903585 QckChgInd 0 "OFF" 1 "ON" 2 "ERROR" 3 "NOT_AVAILABLE" ;
VAL_ 2566903585 QckChgRly 0 "OFF" 1 "ON" 2 "ERROR" 3 "NOT_AVAILABLE" ;
VAL_ 2566903585 NormChgInd 0 "OFF" 1 "ON" 2 "ERROR" 3 "NOT_AVAILABLE" ;
VAL_ 2566903585 LwVltMainRly 0 "OFF" 1 "ON" 2 "ERROR" 3 "NOT_AVAILABLE" ;
VAL_ 2566903585 BoomSwgSelRly 0 "OFF" 1 "ON" 2 "ERROR" 3 "NOT_AVAILABLE" ;
VAL_ 2566903585 PmpDeratSv 0 "OFF" 1 "ON" 2 "ERROR" 3 "NOT_AVAILABLE" ;
VAL_ 2566903585 PrkBrkRly 0 "OFF" 1 "ON" 2 "ERROR" 3 "NOT_AVAILABLE" ;
VAL_ 2566903585 RvsLmpRly 0 "OFF" 1 "ON" 2 "ERROR" 3 "NOT_AVAILABLE" ;
VAL_ 2566903585 AirCompRly 0 "OFF" 1 "ON" 2 "ERROR" 3 "NOT_AVAILABLE" ;
VAL_ 2566903585 CabLmpRly 0 "OFF" 1 "ON" 2 "ERROR" 3 "NOT_AVAILABLE" ;
VAL_ 2566903585 AvmWrnSig 0 "OFF" 1 "ON" 2 "ERROR" 3 "NOT_AVAILABLE" ;
VAL_ 2566903585 WrkLmpRly 0 "OFF" 1 "ON" 2 "ERROR" 3 "NOT_AVAILABLE" ;
VAL_ 2566903585 AirCondCompStpSig 0 "OFF" 1 "ON" 2 "ERROR" 3 "NOT_AVAILABLE" ;
VAL_ 2566903585 Chmsl 0 "OFF" 1 "ON" 2 "ERROR" 3 "NOT_AVAILABLE" ;
VAL_ 2566903585 BoomSusRodSv 0 "OFF" 1 "ON" 2 "ERROR" 3 "NOT_AVAILABLE" ;
VAL_ 2566903585 BoomSusHedSv 0 "OFF" 1 "ON" 2 "ERROR" 3 "NOT_AVAILABLE" ;
VAL_ 2566903585 MrrHt 0 "OFF" 1 "ON" 2 "ERROR" 3 "NOT_AVAILABLE" ;
VAL_ 2566903585 ClearLmp 0 "OFF" 1 "ON" 2 "ERROR" 3 "NOT_AVAILABLE" ;
VAL_ 2566903585 HhHeadLmp 0 "OFF" 1 "ON" 2 "ERROR" 3 "NOT_AVAILABLE" ;
VAL_ 2566903585 LwHeadLmp 0 "OFF" 1 "ON" 2 "ERROR" 3 "NOT_AVAILABLE" ;
VAL_ 2566903585 FineSwgSv 0 "OFF" 1 "ON" 2 "ERROR" 3 "NOT_AVAILABLE" ;
VAL_ 2566903585 TurnRhSigLmp 0 "OFF" 1 "ON" 2 "ERROR" 3 "NOT_AVAILABLE" ;
VAL_ 2566903585 TurnLhSigLmp 0 "OFF" 1 "ON" 2 "ERROR" 3 "NOT_AVAILABLE" ;
VAL_ 2566903585 BeaconRly 0 "OFF" 1 "ON" 2 "ERROR" 3 "NOT_AVAILABLE" ;
VAL_ 2566903585 LightRly 0 "OFF" 1 "ON" 2 "ERROR" 3 "NOT_AVAILABLE" ;
VAL_ 2566903585 LmpRly 0 "OFF" 1 "ON" 2 "ERROR" 3 "NOT_AVAILABLE" ;
VAL_ 2566903585 RamLckSv 0 "OFF" 1 "ON" 2 "ERROR" 3 "NOT_AVAILABLE" ;
VAL_ 2566903585 LwSpdTrvlSv 0 "OFF" 1 "ON" 2 "ERROR" 3 "NOT_AVAILABLE" ;
VAL_ 2566903585 TrvlPmpHhSpd2Sv 0 "OFF" 1 "ON" 2 "ERROR" 3 "NOT_AVAILABLE" ;
VAL_ 2566903585 TrvlPmpHhSpd1Sv 0 "OFF" 1 "ON" 2 "ERROR" 3 "NOT_AVAILABLE" ;
VAL_ 2566903585 WiperWasherRly 0 "OFF" 1 "ON" 2 "ERROR" 3 "NOT_AVAILABLE" ;
VAL_ 2566903585 WiperRly 0 "OFF" 1 "ON" 2 "ERROR" 3 "NOT_AVAILABLE" ;
VAL_ 2566903585 AutoShutOffRly 0 "OFF" 1 "ON" 2 "ERROR" 3 "NOT_AVAILABLE" ;
VAL_ 2566903585 AirHtRly 0 "OFF" 1 "ON" 2 "ERROR" 3 "NOT_AVAILABLE" ;
VAL_ 2566903585 GlowPlugPreHhRly2 0 "OFF" 1 "ON" 2 "ERROR" 3 "NOT_AVAILABLE" ;
VAL_ 2566903585 GlowPlugPreHhRly1 0 "OFF" 1 "ON" 2 "ERROR" 3 "NOT_AVAILABLE" ;
VAL_ 2566903585 HhSpdRly 0 "OFF" 1 "ON" 2 "ERROR" 3 "NOT_AVAILABLE" ;
VAL_ 2566903585 LwSpdRly 0 "OFF" 1 "ON" 2 "ERROR" 3 "NOT_AVAILABLE" ;
VAL_ 2566903585 InchingRly 0 "OFF" 1 "ON" 2 "ERROR" 3 "NOT_AVAILABLE" ;
VAL_ 2566903585 SpareRly 0 "OFF" 1 "ON" 2 "ERROR" 3 "NOT_AVAILABLE" ;
VAL_ 2566903585 BackBzRly 0 "OFF" 1 "ON" 2 "ERROR" 3 "NOT_AVAILABLE" ;
VAL_ 2566903585 StartRly 0 "OFF" 1 "ON" 2 "ERROR" 3 "NOT_AVAILABLE" ;
VAL_ 2566903585 AutoBrkSv 0 "OFF" 1 "ON" 2 "ERROR" 3 "NOT_AVAILABLE" ;
VAL_ 2566903585 PilotCutOffSv 0 "OFF" 1 "ON" 2 "ERROR" 3 "NOT_AVAILABLE" ;
VAL_ 2566903585 McvEpprCutOffSv 0 "OFF" 1 "ON" 2 "ERROR" 3 "NOT_AVAILABLE" ;
VAL_ 2566903585 BsSpoolSc 0 "OFF" 1 "ON" 2 "ERROR" 3 "NOT_AVAILABLE" ;
VAL_ 2566903585 QckCouplerSv 0 "OFF" 1 "ON" 2 "ERROR" 3 "NOT_AVAILABLE" ;
VAL_ 2566903585 FreeBoomDnSv 0 "OFF" 1 "ON" 2 "ERROR" 3 "NOT_AVAILABLE" ;
VAL_ 2566903585 FreeBoomUpSv 0 "OFF" 1 "ON" 2 "ERROR" 3 "NOT_AVAILABLE" ;
VAL_ 2566903585 TrvlStrgtSv 0 "OFF" 1 "ON" 2 "ERROR" 3 "NOT_AVAILABLE" ;
VAL_ 2566903585 RttCcwSv 0 "OFF" 1 "ON" 2 "ERROR" 3 "NOT_AVAILABLE" ;
VAL_ 2566903585 RttCwSv 0 "OFF" 1 "ON" 2 "ERROR" 3 "NOT_AVAILABLE" ;
VAL_ 2566903585 Trvl2PmpCmbSv 0 "OFF" 1 "ON" 2 "ERROR" 3 "NOT_AVAILABLE" ;
VAL_ 2566903585 OptPdlSaftySv 0 "OFF" 1 "ON" 2 "ERROR" 3 "NOT_AVAILABLE" ;
VAL_ 2566903585 ForceRgnSv 0 "OFF" 1 "ON" 2 "ERROR" 3 "NOT_AVAILABLE" ;
VAL_ 2566903585 TwOprSv 0 "OFF" 1 "ON" 2 "ERROR" 3 "NOT_AVAILABLE" ;
VAL_ 2566903585 UnloadSv 0 "OFF" 1 "ON" 2 "ERROR" 3 "NOT_AVAILABLE" ;
VAL_ 2566903585 TwRhCloseSv 0 "OFF" 1 "ON" 2 "ERROR" 3 "NOT_AVAILABLE" ;
VAL_ 2566903585 TwRhOpenSv 0 "OFF" 1 "ON" 2 "ERROR" 3 "NOT_AVAILABLE" ;
VAL_ 2566903585 SwgBrkRelSv 0 "OFF" 1 "ON" 2 "ERROR" 3 "NOT_AVAILABLE" ;
VAL_ 2566903585 BypassCutOffSv 0 "OFF" 1 "ON" 2 "ERROR" 3 "NOT_AVAILABLE" ;
VAL_ 2566903585 RwdSv 0 "OFF" 1 "ON" 2 "ERROR" 3 "NOT_AVAILABLE" ;
VAL_ 2566903585 FwdSv 0 "OFF" 1 "ON" 2 "ERROR" 3 "NOT_AVAILABLE" ;
VAL_ 2566903585 CruiseSv 0 "OFF" 1 "ON" 2 "ERROR" 3 "NOT_AVAILABLE" ;
VAL_ 2566903585 TwoPmpSelSv 0 "OFF" 1 "ON" 2 "ERROR" 3 "NOT_AVAILABLE" ;
VAL_ 2566903585 FanRvsSv 0 "OFF" 1 "ON" 2 "ERROR" 3 "NOT_AVAILABLE" ;
VAL_ 2566903585 BrkrSelSv 0 "OFF" 1 "ON" 2 "ERROR" 3 "NOT_AVAILABLE" ;
VAL_ 2566903585 HhSpdTrvlSv 0 "OFF" 1 "ON" 2 "ERROR" 3 "NOT_AVAILABLE" ;
VAL_ 2566903585 PowMaxSv 0 "OFF" 1 "ON" 2 "ERROR" 3 "NOT_AVAILABLE" ;
VAL_ 2566903585 BrkrOprSv 0 "OFF" 1 "ON" 2 "ERROR" 3 "NOT_AVAILABLE" ;
VAL_ 2566904353 AxleDhlCtrlSw 0 "OFF" 1 "ON" 2 "ERROR" 3 "NOT_AVAILABLE" ;
VAL_ 2566904353 QckCplDisengageSw 0 "OFF" 1 "ON" 2 "ERROR" 3 "NOT_AVAILABLE" ;
VAL_ 2566904353 RttBeaconSw 0 "OFF" 1 "ON" 2 "ERROR" 3 "NOT_AVAILABLE" ;
VAL_ 2566904353 RvsFanManualSw 0 "OFF" 1 "ON" 2 "ERROR" 3 "NOT_AVAILABLE" ;
VAL_ 2566904353 RvsFanAutoSw 0 "OFF" 1 "ON" 2 "ERROR" 3 "NOT_AVAILABLE" ;
VAL_ 2566904353 Aux8Sw 0 "OFF" 1 "ON" 2 "ERROR" 3 "NOT_AVAILABLE" ;
VAL_ 2566904353 TwoSpeedSw 0 "OFF" 1 "ON" 2 "ERROR" 3 "NOT_AVAILABLE" ;
VAL_ 2566904353 Aux7Sw 0 "OFF" 1 "ON" 2 "ERROR" 3 "NOT_AVAILABLE" ;
VAL_ 2566904353 OpsSw 0 "OFF" 1 "ON" 2 "ERROR" 3 "NOT_AVAILABLE" ;
VAL_ 2566904353 HhFlowPinK 0 "OFF" 1 "ON" 2 "ERROR" 3 "NOT_AVAILABLE" ;
VAL_ 2566904353 HhFlowPinN 0 "OFF" 1 "ON" 2 "ERROR" 3 "NOT_AVAILABLE" ;
VAL_ 2566904353 DustInd 0 "OFF" 1 "ON" 2 "ERROR" 3 "NOT_AVAILABLE" ;
VAL_ 2566904353 FrDoorSw 0 "OFF" 1 "ON" 2 "ERROR" 3 "NOT_AVAILABLE" ;
VAL_ 2566904353 ArmRestLhSw 0 "OFF" 1 "ON" 2 "ERROR" 3 "NOT_AVAILABLE" ;
VAL_ 2566904353 ArmRestRhSw 0 "OFF" 1 "ON" 2 "ERROR" 3 "NOT_AVAILABLE" ;
VAL_ 2566904353 Spool3LeverSw 0 "OFF" 1 "ON" 2 "ERROR" 3 "NOT_AVAILABLE" ;
VAL_ 2566904353 BckLeverSw 0 "OFF" 1 "ON" 2 "ERROR" 3 "NOT_AVAILABLE" ;
VAL_ 2566904353 EgOilPrsSw 0 "OFF" 1 "ON" 2 "ERROR" 3 "NOT_AVAILABLE" ;
VAL_ 2566904353 HydLckoutSw 0 "OFF" 1 "ON" 2 "ERROR" 3 "NOT_AVAILABLE" ;
VAL_ 2566904353 TractionCtrlSw 0 "OFF" 1 "ON" 2 "ERROR" 3 "NOT_AVAILABLE" ;
VAL_ 2566904353 AirCleanSw 0 "OFF" 1 "ON" 2 "ERROR" 3 "NOT_AVAILABLE" ;
VAL_ 2566904353 RetFiltSw 0 "OFF" 1 "ON" 2 "ERROR" 3 "NOT_AVAILABLE" ;
VAL_ 2566904353 QckCouperLckSw 0 "OFF" 1 "ON" 2 "ERROR" 3 "NOT_AVAILABLE" ;
VAL_ 2566904353 DnShftSw 0 "OFF" 1 "ON" 2 "ERROR" 3 "NOT_AVAILABLE" ;
VAL_ 2566904353 PreHt 0 "OFF" 1 "ON" 2 "ERROR" 3 "NOT_AVAILABLE" ;
VAL_ 2566904353 Joy1XDetentPosSt 0 "OFF" 1 "ON" 2 "ERROR" 3 "NOT_AVAILABLE" ;
VAL_ 2566904353 Joy1YDetentPosSt 0 "OFF" 1 "ON" 2 "ERROR" 3 "NOT_AVAILABLE" ;
VAL_ 2566904353 IhbSw 0 "OFF" 1 "ON" 2 "ERROR" 3 "NOT_AVAILABLE" ;
VAL_ 2566904353 HstOilFiltWrn 0 "OFF" 1 "ON" 2 "ERROR" 3 "NOT_AVAILABLE" ;
VAL_ 2566904353 GrboxOvrTmp 0 "OFF" 1 "ON" 2 "ERROR" 3 "NOT_AVAILABLE" ;
VAL_ 2566904353 AgsLmp 0 "OFF" 1 "ON" 2 "ERROR" 3 "NOT_AVAILABLE" ;
VAL_ 2566904353 QckCouplerInitSw 0 "OFF" 1 "ON" 2 "ERROR" 3 "NOT_AVAILABLE" ;
VAL_ 2566904353 PrkSw 0 "OFF" 1 "ON" 2 "ERROR" 3 "NOT_AVAILABLE" ;
VAL_ 2566904353 SeatBeltSw 0 "OFF" 1 "ON" 2 "ERROR" 3 "NOT_AVAILABLE" ;
VAL_ 2566904353 ReDefrstSw 0 "OFF" 1 "ON" 2 "ERROR" 3 "NOT_AVAILABLE" ;
VAL_ 2566904353 HormSw 0 "OFF" 1 "ON" 2 "ERROR" 3 "NOT_AVAILABLE" ;
VAL_ 2566904353 Fnr2ActSw 0 "OFF" 1 "ON" 2 "ERROR" 3 "NOT_AVAILABLE" ;
VAL_ 2566904353 RearWiperStpSw 0 "OFF" 1 "ON" 2 "ERROR" 3 "NOT_AVAILABLE" ;
VAL_ 2566904353 FrWiperStpSig 0 "OFF" 1 "ON" 2 "ERROR" 3 "NOT_AVAILABLE" ;
VAL_ 2566904353 DpfForceRgnSw 0 "OFF" 1 "ON" 2 "ERROR" 3 "NOT_AVAILABLE" ;
VAL_ 2566904353 EmgStrPrsSw 0 "OFF" 1 "ON" 2 "ERROR" 3 "NOT_AVAILABLE" ;
VAL_ 2566904353 MainStrPrsSw 0 "OFF" 1 "ON" 2 "ERROR" 3 "NOT_AVAILABLE" ;
VAL_ 2566904353 AccPdlKd 0 "OFF" 1 "ON" 2 "ERROR" 3 "NOT_AVAILABLE" ;
VAL_ 2566904353 AccPdlIvs 0 "OFF" 1 "ON" 2 "ERROR" 3 "NOT_AVAILABLE" ;
VAL_ 2566904353 PrkBrkPrsSw 0 "OFF" 1 "ON" 2 "ERROR" 3 "NOT_AVAILABLE" ;
VAL_ 2566904353 CoolLv 0 "OFF" 1 "ON" 2 "ERROR" 3 "NOT_AVAILABLE" ;
VAL_ 2566904353 WghCntSw 0 "OFF" 1 "ON" 2 "ERROR" 3 "NOT_AVAILABLE" ;
VAL_ 2566904353 EmgStpSw 0 "OFF" 1 "ON" 2 "ERROR" 3 "NOT_AVAILABLE" ;
VAL_ 2566904353 DhlManSw 0 "OFF" 1 "ON" 2 "ERROR" 3 "NOT_AVAILABLE" ;
VAL_ 2566904353 FnrR3 0 "OFF" 1 "ON" 2 "ERROR" 3 "NOT_AVAILABLE" ;
VAL_ 2566904353 FnrN3 0 "OFF" 1 "ON" 2 "ERROR" 3 "NOT_AVAILABLE" ;
VAL_ 2566904353 FnrF3 0 "OFF" 1 "ON" 2 "ERROR" 3 "NOT_AVAILABLE" ;
VAL_ 2566904353 FnrR2 0 "OFF" 1 "ON" 2 "ERROR" 3 "NOT_AVAILABLE" ;
VAL_ 2566904353 FnrN2 0 "OFF" 1 "ON" 2 "ERROR" 3 "NOT_AVAILABLE" ;
VAL_ 2566904353 FnrF2 0 "OFF" 1 "ON" 2 "ERROR" 3 "NOT_AVAILABLE" ;
VAL_ 2566904353 FnrR1 0 "OFF" 1 "ON" 2 "ERROR" 3 "NOT_AVAILABLE" ;
VAL_ 2566904353 FnrN1 0 "OFF" 1 "ON" 2 "ERROR" 3 "NOT_AVAILABLE" ;
VAL_ 2566904353 FnrF1 0 "OFF" 1 "ON" 2 "ERROR" 3 "NOT_AVAILABLE" ;
VAL_ 2566904353 StartBrSw 0 "OFF" 1 "ON" 2 "ERROR" 3 "NOT_AVAILABLE" ;
VAL_ 2566904353 StartAccSw 0 "OFF" 1 "ON" 2 "ERROR" 3 "NOT_AVAILABLE" ;
VAL_ 2566904353 StartCSw 0 "OFF" 1 "ON" 2 "ERROR" 3 "NOT_AVAILABLE" ;
VAL_ 2566904353 PilotCutOffSw 0 "OFF" 1 "ON" 2 "ERROR" 3 "NOT_AVAILABLE" ;
VAL_ 2566904353 ArmRestCutOffSw 0 "OFF" 1 "ON" 2 "ERROR" 3 "NOT_AVAILABLE" ;
VAL_ 2566904353 ElecStrSelSw 0 "OFF" 1 "ON" 2 "ERROR" 3 "NOT_AVAILABLE" ;
VAL_ 2566904609 DhlSol 0 "OFF" 1 "ON" 2 "ERROR" 3 "NOT_AVAILABLE" ;
VAL_ 2566904609 GreenBeacon 0 "OFF" 1 "ON" 2 "ERROR" 3 "NOT_AVAILABLE" ;
VAL_ 2566904609 Beacon 0 "OFF" 1 "ON" 2 "ERROR" 3 "NOT_AVAILABLE" ;
VAL_ 2566904609 RrWrkLmp 0 "OFF" 1 "ON" 2 "ERROR" 3 "NOT_AVAILABLE" ;
VAL_ 2566904609 FrWrkLmp 0 "OFF" 1 "ON" 2 "ERROR" 3 "NOT_AVAILABLE" ;
VAL_ 2566904609 EfanOutSig 0 "OFF" 1 "ON" 2 "ERROR" 3 "NOT_AVAILABLE" ;
VAL_ 2566904609 RrCabLmpRly 0 "OFF" 1 "ON" 2 "ERROR" 3 "NOT_AVAILABLE" ;
VAL_ 2566904609 FrCabLmpRly 0 "OFF" 1 "ON" 2 "ERROR" 3 "NOT_AVAILABLE" ;
VAL_ 2566904609 HeadLmpRly 0 "OFF" 1 "ON" 2 "ERROR" 3 "NOT_AVAILABLE" ;
VAL_ 2566904609 RideCtrlCutOffSv 0 "OFF" 1 "ON" 2 "ERROR" 3 "NOT_AVAILABLE" ;
VAL_ 2566904609 Aux8 0 "OFF" 1 "ON" 2 "ERROR" 3 "NOT_AVAILABLE" ;
VAL_ 2566904609 Aux7 0 "OFF" 1 "ON" 2 "ERROR" 3 "NOT_AVAILABLE" ;
VAL_ 2566904609 Aux6 0 "OFF" 1 "ON" 2 "ERROR" 3 "NOT_AVAILABLE" ;
VAL_ 2566904609 Aux5 0 "OFF" 1 "ON" 2 "ERROR" 3 "NOT_AVAILABLE" ;
VAL_ 2566904609 Aux4 0 "OFF" 1 "ON" 2 "ERROR" 3 "NOT_AVAILABLE" ;
VAL_ 2566904609 Aux3 0 "OFF" 1 "ON" 2 "ERROR" 3 "NOT_AVAILABLE" ;
VAL_ 2566904609 AuxShutOffSv 0 "OFF" 1 "ON" 2 "ERROR" 3 "NOT_AVAILABLE" ;
VAL_ 2566904609 PilotCutOffSv 0 "OFF" 1 "ON" 2 "ERROR" 3 "NOT_AVAILABLE" ;
VAL_ 2566904609 FrWiperRly 0 "OFF" 1 "ON" 2 "ERROR" 3 "NOT_AVAILABLE" ;
VAL_ 2566904609 SideWasherRly 0 "OFF" 1 "ON" 2 "ERROR" 3 "NOT_AVAILABLE" ;
VAL_ 2566904609 UreaSuperChgWrnSig 0 "OFF" 1 "ON" 2 "ERROR" 3 "NOT_AVAILABLE" ;
VAL_ 2566904609 EgRunOutSig 0 "OFF" 1 "ON" 2 "ERROR" 3 "NOT_AVAILABLE" ;
VAL_ 2566904609 SideWiperRly 0 "OFF" 1 "ON" 2 "ERROR" 3 "NOT_AVAILABLE" ;
VAL_ 2566904609 FrWhaserRly 0 "OFF" 1 "ON" 2 "ERROR" 3 "NOT_AVAILABLE" ;
VAL_ 2566904609 FrWiperLwSigRly 0 "OFF" 1 "ON" 2 "ERROR" 3 "NOT_AVAILABLE" ;
VAL_ 2566904609 FrWiperHhSpdRly 0 "OFF" 1 "ON" 2 "ERROR" 3 "NOT_AVAILABLE" ;
VAL_ 2566904609 LwBeamRly 0 "OFF" 1 "ON" 2 "ERROR" 3 "NOT_AVAILABLE" ;
VAL_ 2566904609 HhBeamRly 0 "OFF" 1 "ON" 2 "ERROR" 3 "NOT_AVAILABLE" ;
VAL_ 2566904609 IllmLmpRly 0 "OFF" 1 "ON" 2 "ERROR" 3 "NOT_AVAILABLE" ;
VAL_ 2566904609 RttBeaconRly 0 "OFF" 1 "ON" 2 "ERROR" 3 "NOT_AVAILABLE" ;
VAL_ 2566904609 TurnSigRhRly 0 "OFF" 1 "ON" 2 "ERROR" 3 "NOT_AVAILABLE" ;
VAL_ 2566904609 TurnSigLhRly 0 "OFF" 1 "ON" 2 "ERROR" 3 "NOT_AVAILABLE" ;
VAL_ 2566904609 HormRly 0 "OFF" 1 "ON" 2 "ERROR" 3 "NOT_AVAILABLE" ;
VAL_ 2566904609 AccRly 0 "OFF" 1 "ON" 2 "ERROR" 3 "NOT_AVAILABLE" ;
VAL_ 2566904609 RrWinHtRly 0 "OFF" 1 "ON" 2 "ERROR" 3 "NOT_AVAILABLE" ;
VAL_ 2566904609 AutoShutOffRly 0 "OFF" 1 "ON" 2 "ERROR" 3 "NOT_AVAILABLE" ;
VAL_ 2566904609 BackUpBzRly 0 "OFF" 1 "ON" 2 "ERROR" 3 "NOT_AVAILABLE" ;
VAL_ 2566904609 MrrHtRly 0 "OFF" 1 "ON" 2 "ERROR" 3 "NOT_AVAILABLE" ;
VAL_ 2566904609 HuelHtRly 0 "OFF" 1 "ON" 2 "ERROR" 3 "NOT_AVAILABLE" ;
VAL_ 2566904609 GlowPlugFuelRly 0 "OFF" 1 "ON" 2 "ERROR" 3 "NOT_AVAILABLE" ;
VAL_ 2566904609 GlowPlugRly 0 "OFF" 1 "ON" 2 "ERROR" 3 "NOT_AVAILABLE" ;
VAL_ 2566904609 EmgStrTestRly 0 "OFF" 1 "ON" 2 "ERROR" 3 "NOT_AVAILABLE" ;
VAL_ 2566904609 RrWasherRly 0 "OFF" 1 "ON" 2 "ERROR" 3 "NOT_AVAILABLE" ;
VAL_ 2566904609 RrWiperRly 0 "OFF" 1 "ON" 2 "ERROR" 3 "NOT_AVAILABLE" ;
VAL_ 2566904609 RrWrkCabLmpRly 0 "OFF" 1 "ON" 2 "ERROR" 3 "NOT_AVAILABLE" ;
VAL_ 2566904609 RrWrkRadLmpRly 0 "OFF" 1 "ON" 2 "ERROR" 3 "NOT_AVAILABLE" ;
VAL_ 2566904609 FrWrkLmpRly 0 "OFF" 1 "ON" 2 "ERROR" 3 "NOT_AVAILABLE" ;
VAL_ 2566904609 ElecStrSaftyRly 0 "OFF" 1 "ON" 2 "ERROR" 3 "NOT_AVAILABLE" ;
VAL_ 2566904609 PilotBzRly 0 "OFF" 1 "ON" 2 "ERROR" 3 "NOT_AVAILABLE" ;
VAL_ 2566904609 LisActRly 0 "OFF" 1 "ON" 2 "ERROR" 3 "NOT_AVAILABLE" ;
VAL_ 2566904609 HstCutOffRhSv 0 "OFF" 1 "ON" 2 "ERROR" 3 "NOT_AVAILABLE" ;
VAL_ 2566904609 HstCutOffLhSv 0 "OFF" 1 "ON" 2 "ERROR" 3 "NOT_AVAILABLE" ;
VAL_ 2566904609 BckMagnet 0 "OFF" 1 "ON" 2 "ERROR" 3 "NOT_AVAILABLE" ;
VAL_ 2566904609 BoomMagnet 0 "OFF" 1 "ON" 2 "ERROR" 3 "NOT_AVAILABLE" ;
VAL_ 2566904609 HstCutOffSv 0 "OFF" 1 "ON" 2 "ERROR" 3 "NOT_AVAILABLE" ;
VAL_ 2566904609 HydCutOffSv 0 "OFF" 1 "ON" 2 "ERROR" 3 "NOT_AVAILABLE" ;
VAL_ 2566904609 StartRly 0 "OFF" 1 "ON" 2 "ERROR" 3 "NOT_AVAILABLE" ;
VAL_ 2566904609 QckCouplerRly 0 "OFF" 1 "ON" 2 "ERROR" 3 "NOT_AVAILABLE" ;
VAL_ 2566904609 EgStpRly 0 "OFF" 1 "ON" 2 "ERROR" 3 "NOT_AVAILABLE" ;
VAL_ 2566904609 PrkBrkRlsSv 0 "OFF" 1 "ON" 2 "ERROR" 3 "NOT_AVAILABLE" ;
VAL_ 2566904609 EscortWrkLmpRly 0 "OFF" 1 "ON" 2 "ERROR" 3 "NOT_AVAILABLE" ;
VAL_ 2566904609 AxleOilCoolSv 0 "OFF" 1 "ON" 2 "ERROR" 3 "NOT_AVAILABLE" ;
VAL_ 2566904609 UnloadSv 0 "OFF" 1 "ON" 2 "ERROR" 3 "NOT_AVAILABLE" ;
VAL_ 2566904609 BrkChgSv 0 "OFF" 1 "ON" 2 "ERROR" 3 "NOT_AVAILABLE" ;
VAL_ 2566904609 RvsFanSV 0 "OFF" 1 "ON" 2 "ERROR" 3 "NOT_AVAILABLE" ;
VAL_ 2566904865 EcuMaker2 0 "ECU_MAKER_1" 1 "WEICHAI_6M33" 2 "BOSCH_DX22" ;
VAL_ 2566904865 MchMaker 0 "HDI" 1 "HCE" ;
VAL_ 2566904865 SalesRegion 0 "KOREA" 1 "CHINA" 2 "ADVANCED" 3 "EMERGING" 4 "US" ;
VAL_ 2566904865 TcuType 0 "HDT" 1 "HST" 2 "CVT" 3 "HDT_LEVEL1" ;
VAL_ 2566904865 JoyType 0 "HYDRAULIC" 1 "ELECTRIC" 2 "ELECTRONIC" ;
VAL_ 2566904865 McvCtrlType 0 "MECHANIC" 1 "VBO" 2 "FEH" ;
VAL_ 2566904865 McvType 0 "MECHANIC" 1 "ELECTRIC" ;
VAL_ 2566904865 PmpCtrlType 0 "MECHANIC" 1 "ELECTRIC" ;
VAL_ 2566904865 PmpType 0 "NEGACON" 1 "POSICON" 2 "OPEN_CENTER" 3 "VBO" 4 "LS" ;
VAL_ 2566904865 EcuMaker 0 "NONE" 1 "BOSCH_DL06_DL08" 2 "SCANIA" 3 "CUMMINS" 4 "PERKINS_2506J" 5 "ISUZU" 6 "BOSCH_G2" 7 "HITACHI" 8 "PERKINS_1204J" 9 "WOODWARD" 10 "BOSCH_EDC7" 11 "WEIFU" 12 "PERKINS_2506J_UNIFIED" 13 "BOSCH_DX05_DX08" 14 "KUBOTA" 15 "ECU_MAKER_2" ;
VAL_ 2566904865 EgMaker 0 "NONE" 1 "DEVELON" 2 "SCANIA" 3 "CUMMINS" 4 "PERKINS" 5 "ISUZU" 7 "YANMAR" 8 "DAEDONG" 9 "KUBOTA" 10 "WEICHAI" ;
VAL_ 2566904865 MchType 0 "CRAWLER" 1 "LONG_CRAWLER" 2 "LOGLOADER" 3 "REDUCED_TAIL" 4 "ZERO_TAIL" 5 "MOUNTAIN" 6 "WHEEL" 7 "LOADER" 8 "DOZER" 9 "MATERIAL_HANDLER" 10 "MATERIAL_HANDLER_WHEEL" 11 "DRILL_RIG" 12 "COMPACT_TRACK_LOADER" 13 "ROAD_BUILDER" 14 "ADT" ;
VAL_ 2566904865 MchGen 0 "DX" 1 "U" 2 "V" 3 "C" 4 "B" 5 "W" 96 "JD" 108 "AGK" 128 "DL" 129 "H" 130 "K" 131 "S" 132 "SD" 133 "G" 224 "D" ;
VAL_ 2566904865 EmsCtrl 0 "TIER2" 1 "TIER3" 2 "TIER4I" 3 "TIER4F" 4 "STAGEV" 5 "NR4" 128 "NOT_AVAILABLE" ;
VAL_ 2566905121 Tw4BrkrBtnType 0 "PUSH" 1 "TOGGLE" 2 "PROPOTIONOT_AVAILABLEL" 3 "NOT_AVAILABLE" ;
VAL_ 2566905121 Tw3BrkrBtnType 0 "PUSH" 1 "TOGGLE" 2 "PROPOTIONOT_AVAILABLEL" 3 "NOT_AVAILABLE" ;
VAL_ 2566905121 Tw2BrkrBtnType 0 "PUSH" 1 "TOGGLE" 2 "PROPOTIONOT_AVAILABLEL" 3 "NOT_AVAILABLE" ;
VAL_ 2566905121 Tw1BrkrBtnType 0 "PUSH" 1 "TOGGLE" 2 "PROPOTIONOT_AVAILABLEL" 3 "NOT_AVAILABLE" ;
VAL_ 2566905121 Tw0BrkrBtnType 0 "PUSH" 1 "TOGGLE" 2 "PROPOTIONOT_AVAILABLEL" 3 "NOT_AVAILABLE" ;
VAL_ 2566905121 Ow4BrkrBtnType 0 "PUSH" 1 "TOGGLE" 2 "PROPOTIONOT_AVAILABLEL" 3 "NOT_AVAILABLE" ;
VAL_ 2566905121 Ow3BrkrBtnType 0 "PUSH" 1 "TOGGLE" 2 "PROPOTIONOT_AVAILABLEL" 3 "NOT_AVAILABLE" ;
VAL_ 2566905121 Ow2BrkrBtnType 0 "PUSH" 1 "TOGGLE" 2 "PROPOTIONOT_AVAILABLEL" 3 "NOT_AVAILABLE" ;
VAL_ 2566905121 Ow1BrkrBtnType 0 "PUSH" 1 "TOGGLE" 2 "PROPOTIONOT_AVAILABLEL" 3 "NOT_AVAILABLE" ;
VAL_ 2566905121 Ow0BrkrBtnType 0 "PUSH" 1 "TOGGLE" 2 "PROPOTIONOT_AVAILABLEL" 3 "NOT_AVAILABLE" ;
VAL_ 2566906657 SecSt 0 "NONE" 1 "ACTIVE" 2 "INACTIVE" ;
VAL_ 2566907681 IccoFunCrcmdScore 0 "FALSE" 1 "TRUE" 2 "ERROR" 3 "NOT_AVAILABLE" ;
VAL_ 2566907681 UnssHydReliefScore 0 "FALSE" 1 "TRUE" 2 "ERROR" 3 "NOT_AVAILABLE" ;
VAL_ 2566907681 InIntentBrkPreventScore 0 "FALSE" 1 "TRUE" 2 "ERROR" 3 "NOT_AVAILABLE" ;
VAL_ 2566907681 EmgStpPreventScore 0 "FALSE" 1 "TRUE" 2 "ERROR" 3 "NOT_AVAILABLE" ;
VAL_ 2566907681 EgMdDnRcmdScore 0 "FALSE" 1 "TRUE" 2 "ERROR" 3 "NOT_AVAILABLE" ;
VAL_ 2566907681 LckUpRcmdScore 0 "FALSE" 1 "TRUE" 2 "ERROR" 3 "NOT_AVAILABLE" ;
VAL_ 2566907681 GrNeutRpmUpScore 0 "FALSE" 1 "TRUE" 2 "ERROR" 3 "NOT_AVAILABLE" ;
VAL_ 2566907681 IdlePrvtScore 0 "FALSE" 1 "TRUE" 2 "ERROR" 3 "NOT_AVAILABLE" ;
VAL_ 2566907681 ManGrMaxSpdRcmdScore 0 "FALSE" 1 "TRUE" 2 "ERROR" 3 "NOT_AVAILABLE" ;
VAL_ 2566907681 Auto14RcmdScore 0 "FALSE" 1 "TRUE" 2 "ERROR" 3 "NOT_AVAILABLE" ;
VAL_ 2566907681 LisVhcSpdSetDnChngRcmdScore 0 "FALSE" 1 "TRUE" 2 "ERROR" 3 "NOT_AVAILABLE" ;
VAL_ 2566907681 LisVhcSpdSetUpChngRcmdScore 0 "FALSE" 1 "TRUE" 2 "ERROR" 3 "NOT_AVAILABLE" ;
VAL_ 2566907681 LisFunCrcmdScore 0 "FALSE" 1 "TRUE" 2 "ERROR" 3 "NOT_AVAILABLE" ;
VAL_ 2566907681 EcoGudCtrl 1 "RECOM_USE_OF_THE_LIS_FEATURE" 2 "RECOM_USE_1_4_AUTO" 4 "PREVENTION_OF_IDLE_STATE" 8 "RECOM_USE_OF_LOCK_UP" 16 "RECOM_LOWERING_THE_ENGINE_MODE" 32 "RECOM_USE_OF_THE_ICCO_FEATURE" ;
